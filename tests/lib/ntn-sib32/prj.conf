## CMakeLists.txt
```
#
# Copyright (c) 2026 Nordic Semiconductor ASA
#
# SPDX-License-Identifier: LicenseRef-Nordic-5-Clause
#

cmake_minimum_required(VERSION 3.20.0)

find_package(Zephyr REQUIRED HINTS $ENV{ZEPHYR_BASE})
project(ntn_sib32_test)

test_runner_generate(src/test_sib32_tle.c)

set(ASSET_TRACKER_TEMPLATE_DIR ../../..)

target_sources(app
  PRIVATE
  src/test_sib32_tle.c
)

zephyr_include_directories(${ZEPHYR_BASE}/include/zephyr/)
zephyr_include_directories(${ZEPHYR_BASE}/subsys/testsuite/include)
zephyr_include_directories(${ASSET_TRACKER_TEMPLATE_DIR}/app/src/common)
zephyr_include_directories(${ASSET_TRACKER_TEMPLATE_DIR}/lib/sgp4)

target_link_options(app PRIVATE --whole-archive)
```

## prj.conf
```kconfig
#
# Copyright (c) 2026 Nordic Semiconductor ASA
#
# SPDX-License-Identifier: LicenseRef-Nordic-5-Clause
#

CONFIG_SGP4_PASS_PREDICT=y
CONFIG_UNITY=y
CONFIG_LOG=y
CONFIG_CBPRINTF_FP_SUPPORT=y
CONFIG_HEAP_MEM_POOL_SIZE=80000
CONFIG_MAIN_STACK_SIZE=16384
CONFIG_NATIVE_SIM_SLOWDOWN_TO_REAL_TIME=n
```

## src/test_sib32_tle.c
```c
/*
 * Copyright (c) 2026 Nordic Semiconductor ASA
 *
 * SPDX-License-Identifier: LicenseRef-Nordic-5-Clause
 */

#include <unity.h>
#include <zephyr/fff.h>
#include <zephyr/zbus/zbus.h>
#include <zephyr/logging/log.h>
#include <zephyr/random/random.h>
#include <stdint.h>
#include <stdlib.h>
#include <date_time.h>
#include <time.h>
#include "sgp4_pass_predict.h"

/* missing headers */
struct tm *gmtime_r(const int64_t *timep, struct tm *result);

DEFINE_FFF_GLOBALS;

FAKE_VALUE_FUNC(int, date_time_now, int64_t *);

LOG_MODULE_REGISTER(ntn_sib32_test, LOG_LEVEL_DBG);

/* Thu Feb 12 2026 09:38:29 GMT+0000 */
#define FAKE_TIME_MS 1770889109000LL

static int date_time_now_custom_fake(int64_t *time)
{
	*time = FAKE_TIME_MS;
	return 0;
}

void setUp(void)
{
	RESET_FAKE(date_time_now);
	date_time_now_fake.custom_fake = date_time_now_custom_fake;
}

#define LAT_TRD 63.43
#define LON_TRD 10.39
#define ALT_TRD 40.0

static void debug_print_time(const char *label, const int64_t time)
{
	struct tm tm_local;
	char time_str[32];

	gmtime_r(&time, &tm_local);
	strftime(time_str, sizeof(time_str), "%Y-%m-%d %H:%M:%S", &tm_local);
	LOG_DBG("%s: %s", label, time_str);
}

static void debug_print_satrec(struct sat_data *data,  int index)
{
	LOG_DBG("data->satrec[%d].no_kozai: %f", index, data->satrec[index].no_kozai);
	LOG_DBG("data->satrec[%d].ecco: %f", index, data->satrec[index].ecco);
	LOG_DBG("data->satrec[%d].inclo: %f", index, data->satrec[index].inclo);
	LOG_DBG("data->satrec[%d].nodeo: %f", index, data->satrec[index].nodeo);
	LOG_DBG("data->satrec[%d].argpo: %f", index, data->satrec[index].argpo);
	LOG_DBG("data->satrec[%d].mo: %f", index, data->satrec[index].mo);
	LOG_DBG("data->satrec[%d].bstar: %f", index, data->satrec[index].bstar);
	LOG_DBG("data->satrec[%d].jdsatepoch: %f", index, data->satrec[index].jdsatepoch);
	LOG_DBG("data->satrec[%d].jdsatepochF: %f", index, data->satrec[index].jdsatepochF);
}

#define EXPECTED_NEXT_PASS_START_TIME 1770893489LL
#define EXPECTED_NEXT_PASS_END_TIME 1770893669LL
#define EXPECTED_NEXT_PASS_MAX_ELEVATION_TIME 1770893549LL


void test_nextpass_atsib_sateliot_1(void)
{
	int err;
	struct sat_data data = {0};
	const char *atsib32 = "SIBCONFIG: 32,\"00000001\",2,1,1138123,1529334,1391197,758633,"
		"13719,2572629918,28139,-3,120679,,11,11,,,,3,1138188,1686202,1399132,2534648,"
		"10028,2572728485,19572,-3,121275,,11,11,,,";

	err = sat_data_init_atsib32(&data, atsib32);
	TEST_ASSERT_EQUAL(0, err);
	debug_print_satrec(&data, 0);
	err = sat_data_calculate_next_pass(&data, 0, LAT_TRD, LON_TRD, ALT_TRD, FAKE_TIME_MS);
	TEST_ASSERT_EQUAL(0, err);
	LOG_INF("Next pass: %lld", data.next_pass.start_time_ms);
	LOG_INF("End time: %lld", data.next_pass.end_time_ms);
	LOG_INF("Max elevation time: %lld", data.next_pass.max_elevation_time_ms);

	int64_t start_time = data.next_pass.start_time_ms / 1000;
	int64_t end_time = data.next_pass.end_time_ms / 1000;
	int64_t max_elevation_time = data.next_pass.max_elevation_time_ms / 1000;

	debug_print_time("data.next_pass.start_time", start_time);
	debug_print_time("data.next_pass.end_time", end_time);
	debug_print_time("data.next_pass.max_elevation_time", max_elevation_time);

	TEST_ASSERT_EQUAL(EXPECTED_NEXT_PASS_START_TIME, start_time);
	TEST_ASSERT_EQUAL(EXPECTED_NEXT_PASS_END_TIME, end_time);
	TEST_ASSERT_EQUAL(EXPECTED_NEXT_PASS_MAX_ELEVATION_TIME, max_elevation_time);
}

void test_nextpass_tle_sateliot_1(void)
{
	int err;
	char line1[] = "1 60550U 24149CL  26041.62762187  .00003124  00000+0  27307-3 0  9999";
	char line2[] = "2 60550  97.6859 119.6343 0008059 130.5773 229.6152 14.97467371 81125";
	struct sat_data data = {0};

	err = sat_data_init_tle(&data, line1, line2);
	TEST_ASSERT_EQUAL(0, err);
	debug_print_satrec(&data, 0);
	err = sat_data_calculate_next_pass(&data, 0, LAT_TRD, LON_TRD, ALT_TRD, FAKE_TIME_MS);
	TEST_ASSERT_EQUAL(0, err);
	LOG_INF("Next pass: %lld", data.next_pass.start_time_ms);
	LOG_INF("End time: %lld", data.next_pass.end_time_ms);
	LOG_INF("Max elevation time: %lld", data.next_pass.max_elevation_time_ms);

	int64_t start_time = data.next_pass.start_time_ms / 1000;
	int64_t end_time = data.next_pass.end_time_ms / 1000;
	int64_t max_elevation_time = data.next_pass.max_elevation_time_ms / 1000;

	debug_print_time("data.next_pass.start_time", start_time);
	debug_print_time("data.next_pass.end_time", end_time);
	debug_print_time("data.next_pass.max_elevation_time", max_elevation_time);
	LOG_DBG("TLEs:\n%s\n%s", line1, line2);
	TEST_ASSERT_EQUAL(EXPECTED_NEXT_PASS_START_TIME, start_time);
	TEST_ASSERT_EQUAL(EXPECTED_NEXT_PASS_END_TIME, end_time);
	TEST_ASSERT_EQUAL(EXPECTED_NEXT_PASS_MAX_ELEVATION_TIME, max_elevation_time);
}

extern int unity_main(void);

int main(void)
{
	/* use the runner from test_runner_generate() */
	(void)unity_main();

	return 0;
}
```
