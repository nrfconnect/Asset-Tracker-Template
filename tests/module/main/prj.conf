## CMakeLists.txt
```
#
# Copyright (c) 2025 Nordic Semiconductor ASA
#
# SPDX-License-Identifier: LicenseRef-Nordic-5-Clause
#

cmake_minimum_required(VERSION 3.20.0)

find_package(Zephyr REQUIRED HINTS $ENV{ZEPHYR_BASE})
project(app_module_test)

test_runner_generate(src/main.c)

set(ASSET_TRACKER_TEMPLATE_DIR ${CMAKE_CURRENT_SOURCE_DIR}/../../..)

# Make Kconfig values available as CMake variables for CBOR generation
set(CONFIG_APP_STORAGE_MAX_RECORDS_PER_TYPE 10)
# Include CBOR generation (required by main app)
add_subdirectory(${ASSET_TRACKER_TEMPLATE_DIR}/app/src/cbor ${CMAKE_CURRENT_BINARY_DIR}/cbor)
target_sources(app
	PRIVATE
	src/main.c
	src/checks.c
	${ASSET_TRACKER_TEMPLATE_DIR}/app/src/main.c
	${ASSET_TRACKER_TEMPLATE_DIR}/app/src/cbor/cbor_helper.c
)

target_include_directories(app PRIVATE src)

zephyr_include_directories(${ZEPHYR_BASE}/include/zephyr/)
zephyr_include_directories(${ZEPHYR_BASE}/subsys/testsuite/include)
zephyr_include_directories(../../../app/src/common)
zephyr_include_directories(../../../app/src/cbor)
zephyr_include_directories(../../../app/src/modules/cloud)
zephyr_include_directories(../../../app/src/modules/power)
zephyr_include_directories(../../../app/src/modules/button)
zephyr_include_directories(../../../app/src/modules/network)
zephyr_include_directories(../../../app/src/modules/environmental)
zephyr_include_directories(../../../app/src/modules/fota)
zephyr_include_directories(../../../app/src/modules/location)
zephyr_include_directories(../../../app/src/modules/led)
zephyr_include_directories(../../../app/src/modules/storage)
zephyr_include_directories(${ZEPHYR_BASE}/../nrfxlib/nrf_modem/include)

target_link_options(app PRIVATE --whole-archive)

add_compile_options(-Wno-return-type)

set_property(SOURCE ${ASSET_TRACKER_TEMPLATE_DIR}/app/src/main.c PROPERTY COMPILE_FLAGS
	     "-include ${CMAKE_CURRENT_SOURCE_DIR}/src/redef.h")

# Options that cannot be passed through Kconfig fragments
target_compile_definitions(app PRIVATE
	-DCONFIG_APP_LOG_LEVEL=1
	-DCONFIG_APP_MSG_PROCESSING_TIMEOUT_SECONDS=120
	-DCONFIG_APP_WATCHDOG_TIMEOUT_SECONDS=180
	-DCONFIG_APP_CLOUD_PAYLOAD_BUFFER_MAX_SIZE=100
	-DCONFIG_APP_CLOUD_SHADOW_RESPONSE_BUFFER_MAX_SIZE=512
	-DCONFIG_APP_SAMPLING_INTERVAL_SECONDS=600
	-DCONFIG_APP_CLOUD_LOG_LEVEL=0
	-DCONFIG_APP_CLOUD_THREAD_STACK_SIZE=2048
	-DCONFIG_APP_CLOUD_MESSAGE_QUEUE_SIZE=5
	-DCONFIG_APP_CLOUD_BACKOFF_TYPE_LINEAR=1
	-DCONFIG_APP_CLOUD_BACKOFF_INITIAL_SECONDS=6
	-DCONFIG_APP_CLOUD_BACKOFF_LINEAR_INCREMENT_SECONDS=6
	-DCONFIG_APP_CLOUD_BACKOFF_MAX_SECONDS=36
	-DCONFIG_LTE_LC_EDRX_MODULE=1
	-DCONFIG_LTE_LC_PSM_MODULE=1
	-DCOAP_CONTENT_FORMAT_APP_JSON=50
	-DCONFIG_APP_POWER=1
	-DCONFIG_APP_ENVIRONMENTAL=1
	-DCONFIG_APP_BUTTON=1
	-DZEPHYR_INCLUDE_SYS_REBOOT_H_
	-DCONFIG_LOCATION_SERVICE_EXTERNAL
	-DCONFIG_LOCATION_METHOD_CELLULAR=1
	-DCONFIG_LOCATION_METHOD_WIFI=1
	-DCONFIG_LOCATION_METHODS_LIST_SIZE=3
	-DCONFIG_APP_LOCATION_WIFI_APS_MAX=10
	-DCONFIG_APP_LOCATION_NEIGHBOR_CELLS_MAX=10
	-DCONFIG_LTE_NEIGHBOR_CELLS_MAX=10
	-DCONFIG_LOCATION_METHOD_WIFI_SCANNING_RESULTS_MAX_CNT=10
	-DCONFIG_LOCATION_METHOD_WIFI_SCANNING_CHANNELS_MAX=3
	-DCONFIG_NRF_CLOUD_AGNSS=y
	-DCONFIG_APP_STORAGE_INITIAL_THRESHOLD=1
)
```

## prj.conf
```kconfig
#
# Copyright (c) 2025 Nordic Semiconductor ASA
#
# SPDX-License-Identifier: LicenseRef-Nordic-5-Clause
#

CONFIG_UNITY=y
CONFIG_ZBUS=y
CONFIG_LOG=y
CONFIG_LOG_MODE_IMMEDIATE=y
CONFIG_ZBUS_OBSERVER_NAME=y
CONFIG_ZBUS_CHANNEL_NAME=y
CONFIG_ZBUS_MSG_SUBSCRIBER=y
CONFIG_ZBUS_RUNTIME_OBSERVERS=y
CONFIG_CBPRINTF_FP_SUPPORT=y
CONFIG_HEAP_MEM_POOL_SIZE=40000
CONFIG_ZBUS_MSG_SUBSCRIBER_NET_BUF_POOL_SIZE=100

CONFIG_SMF=y
CONFIG_SMF_ANCESTOR_SUPPORT=y
CONFIG_SMF_INITIAL_TRANSITION=y
CONFIG_NATIVE_SIM_SLOWDOWN_TO_REAL_TIME=n
CONFIG_DATE_TIME=y
CONFIG_DATE_TIME_NTP=n

CONFIG_MAIN_STACK_SIZE=8192
```

## src/main.c
```c
/*
 * Copyright (c) 2025 Nordic Semiconductor ASA
 *
 * SPDX-License-Identifier: LicenseRef-Nordic-5-Clause
 */
#include <unity.h>
#include <zephyr/fff.h>
#include <zephyr/zbus/zbus.h>
#include <zephyr/task_wdt/task_wdt.h>
#include <zephyr/logging/log.h>
#include <date_time.h>

#include "dk_buttons_and_leds.h"
#include "app_common.h"
#include "power.h"
#include "network.h"
#include "environmental.h"
#include "cloud.h"
#include "fota.h"
#include "location.h"
#include "led.h"
#include "button.h"
#include "storage.h"
#include "checks.h"
#include "cbor_helper.h"

DEFINE_FFF_GLOBALS;

#define HOUR_IN_SECONDS 3600
#define WEEK_IN_SECONDS HOUR_IN_SECONDS * 24 * 7

FAKE_VALUE_FUNC(int, dk_buttons_init, button_handler_t);
FAKE_VALUE_FUNC(int, task_wdt_feed, int);
FAKE_VALUE_FUNC(int, task_wdt_add, uint32_t, task_wdt_callback_t, void *);
FAKE_VOID_FUNC(sys_reboot, int);

LOG_MODULE_REGISTER(main_module_test, 4);

/* Define the channels for testing */
ZBUS_CHAN_DEFINE(power_chan,
	struct power_msg,
	NULL,
	NULL,
	ZBUS_OBSERVERS_EMPTY,
	ZBUS_MSG_INIT(0)
);
ZBUS_CHAN_DEFINE(button_chan,
	struct button_msg,
	NULL,
	NULL,
	ZBUS_OBSERVERS_EMPTY,
	ZBUS_MSG_INIT(0)
);
ZBUS_CHAN_DEFINE(network_chan,
	struct network_msg,
	NULL,
	NULL,
	ZBUS_OBSERVERS_EMPTY,
	ZBUS_MSG_INIT(.type = NETWORK_DISCONNECTED)
);
ZBUS_CHAN_DEFINE(cloud_chan,
	struct cloud_msg,
	NULL,
	NULL,
	ZBUS_OBSERVERS_EMPTY,
	ZBUS_MSG_INIT(.type = CLOUD_DISCONNECTED)
);
ZBUS_CHAN_DEFINE(environmental_chan,
	struct environmental_msg,
	NULL,
	NULL,
	ZBUS_OBSERVERS_EMPTY,
	ZBUS_MSG_INIT(0)
);
ZBUS_CHAN_DEFINE(fota_chan,
	struct fota_msg,
	NULL,
	NULL,
	ZBUS_OBSERVERS_EMPTY,
	ZBUS_MSG_INIT(0)
);
ZBUS_CHAN_DEFINE(location_chan,
	struct location_msg,
	NULL,
	NULL,
	ZBUS_OBSERVERS_EMPTY,
	ZBUS_MSG_INIT(0)
);
ZBUS_CHAN_DEFINE(led_chan,
	struct led_msg,
	NULL,
	NULL,
	ZBUS_OBSERVERS_EMPTY,
	ZBUS_MSG_INIT(0)
);
ZBUS_CHAN_DEFINE(storage_chan,
	struct storage_msg,
	NULL,
	NULL,
	ZBUS_OBSERVERS_EMPTY,
	ZBUS_MSG_INIT(0)
);

/* Helper functions for sending messages */

static void send_cloud_connected(void)
{
	struct cloud_msg cloud_msg = {
		.type = CLOUD_CONNECTED,
	};

	int err = zbus_chan_pub(&cloud_chan, &cloud_msg, K_SECONDS(1));

	TEST_ASSERT_EQUAL(0, err);
}

static void send_cloud_disconnected(void)
{
	struct cloud_msg cloud_msg = {
		.type = CLOUD_DISCONNECTED,
	};

	int err = zbus_chan_pub(&cloud_chan, &cloud_msg, K_SECONDS(1));

	TEST_ASSERT_EQUAL(0, err);
}

static void send_location_search_done(void)
{
	struct location_msg msg = {
		.type = LOCATION_SEARCH_DONE,
	};

	int err = zbus_chan_pub(&location_chan, &msg, K_SECONDS(1));

	TEST_ASSERT_EQUAL(0, err);
}

static void send_location_ready(void)
{
	struct location_msg msg = {
		.type = LOCATION_MODULE_READY,
	};

	int err = zbus_chan_pub(&location_chan, &msg, K_SECONDS(1));

	TEST_ASSERT_EQUAL(0, err);
}

static void send_power_ready(void)
{
	struct power_msg msg = {
		.type = POWER_MODULE_READY,
	};

	int err = zbus_chan_pub(&power_chan, &msg, K_SECONDS(1));

	TEST_ASSERT_EQUAL(0, err);
}

static void send_button_press_short(void)
{
	struct button_msg button_msg = {
		.type = BUTTON_PRESS_SHORT,
		.button_number = 1
	};

	int err = zbus_chan_pub(&button_chan, &button_msg, K_SECONDS(1));

	TEST_ASSERT_EQUAL(0, err);
}

static void send_button_press_long(void)
{
	struct button_msg button_msg = {
		.type = BUTTON_PRESS_LONG,
		.button_number = 1
	};

	int err = zbus_chan_pub(&button_chan, &button_msg, K_SECONDS(1));

	TEST_ASSERT_EQUAL(0, err);
}

static void send_storage_threshold_reached(void)
{
	struct storage_msg storage_msg = {
		.type = STORAGE_THRESHOLD_REACHED,
	};
	int err = zbus_chan_pub(&storage_chan, &storage_msg, K_SECONDS(1));

	TEST_ASSERT_EQUAL(0, err);
}

static void send_storage_batch_close(void)
{
	struct storage_msg storage_msg = {
		.type = STORAGE_BATCH_CLOSE,
	};
	int err = zbus_chan_pub(&storage_chan, &storage_msg, K_SECONDS(1));

	TEST_ASSERT_EQUAL(0, err);
}

static void send_fota_msg(enum fota_msg_type msg_type)
{
	int err;
	struct fota_msg msg = { .type = msg_type };

	LOG_INF("Sending FOTA message: %d", msg_type);

	err = zbus_chan_pub(&fota_chan, &msg, K_SECONDS(1));
	TEST_ASSERT_EQUAL(0, err);

	k_sleep(K_MSEC(100));
}

static void config_change_sampling_interval(uint32_t sampling_interval)
{
	int err;
	struct cloud_msg msg = {
		.type = CLOUD_SHADOW_RESPONSE_DELTA,
	};
	struct config_params config = {
		.sample_interval = sampling_interval,
	};
	size_t encoded_len = 0;

	err = encode_shadow_parameters_to_cbor(&config, 0, 0, msg.response.buffer,
							 sizeof(msg.response.buffer), &encoded_len);
	if (err != 0) {
		TEST_FAIL_MESSAGE("Failed to encode CBOR parameters");
	}

	msg.response.buffer_data_len = encoded_len;

	err = zbus_chan_pub(&cloud_chan, &msg, K_SECONDS(1));
	TEST_ASSERT_EQUAL(0, err);
}

static void config_change_all(uint32_t sample_interval, uint32_t storage_threshold)
{
	int err;
	struct cloud_msg msg = {
		.type = CLOUD_SHADOW_RESPONSE_DELTA,
	};
	struct config_params config = {
		.sample_interval = sample_interval,
		.storage_threshold = storage_threshold,
		.storage_threshold_valid = true,
	};
	size_t encoded_len = 0;

	err = encode_shadow_parameters_to_cbor(&config, 0, 0, msg.response.buffer,
					       sizeof(msg.response.buffer), &encoded_len);
	if (err != 0) {
		TEST_FAIL_MESSAGE("Failed to encode CBOR parameters");
	}

	msg.response.buffer_data_len = encoded_len;

	err = zbus_chan_pub(&cloud_chan, &msg, K_SECONDS(1));
	TEST_ASSERT_EQUAL(0, err);
}

/* Publish a shadow response with an empty CBOR payload. */
static void send_shadow_response_empty_payload(enum cloud_msg_type type)
{
	int err;
	struct cloud_msg msg = { .type = type };
	struct config_params empty_config = {0};
	size_t encoded_len = 0;

	err = encode_shadow_parameters_to_cbor(&empty_config, 0, 0, msg.response.buffer,
					       sizeof(msg.response.buffer), &encoded_len);
	if (err != 0) {
		TEST_FAIL_MESSAGE("Failed to encode empty CBOR parameters");
	}

	msg.response.buffer_data_len = encoded_len;

	err = zbus_chan_pub(&cloud_chan, &msg, K_SECONDS(1));
	TEST_ASSERT_EQUAL(0, err);
}

/* Restart the sampling timer by doing a immediate sample using a short button press */
static void restart_sample_timer(void)
{
	send_button_press_short();
	expect_location_event(LOCATION_SEARCH_TRIGGER);

	send_location_search_done();
	expect_location_event(LOCATION_SEARCH_DONE);
	expect_power_event(POWER_BATTERY_PERCENTAGE_SAMPLE_REQUEST);
}

/* Connect to cloud and complete the initial data dispatch cycle.
 * STATE_CONNECTED_SENDING is the initial child state of STATE_CONNECTED,
 * so connecting always triggers an immediate data dispatch via cloud_send_now().
 */
static void connect_to_cloud(void)
{
	send_cloud_connected();
	expect_cloud_event(CLOUD_CONNECTED);
}

void setUp(void)
{
	RESET_FAKE(dk_buttons_init);
	RESET_FAKE(task_wdt_feed);
	RESET_FAKE(task_wdt_add);
	RESET_FAKE(sys_reboot);

	/* Send ready messages for all relevant modules */
	send_location_ready();
	send_power_ready();
	send_fota_msg(FOTA_MODULE_READY);

	/* Ensure clean disconnected state */
	send_cloud_disconnected();
	k_sleep(K_MSEC(500));

	/* Trigger a button press to "burn" the current sampling cycle and reset state.
	 * This bypasses the "too soon to sample" protection and ensures each test
	 * starts with a known, clean state.
	 */
	send_button_press_short();
	send_location_search_done();
	/* Wait for sampling to complete and return to waiting state */
	k_sleep(K_MSEC(100));

	FFF_RESET_HISTORY();

	/* Clear any stale events from cleanup */
	purge_all_events();
}

/* Test functions */

void test_init_first_connection(void)
{
	/* Connect to cloud */
	send_cloud_connected();
	expect_cloud_event(CLOUD_CONNECTED);

	/* First connection should trigger fota poll and get shadow desired */
	expect_cloud_event(CLOUD_SHADOW_UPDATE_REPORTED_DEVICE);
	expect_fota_event(FOTA_POLL_REQUEST);
	expect_cloud_event(CLOUD_SHADOW_GET_DESIRED);
}

void test_short_button_press_connected(void)
{
	connect_to_cloud();

	/* Short button press should trigger sampling immediately */
	send_button_press_short();
	expect_location_event(LOCATION_SEARCH_TRIGGER);

	/* Complete location search */
	send_location_search_done();
	expect_location_event(LOCATION_SEARCH_DONE);
	expect_power_event(POWER_BATTERY_PERCENTAGE_SAMPLE_REQUEST);
}

void test_long_button_press_connected(void)
{
	connect_to_cloud();

	/* Long button press should trigger sending start */
	send_button_press_long();
	expect_storage_event(STORAGE_BATCH_REQUEST);

	/* Cloud/FOTA poll fires after the batch closes */
	send_storage_batch_close();
	expect_storage_event(STORAGE_BATCH_CLOSE);
	expect_fota_event(FOTA_POLL_REQUEST);
	expect_cloud_event(CLOUD_SHADOW_GET_DELTA);
}

void test_threshold_reached_connected(void)
{
	connect_to_cloud();

	/* Threshold reached should trigger sending start */
	send_storage_threshold_reached();
	expect_storage_event(STORAGE_THRESHOLD_REACHED);
	expect_storage_event(STORAGE_BATCH_REQUEST);

	/* Cloud/FOTA poll fires after the batch closes */
	send_storage_batch_close();
	expect_storage_event(STORAGE_BATCH_CLOSE);
	expect_fota_event(FOTA_POLL_REQUEST);
	expect_cloud_event(CLOUD_SHADOW_GET_DELTA);
}

void test_short_button_press_disconnected(void)
{
	/* Short button press should trigger sampling immediately */
	send_button_press_short();
	expect_location_event(LOCATION_SEARCH_TRIGGER);

	/* Complete location search */
	send_location_search_done();
	expect_location_event(LOCATION_SEARCH_DONE);
	expect_power_event(POWER_BATTERY_PERCENTAGE_SAMPLE_REQUEST);
}

void test_long_button_press_disconnected(void)
{
	/* Long button press when disconnected should be ignored */
	send_button_press_long();
	expect_no_events(500);
}

void test_threshold_reached_disconnected(void)
{
	/* Threshold reached when disconnected should be ignored */
	send_storage_threshold_reached();
	expect_storage_event(STORAGE_THRESHOLD_REACHED);
	expect_no_events(500);

	/* Connection after threshold reached should trigger immediate sending */
	connect_to_cloud();
	expect_storage_event(STORAGE_BATCH_REQUEST);

	/* Cloud/FOTA poll fires after the batch closes */
	send_storage_batch_close();
	expect_storage_event(STORAGE_BATCH_CLOSE);
	expect_fota_event(FOTA_POLL_REQUEST);
	expect_cloud_event(CLOUD_SHADOW_GET_DELTA);
}

void test_threshold_reached_during_connected_sampling(void)
{
	connect_to_cloud();

	send_button_press_short();
	expect_location_event(LOCATION_SEARCH_TRIGGER);
	expect_power_event(POWER_BATTERY_PERCENTAGE_SAMPLE_REQUEST);

	send_storage_threshold_reached();
	expect_storage_event(STORAGE_THRESHOLD_REACHED);
	expect_no_events(1);

	send_location_search_done();
	expect_location_event(LOCATION_SEARCH_DONE);
	expect_storage_event(STORAGE_BATCH_REQUEST);

	send_storage_batch_close();
	expect_storage_event(STORAGE_BATCH_CLOSE);
	expect_fota_event(FOTA_POLL_REQUEST);
	expect_cloud_event(CLOUD_SHADOW_GET_DELTA);

	restart_sample_timer();
	expect_no_events(500);
}

void test_threshold_reached_during_disconnected_sampling(void)
{
	send_button_press_short();
	expect_location_event(LOCATION_SEARCH_TRIGGER);

	send_storage_threshold_reached();
	expect_storage_event(STORAGE_THRESHOLD_REACHED);

	send_location_search_done();
	expect_location_event(LOCATION_SEARCH_DONE);
	expect_power_event(POWER_BATTERY_PERCENTAGE_SAMPLE_REQUEST);
	expect_no_events(500);

	connect_to_cloud();
	expect_storage_event(STORAGE_BATCH_REQUEST);

	send_storage_batch_close();
	expect_storage_event(STORAGE_BATCH_CLOSE);
	expect_fota_event(FOTA_POLL_REQUEST);
	expect_cloud_event(CLOUD_SHADOW_GET_DELTA);
}

void test_threshold_during_sampling_cleared_by_long_press(void)
{
	connect_to_cloud();

	send_button_press_short();
	expect_location_event(LOCATION_SEARCH_TRIGGER);

	send_storage_threshold_reached();
	expect_storage_event(STORAGE_THRESHOLD_REACHED);

	send_button_press_long();
	expect_storage_event(STORAGE_BATCH_REQUEST);

	send_location_search_done();
	expect_location_event(LOCATION_SEARCH_DONE);
	expect_power_event(POWER_BATTERY_PERCENTAGE_SAMPLE_REQUEST);

	send_storage_batch_close();
	expect_storage_event(STORAGE_BATCH_CLOSE);
	expect_fota_event(FOTA_POLL_REQUEST);
	expect_cloud_event(CLOUD_SHADOW_GET_DELTA);

	restart_sample_timer();
	expect_no_events(500);
}

void test_fota_state_ignores_events_until_aborted(void)
{
	connect_to_cloud();

	/* FOTA module signals download start -> main transitions to STATE_FOTA */
	send_fota_msg(FOTA_STARTING);
	expect_fota_event(FOTA_STARTING);

	/* While in STATE_FOTA, cloud-ready and button events should be ignored */
	send_cloud_connected();
	expect_cloud_event(CLOUD_CONNECTED);
	expect_no_events(7200);
	send_button_press_short();
	expect_no_events(7200);

	/* FOTA module requests a network disconnect, main translates the
	 * request into NETWORK_DISCONNECT on network_chan.
	 */
	send_fota_msg(FOTA_NETWORK_DISCONNECT_NEEDED);
	expect_fota_event(FOTA_NETWORK_DISCONNECT_NEEDED);
	expect_network_event(NETWORK_DISCONNECT);

	/* Network confirms disconnection, main translates the notification
	 * into FOTA_NETWORK_DISCONNECTED on fota_chan.
	 */
	struct network_msg net_msg = { .type = NETWORK_DISCONNECTED };
	int err = zbus_chan_pub(&network_chan, &net_msg, K_SECONDS(1));

	TEST_ASSERT_EQUAL(0, err);
	expect_network_event(NETWORK_DISCONNECTED);
	expect_fota_event(FOTA_NETWORK_DISCONNECTED);

	/* Abort from the FOTA module returns main to running_history */
	send_fota_msg(FOTA_ABORTED);

	/* Then sampling resumes */
	expect_location_event(LOCATION_SEARCH_TRIGGER);
	send_location_search_done();
	expect_location_event(LOCATION_SEARCH_DONE);
	expect_power_event(POWER_BATTERY_PERCENTAGE_SAMPLE_REQUEST);
}

void test_sensor_timer_multiple_expiries(void)
{
	connect_to_cloud();

	restart_sample_timer();

	/* Wait for sample timer to trigger sampling */
	k_sleep(K_SECONDS(CONFIG_APP_SAMPLING_INTERVAL_SECONDS));
	expect_timer_event(TIMER_EXPIRED_SAMPLE_DATA);
	expect_location_event(LOCATION_SEARCH_TRIGGER);

	/* Complete location search */
	send_location_search_done();
	expect_location_event(LOCATION_SEARCH_DONE);
	expect_power_event(POWER_BATTERY_PERCENTAGE_SAMPLE_REQUEST);

	/* Wait for next sample timer */
	k_sleep(K_SECONDS(CONFIG_APP_SAMPLING_INTERVAL_SECONDS));
	expect_timer_event(TIMER_EXPIRED_SAMPLE_DATA);
	expect_location_event(LOCATION_SEARCH_TRIGGER);

	/* Complete location search */
	send_location_search_done();
	expect_location_event(LOCATION_SEARCH_DONE);
	expect_power_event(POWER_BATTERY_PERCENTAGE_SAMPLE_REQUEST);
}

/* During network activity, no location search should be triggered */
void test_no_sampling_during_cloud_send(void)
{
	connect_to_cloud();

	/* Trigger cloud send */
	send_button_press_long();
	expect_storage_event(STORAGE_BATCH_REQUEST);

	/* Try to trigger sampling during an active send */
	send_button_press_short();

	/* Nothing should happen */
	expect_no_events(500);

	/* Close batch to signal send completion, polls fire after */
	send_storage_batch_close();
	expect_storage_event(STORAGE_BATCH_CLOSE);
	expect_fota_event(FOTA_POLL_REQUEST);
	expect_cloud_event(CLOUD_SHADOW_GET_DELTA);
}

void test_config_change(void)
{
	connect_to_cloud();

	/* Restart timer to know the timing for the next trigger */
	restart_sample_timer();

	/* Change sample interval and verify that the new interval is respected */
	config_change_sampling_interval(300);
	expect_cloud_event(CLOUD_SHADOW_RESPONSE_DELTA);
	expect_cloud_event(CLOUD_SHADOW_UPDATE_REPORTED_CONFIG);
	expect_timer_event(TIMER_CONFIG_CHANGED);

	k_sleep(K_SECONDS(300));
	expect_timer_event(TIMER_EXPIRED_SAMPLE_DATA);
	expect_location_event(LOCATION_SEARCH_TRIGGER);

	/* Complete location search */
	send_location_search_done();
	expect_location_event(LOCATION_SEARCH_DONE);
	expect_power_event(POWER_BATTERY_PERCENTAGE_SAMPLE_REQUEST);

	/* Restart timer to know the timing for the next trigger */
	restart_sample_timer();

	/* Change all parameters at once and verify that all changes are respected */
	config_change_all(200, 3);
	expect_storage_event(STORAGE_SET_THRESHOLD);
	expect_cloud_event(CLOUD_SHADOW_RESPONSE_DELTA);
	expect_cloud_event(CLOUD_SHADOW_UPDATE_REPORTED_CONFIG);
	expect_timer_event(TIMER_CONFIG_CHANGED);

	k_sleep(K_SECONDS(200));
	expect_timer_event(TIMER_EXPIRED_SAMPLE_DATA);
	expect_location_event(LOCATION_SEARCH_TRIGGER);

	/* Complete location search */
	send_location_search_done();
	expect_location_event(LOCATION_SEARCH_DONE);
	expect_power_event(POWER_BATTERY_PERCENTAGE_SAMPLE_REQUEST);

	/* Close batch to signal send completion */
	send_storage_batch_close();
	expect_storage_event(STORAGE_BATCH_CLOSE);

	send_shadow_response_empty_payload(CLOUD_SHADOW_RESPONSE_DESIRED);
	expect_cloud_event(CLOUD_SHADOW_RESPONSE_DESIRED);
	expect_cloud_event(CLOUD_SHADOW_SET_REPORTED_CONFIG);

	send_shadow_response_empty_payload(CLOUD_SHADOW_RESPONSE_EMPTY_DELTA);
	expect_cloud_event(CLOUD_SHADOW_RESPONSE_EMPTY_DELTA);
	/* EMPTY_DELTA only logs */
	expect_no_events(100);

	send_shadow_response_empty_payload(CLOUD_SHADOW_RESPONSE_EMPTY_DESIRED);
	expect_cloud_event(CLOUD_SHADOW_RESPONSE_EMPTY_DESIRED);
	expect_cloud_event(CLOUD_SHADOW_SET_REPORTED_CONFIG);
}


/* NOTE: This test must remain LAST in the file.
 *
 * On FOTA_REQUEST_REBOOT, the main module clears storage and transitions to
 * STATE_REBOOTING, which is a terminal top-level state with no run handler.
 * Once entered, the SMF cannot be driven back out via zbus events, so any
 * test running after this one would observe a frozen state machine.
 * `sys_reboot()` is faked, so the test process keeps running, but the SMF
 * is intentionally stuck — leave this test at the end.
 */
void test_fota_request_reboot(void)
{
	connect_to_cloud();

	/* Enter STATE_FOTA */
	send_fota_msg(FOTA_STARTING);
	expect_fota_event(FOTA_STARTING);

	/* FOTA module signals completion -> main clears storage and reboots */
	send_fota_msg(FOTA_REQUEST_REBOOT);

	/* Verify that the module sends STORAGE_CLEAR before reboot */
	expect_storage_event(STORAGE_CLEAR);

	/* Give the system time to reboot */
	k_sleep(K_SECONDS(10));

	TEST_ASSERT_EQUAL(1, sys_reboot_fake.call_count);
}


/* This is required to be added to each test. That is because unity's
 * main may return nonzero, while zephyr's main currently must
 * return 0 in all cases (other values are reserved).
 */
extern int unity_main(void);

int main(void)
{
	(void)unity_main();

	k_sleep(K_FOREVER);

	return 0;
}
```

## src/checks.c
```c
/*
 * Copyright (c) 2025 Nordic Semiconductor ASA
 *
 * SPDX-License-Identifier: LicenseRef-Nordic-5-Clause
 */
#include <unity.h>
#include <zephyr/zbus/zbus.h>
#include <zephyr/logging/log.h>

#include "app_common.h"
#include "location.h"
#include "power.h"
#include "network.h"
#include "checks.h"
#include "fota.h"
#include "storage.h"
#include "cloud.h"


ZBUS_CHAN_DECLARE(timer_chan);

ZBUS_MSG_SUBSCRIBER_DEFINE(fota_subscriber);
ZBUS_MSG_SUBSCRIBER_DEFINE(location_subscriber);
ZBUS_MSG_SUBSCRIBER_DEFINE(network_subscriber);
ZBUS_MSG_SUBSCRIBER_DEFINE(power_subscriber);
ZBUS_MSG_SUBSCRIBER_DEFINE(storage_subscriber);
ZBUS_MSG_SUBSCRIBER_DEFINE(cloud_subscriber);
ZBUS_MSG_SUBSCRIBER_DEFINE(timer_subscriber);
ZBUS_CHAN_ADD_OBS(fota_chan, fota_subscriber, 0);
ZBUS_CHAN_ADD_OBS(location_chan, location_subscriber, 0);
ZBUS_CHAN_ADD_OBS(network_chan, network_subscriber, 0);
ZBUS_CHAN_ADD_OBS(power_chan, power_subscriber, 0);
ZBUS_CHAN_ADD_OBS(storage_chan, storage_subscriber, 0);
ZBUS_CHAN_ADD_OBS(cloud_chan, cloud_subscriber, 0);
ZBUS_CHAN_ADD_OBS(timer_chan, timer_subscriber, 0);

LOG_MODULE_REGISTER(main_module_checks, 1);

int priv_expect_location_event(void)
{
	int err;
	const struct zbus_channel *chan;
	struct location_msg location_msg;

	/* Allow the test thread to sleep so that the DUT's thread is allowed to run. */
	k_sleep(K_MSEC(100));

	err = zbus_sub_wait_msg(&location_subscriber, &chan, &location_msg, K_MSEC(10000));
	if (err == -ENOMSG) {
		LOG_ERR("No location event received");
		return -1;
	} else if (err) {
		LOG_ERR("zbus_sub_wait, error: %d", err);
		return -2;
	}

	if (chan != &location_chan) {
		LOG_ERR("Received message from wrong channel, expected %s, got %s",
			zbus_chan_name(&location_chan), zbus_chan_name(chan));
		return -3;
	}

	return location_msg.type;
}

int priv_expect_network_event(void)
{
	int err;
	const struct zbus_channel *chan;
	struct network_msg network_msg;

	/* Allow the test thread to sleep so that the DUT's thread is allowed to run. */
	k_sleep(K_MSEC(100));

	err = zbus_sub_wait_msg(&network_subscriber, &chan, &network_msg, K_MSEC(10000));
	if (err == -ENOMSG) {
		LOG_ERR("No network event received");
		return -1;
	} else if (err) {
		LOG_ERR("zbus_sub_wait, error: %d", err);
		return -2;
	}

	if (chan != &network_chan) {
		LOG_ERR("Received message from wrong channel, expected %s, got %s",
			zbus_chan_name(&network_chan), zbus_chan_name(chan));
		return -3;
	}

	return network_msg.type;
}

int priv_expect_power_event(void)
{
	int err;
	const struct zbus_channel *chan;
	struct power_msg power_msg;

	/* Allow the test thread to sleep so that the DUT's thread is allowed to run. */
	k_sleep(K_MSEC(100));

	err = zbus_sub_wait_msg(&power_subscriber, &chan, &power_msg, K_MSEC(10000));
	if (err == -ENOMSG) {
		LOG_ERR("No power event received");
		return -1;
	} else if (err) {
		LOG_ERR("zbus_sub_wait, error: %d", err);
		return -2;
	}

	if (chan != &power_chan) {
		LOG_ERR("Received message from wrong channel, expected %s, got %s",
			zbus_chan_name(&power_chan), zbus_chan_name(chan));
		return -3;
	}

	return power_msg.type;
}

int priv_expect_fota_event(void)
{
	int err;
	const struct zbus_channel *chan;
	struct fota_msg fota_msg;

	/* Allow the test thread to sleep so that the DUT's thread is allowed to run. */
	k_sleep(K_MSEC(100));

	err = zbus_sub_wait_msg(&fota_subscriber, &chan, &fota_msg, K_MSEC(100000));
	if (err == -ENOMSG) {
		LOG_ERR("No FOTA event received");
		return -1;
	} else if (err) {
		LOG_ERR("zbus_sub_wait, error: %d", err);
		return -2;
	}

	if (chan != &fota_chan) {
		LOG_ERR("Received message from wrong channel, expected %s, got %s",
			zbus_chan_name(&fota_chan), zbus_chan_name(chan));
		return -3;
	}

	return fota_msg.type;
}

int priv_expect_storage_event(void)
{
	int err;
	const struct zbus_channel *chan;
	struct storage_msg storage_msg;

	/* Allow the test thread to sleep so that the DUT's thread is allowed to run. */
	k_sleep(K_MSEC(100));

	err = zbus_sub_wait_msg(&storage_subscriber, &chan, &storage_msg, K_MSEC(10000));
	if (err == -ENOMSG) {
		LOG_ERR("No storage event received");
		return -1;
	} else if (err) {
		LOG_ERR("zbus_sub_wait, error: %d", err);
		return -2;
	}

	if (chan != &storage_chan) {
		LOG_ERR("Received message from wrong channel, expected %s, got %s",
			zbus_chan_name(&storage_chan), zbus_chan_name(chan));
		return -3;
	}

	return storage_msg.type;
}

int priv_expect_cloud_event(void)
{
	int err;
	const struct zbus_channel *chan;
	struct cloud_msg cloud_msg;

	/* Allow the test thread to sleep so that the DUT's thread is allowed to run. */
	k_sleep(K_MSEC(100));

	err = zbus_sub_wait_msg(&cloud_subscriber, &chan, &cloud_msg, K_MSEC(10000));
	if (err == -ENOMSG) {
		LOG_ERR("No cloud event received");
		return -1;
	} else if (err) {
		LOG_ERR("zbus_sub_wait, error: %d", err);
		return -2;
	}

	if (chan != &cloud_chan) {
		LOG_ERR("Received message from wrong channel, expected %s, got %s",
			zbus_chan_name(&cloud_chan), zbus_chan_name(chan));
		return -3;
	}

	return cloud_msg.type;
}

int priv_expect_timer_event(void)
{
	int err;
	const struct zbus_channel *chan;
	struct timer_msg timer_msg;

	/* Allow the test thread to sleep so that the DUT's thread is allowed to run. */
	k_sleep(K_MSEC(100));

	err = zbus_sub_wait_msg(&timer_subscriber, &chan, &timer_msg, K_MSEC(10000));
	if (err == -ENOMSG) {
		LOG_ERR("No timer event received");
		return -1;
	} else if (err) {
		LOG_ERR("zbus_sub_wait, error: %d", err);
		return -2;
	}

	if (chan != &timer_chan) {
		LOG_ERR("Received message from wrong channel, expected %s, got %s",
			zbus_chan_name(&timer_chan), zbus_chan_name(chan));
		return -3;
	}

	return timer_msg.type;
}

static void expect_no_location_events(void)
{
	int err;
	const struct zbus_channel *chan;
	struct location_msg location_msg;

	err = zbus_sub_wait_msg(&location_subscriber, &chan, &location_msg, K_MSEC(10000));
	if (err == -ENOMSG) {
		return;
	} else if (err) {
		LOG_ERR("zbus_sub_wait, error: %d", err);
		TEST_FAIL();

		return;
	}

	LOG_ERR("Received unexpected location event: %d", location_msg.type);
	TEST_FAIL();
}

static void expect_no_network_events(void)
{
	int err;
	const struct zbus_channel *chan;
	struct network_msg network_msg;

	err = zbus_sub_wait_msg(&network_subscriber, &chan, &network_msg, K_MSEC(10000));
	if (err == -ENOMSG) {
		return;
	} else if (err) {
		LOG_ERR("zbus_sub_wait, error: %d", err);
		TEST_FAIL();

		return;
	}

	LOG_ERR("Received unexpected network event: %d", network_msg.type);
	TEST_FAIL();
}

static void expect_no_power_events(void)
{
	int err;
	const struct zbus_channel *chan;
	struct power_msg power_msg;

	err = zbus_sub_wait_msg(&power_subscriber, &chan, &power_msg, K_MSEC(10000));
	if (err == -ENOMSG) {
		return;
	} else if (err) {
		LOG_ERR("zbus_sub_wait, error: %d", err);
		TEST_FAIL();

		return;
	}

	LOG_ERR("Received unexpected power event: %d", power_msg.type);
	TEST_FAIL();
}

static void expect_no_fota_events(void)
{
	int err;
	const struct zbus_channel *chan;
	struct fota_msg fota_msg;

	err = zbus_sub_wait_msg(&fota_subscriber, &chan, &fota_msg, K_MSEC(10000));
	if (err == -ENOMSG) {
		return;
	} else if (err) {
		LOG_ERR("zbus_sub_wait, error: %d", err);
		TEST_FAIL();

		return;
	}

	LOG_ERR("Received unexpected FOTA event: %d", fota_msg.type);
	TEST_FAIL();
}

static void expect_no_storage_events(void)
{
	int err;
	const struct zbus_channel *chan;
	struct storage_msg storage_msg;

	err = zbus_sub_wait_msg(&storage_subscriber, &chan, &storage_msg, K_MSEC(10000));
	if (err == -ENOMSG) {
		return;
	} else if (err) {
		LOG_ERR("zbus_sub_wait, error: %d", err);
		TEST_FAIL();

		return;
	}

	LOG_ERR("Received unexpected storage event: %d", storage_msg.type);
	TEST_FAIL();
}

static void expect_no_cloud_events(void)
{
	int err;
	const struct zbus_channel *chan;
	struct cloud_msg cloud_msg;

	err = zbus_sub_wait_msg(&cloud_subscriber, &chan, &cloud_msg, K_MSEC(10000));
	if (err == -ENOMSG) {
		return;
	} else if (err) {
		LOG_ERR("zbus_sub_wait, error: %d", err);
		TEST_FAIL();

		return;
	}

	LOG_ERR("Received unexpected cloud event: %d", cloud_msg.type);
	TEST_FAIL();
}

static void expect_no_timer_events(void)
{
	int err;
	const struct zbus_channel *chan;
	struct timer_msg timer_msg;

	err = zbus_sub_wait_msg(&timer_subscriber, &chan, &timer_msg, K_MSEC(10000));
	if (err == -ENOMSG) {
		return;
	} else if (err) {
		LOG_ERR("zbus_sub_wait, error: %d", err);
		TEST_FAIL();

		return;
	}

	LOG_ERR("Received unexpected timer event: %d", timer_msg.type);
	TEST_FAIL();
}

void expect_no_events(uint32_t timeout_sec)
{
	k_sleep(K_SECONDS(timeout_sec));

	expect_no_location_events();
	expect_no_network_events();
	expect_no_power_events();
	expect_no_fota_events();
	expect_no_cloud_events();
	expect_no_storage_events();
	expect_no_timer_events();
}

void purge_location_events(void)
{
	while (true) {
		int err;
		const struct zbus_channel *chan;
		struct location_msg location_msg;

		err = zbus_sub_wait_msg(&location_subscriber, &chan, &location_msg, K_NO_WAIT);
		if (err == -ENOMSG) {
			break;
		} else if (err) {
			LOG_ERR("zbus_sub_wait, error: %d", err);
			TEST_FAIL();

			return;
		}
	}
}

void purge_network_events(void)
{
	while (true) {
		int err;
		const struct zbus_channel *chan;
		struct network_msg network_msg;

		err = zbus_sub_wait_msg(&network_subscriber, &chan, &network_msg, K_NO_WAIT);
		if (err == -ENOMSG) {
			break;
		} else if (err) {
			LOG_ERR("zbus_sub_wait, error: %d", err);
			TEST_FAIL();

			return;
		}
	}
}

void purge_power_events(void)
{
	while (true) {
		int err;
		const struct zbus_channel *chan;
		struct power_msg power_msg;

		err = zbus_sub_wait_msg(&power_subscriber, &chan, &power_msg, K_NO_WAIT);
		if (err == -ENOMSG) {
			break;
		} else if (err) {
			LOG_ERR("zbus_sub_wait, error: %d", err);
			TEST_FAIL();

			return;
		}
	}
}

void purge_fota_events(void)
{
	while (true) {
		int err;
		const struct zbus_channel *chan;
		struct fota_msg fota_msg;

		err = zbus_sub_wait_msg(&fota_subscriber, &chan, &fota_msg, K_NO_WAIT);
		if (err == -ENOMSG) {
			break;
		} else if (err) {
			LOG_ERR("zbus_sub_wait, error: %d", err);
			TEST_FAIL();

			return;
		}
	}
}

void purge_storage_events(void)
{
	while (true) {
		int err;
		const struct zbus_channel *chan;
		struct storage_msg storage_msg;

		err = zbus_sub_wait_msg(&storage_subscriber, &chan, &storage_msg, K_NO_WAIT);
		if (err == -ENOMSG) {
			break;
		} else if (err) {
			LOG_ERR("zbus_sub_wait, error: %d", err);
			TEST_FAIL();

			return;
		}
	}
}

void purge_cloud_events(void)
{
	while (true) {
		int err;
		const struct zbus_channel *chan;
		struct cloud_msg cloud_msg;

		err = zbus_sub_wait_msg(&cloud_subscriber, &chan, &cloud_msg, K_NO_WAIT);
		if (err == -ENOMSG) {
			break;
		} else if (err) {
			LOG_ERR("zbus_sub_wait, error: %d", err);
			TEST_FAIL();

			return;
		}
	}
}

void purge_timer_events(void)
{
	while (true) {
		int err;
		const struct zbus_channel *chan;
		struct timer_msg timer_msg;

		err = zbus_sub_wait_msg(&timer_subscriber, &chan, &timer_msg, K_NO_WAIT);
		if (err == -ENOMSG) {
			break;
		} else if (err) {
			LOG_ERR("zbus_sub_wait, error: %d", err);
			TEST_FAIL();

			return;
		}
	}
}

void purge_all_events(void)
{
	purge_location_events();
	purge_network_events();
	purge_power_events();
	purge_fota_events();
	purge_storage_events();
	purge_cloud_events();
	purge_timer_events();
}

int wait_for_location_event(enum location_msg_type expected_type, uint32_t timeout_sec)
{
	int err;
	const struct zbus_channel *chan;
	struct location_msg location_msg;
	uint32_t start_time = k_uptime_seconds();
	uint32_t elapsed_time;

	err = zbus_sub_wait_msg(&location_subscriber, &chan, &location_msg,
				K_SECONDS(timeout_sec));
	if (err == -ENOMSG) {
		return -ENOMSG;
	} else if (err) {
		LOG_ERR("zbus_sub_wait, error: %d", err);

		return err;
	}

	if (chan != &location_chan) {
		LOG_ERR("Received message from wrong channel, expected %s, got %s",
			zbus_chan_name(&location_chan), zbus_chan_name(chan));
		return -EINVAL;
	}

	if (location_msg.type != expected_type) {
		LOG_ERR("Received unexpected location event: %d", location_msg.type);
		return -EINVAL;
	}

	elapsed_time = k_uptime_seconds() - start_time;

	LOG_DBG("Received expected location event: %d, wait: %d", location_msg.type, elapsed_time);

	return elapsed_time;
}

int wait_for_network_gnss_location(struct network_msg *out, uint32_t timeout_sec)
{
	int err;
	const struct zbus_channel *chan;
	struct network_msg network_msg;
	int i;

	/* Allow the test thread to sleep so that the DUT's thread is allowed to run. */
	k_sleep(K_MSEC(100));

	/* Other network messages (e.g. the echoed request) may precede the location, so
	 * skip non-matching messages until the NETWORK_GNSS_LOCATION is found.
	 */
	for (i = 0; i < 10; i++) {
		err = zbus_sub_wait_msg(&network_subscriber, &chan, &network_msg,
					K_SECONDS(timeout_sec));
		if (err == -ENOMSG) {
			return -ENOMSG;
		} else if (err) {
			LOG_ERR("zbus_sub_wait, error: %d", err);
			return err;
		}

		if (chan == &network_chan && network_msg.type == NETWORK_GNSS_LOCATION) {
			*out = network_msg;
			return 0;
		}
	}

	return -ENOMSG;
}

int wait_for_network_event(enum network_msg_type expected_type, uint32_t timeout_sec)
{
	int err;
	const struct zbus_channel *chan;
	struct network_msg network_msg;
	uint32_t start_time = k_uptime_seconds();
	uint32_t elapsed_time;

	err = zbus_sub_wait_msg(&network_subscriber, &chan, &network_msg, K_SECONDS(timeout_sec));
	if (err == -ENOMSG) {
		return -ENOMSG;
	} else if (err) {
		LOG_ERR("zbus_sub_wait, error: %d", err);

		return err;
	}

	if (chan != &network_chan) {
		LOG_ERR("Received message from wrong channel, expected %s, got %s",
			zbus_chan_name(&network_chan), zbus_chan_name(chan));
		return -EINVAL;
	}

	if (network_msg.type != expected_type) {
		LOG_ERR("Received unexpected network event: %d", network_msg.type);
		return -EINVAL;
	}

	elapsed_time = k_uptime_seconds() - start_time;

	LOG_DBG("Received expected network event: %d, wait: %d", network_msg.type, elapsed_time);

	return elapsed_time;
}
```

## src/checks.h
```c
/*
 * Copyright (c) 2025 Nordic Semiconductor ASA
 *
 * SPDX-License-Identifier: LicenseRef-Nordic-5-Clause
 */

#include "location.h"
#include "network.h"
#include "power.h"
#include "fota.h"
#include "storage.h"
#include "cloud.h"

/* Timer message type - must match the types in project/app/src/main.c */
enum timer_msg_type {
	TIMER_EXPIRED_SAMPLE_DATA,
	TIMER_CONFIG_CHANGED,
};

struct timer_msg {
	enum timer_msg_type type;
};

/* Private functions that return the actual received values or negative error codes */
int priv_expect_location_event(void);
int priv_expect_network_event(void);
int priv_expect_power_event(void);
int priv_expect_fota_event(void);
int priv_expect_storage_event(void);
int priv_expect_cloud_event(void);
int priv_expect_timer_event(void);

/* Macros that provide line number information for test failures */
#define expect_location_event(expected) \
	TEST_ASSERT_EQUAL(expected, priv_expect_location_event())

#define expect_network_event(expected) \
	TEST_ASSERT_EQUAL(expected, priv_expect_network_event())

#define expect_power_event(expected) \
	TEST_ASSERT_EQUAL(expected, priv_expect_power_event())

#define expect_fota_event(expected) \
	TEST_ASSERT_EQUAL(expected, priv_expect_fota_event())

#define expect_storage_event(expected) \
	TEST_ASSERT_EQUAL(expected, priv_expect_storage_event())

#define expect_cloud_event(expected) \
	TEST_ASSERT_EQUAL(expected, priv_expect_cloud_event())

#define expect_timer_event(expected) \
	TEST_ASSERT_EQUAL(expected, priv_expect_timer_event())

void expect_no_events(uint32_t timeout_sec);

void purge_location_events(void);

void purge_network_events(void);

void purge_power_events(void);

void purge_storage_events(void);

void purge_cloud_events(void);

void purge_timer_events(void);

void purge_all_events(void);

/* Wait for a location event of the expected type.
 *
 * Returns the time in seconds it took to receive the event if it is received within the timeout.
 * Otherwise, it returns a negative value.
 */
int wait_for_location_event(enum location_msg_type expected_type, uint32_t timeout_sec);

/* Wait for a network event of the expected type.
 *
 * Returns the time in seconds it took to receive the event if it is received within the timeout.
 * Otherwise, it returns a negative value.
 */
int wait_for_network_event(enum network_msg_type expected_type, uint32_t timeout_sec);

/* Wait for a NETWORK_GNSS_LOCATION event and copy its payload into *out.
 *
 * Returns 0 if the event is received within the timeout, a negative value otherwise.
 */
int wait_for_network_gnss_location(struct network_msg *out, uint32_t timeout_sec);
```

## src/redef.h
```c
/*
 * Copyright (c) 2025 Nordic Semiconductor ASA
 *
 * SPDX-License-Identifier: LicenseRef-Nordic-5-Clause
 */

#ifndef REDEF_H
#define REDEF_H

#include <zephyr/kernel.h>

#define SYS_REBOOT_COLD 1

void sys_reboot(int type);

/* Rename app's main to app_main */
#define main app_main

/* Declare app_main so we can use it in the test */
extern int app_main(void);

K_THREAD_DEFINE(app_main_id,
		16384,
		app_main, NULL, NULL, NULL, 0, 0, 0);

#endif
```
