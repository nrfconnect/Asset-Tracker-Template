## CMakeLists.txt
```
#
# Copyright (c) 2024 Nordic Semiconductor ASA
#
# SPDX-License-Identifier: LicenseRef-Nordic-5-Clause
#

cmake_minimum_required(VERSION 3.20.0)

find_package(Zephyr REQUIRED HINTS $ENV{ZEPHYR_BASE})
project(battery_module_test)

test_runner_generate(src/main.c)

set(ASSET_TRACKER_TEMPLATE_DIR ../../..)

target_sources(app
  PRIVATE
  src/main.c
  src/redef.c
  ${ASSET_TRACKER_TEMPLATE_DIR}/app/src/modules/battery/battery.c
  ${ASSET_TRACKER_TEMPLATE_DIR}/app/src/common/message_channel.c
)

target_include_directories(app PRIVATE src)

zephyr_include_directories(${ZEPHYR_BASE}/include/zephyr/)
zephyr_include_directories(${ZEPHYR_NRFXLIB_MODULE_DIR}/nrf_fuel_gauge/include/)
zephyr_include_directories(${ZEPHYR_BASE}/subsys/testsuite/include)
zephyr_include_directories(${ASSET_TRACKER_TEMPLATE_DIR}/app/src/common)
zephyr_include_directories(${ASSET_TRACKER_TEMPLATE_DIR}/app/src/modules/cloud)
zephyr_include_directories(${ASSET_TRACKER_TEMPLATE_DIR}/app/src/modules/battery)

# Options that cannot be passed through Kconfig fragments
target_compile_definitions(app PRIVATE
	-DCONFIG_APP_BATTERY_LOG_LEVEL=4
	-DCONFIG_APP_BATTERY_THREAD_STACK_SIZE=4096
	-DCONFIG_APP_PAYLOAD_CHANNEL_BUFFER_MAX_SIZE=100
  -DCONFIG_APP_BATTERY_MSG_PROCESSING_TIMEOUT_SECONDS=3
  -DCONFIG_APP_BATTERY_WATCHDOG_TIMEOUT_SECONDS=120
)

set_property(SOURCE ${ASSET_TRACKER_TEMPLATE_DIR}/app/src/modules/battery/battery.c PROPERTY COMPILE_FLAGS
             "-include ${CMAKE_CURRENT_SOURCE_DIR}/src/redef.h")
```

## prj.conf
```kconfig
#
# Copyright (c) 2024 Nordic Semiconductor ASA
#
# SPDX-License-Identifier: LicenseRef-Nordic-5-Clause
#

CONFIG_UNITY=y
CONFIG_ZBUS=y
CONFIG_LOG=y
CONFIG_ZBUS_OBSERVER_NAME=y
CONFIG_ZBUS_CHANNEL_NAME=y
CONFIG_ZBUS_MSG_SUBSCRIBER=y
CONFIG_ZBUS_RUNTIME_OBSERVERS=y
CONFIG_CBPRINTF_FP_SUPPORT=y
CONFIG_HEAP_MEM_POOL_SIZE=40000
CONFIG_ZBUS_MSG_SUBSCRIBER_NET_BUF_POOL_SIZE=100

CONFIG_SMF=y
CONFIG_SMF_ANCESTOR_SUPPORT=y
CONFIG_SMF_INITIAL_TRANSITION=y
CONFIG_NATIVE_SIM_SLOWDOWN_TO_REAL_TIME=n
```

## src/main.c
```c
/*
 * Copyright (c) 2024 Nordic Semiconductor ASA
 *
 * SPDX-License-Identifier: LicenseRef-Nordic-5-Clause
 */
#include <unity.h>

#include <zephyr/fff.h>
#include <zephyr/zbus/zbus.h>
#include <zephyr/task_wdt/task_wdt.h>
#include <zephyr/logging/log.h>
#include "message_channel.h"
#include "battery.h"

DEFINE_FFF_GLOBALS;

FAKE_VALUE_FUNC(int, task_wdt_feed, int);
FAKE_VALUE_FUNC(int, task_wdt_add, uint32_t, task_wdt_callback_t, void *);
FAKE_VALUE_FUNC(float, nrf_fuel_gauge_process, float, float, float, float, bool, void *);
FAKE_VALUE_FUNC(int, charger_read_sensors, float *, float *, float *, int32_t *);
FAKE_VALUE_FUNC(int, nrf_fuel_gauge_init, const struct nrf_fuel_gauge_init_parameters *, void *);

ZBUS_MSG_SUBSCRIBER_DEFINE(battery_subscriber);
ZBUS_CHAN_ADD_OBS(BATTERY_CHAN, battery_subscriber, 0);

LOG_MODULE_REGISTER(battery_module_test, 4);

void check_battery_event(enum battery_msg_type expected_battery_type)
{
	int err;
	const struct zbus_channel *chan;
	struct battery_msg battery_msg;

	/* Allow the test thread to sleep so that the DUT's thread is allowed to run. */
	k_sleep(K_MSEC(100));

	err = zbus_sub_wait_msg(&battery_subscriber, &chan, &battery_msg, K_MSEC(1000));
	if (err == -ENOMSG) {
		LOG_ERR("No battery event received");
		TEST_FAIL();
	} else if (err) {
		LOG_ERR("zbus_sub_wait, error: %d", err);
		SEND_FATAL_ERROR();

		return;
	}

	if (chan != &BATTERY_CHAN) {
		LOG_ERR("Received message from wrong channel");
		TEST_FAIL();
	}

	TEST_ASSERT_EQUAL(expected_battery_type, battery_msg.type);
}

void check_no_battery_events(uint32_t time_in_seconds)
{
	int err;
	const struct zbus_channel *chan;
	struct battery_msg battery_msg;

	/* Allow the test thread to sleep so that the DUT's thread is allowed to run. */
	k_sleep(K_SECONDS(time_in_seconds));

	err = zbus_sub_wait_msg(&battery_subscriber, &chan, &battery_msg, K_MSEC(1000));
	if (err == 0) {
		LOG_ERR("Received trigger event with type %d", battery_msg.type);
		TEST_FAIL();
	}
}

static void send_battery_percentage_sample_request(void)
{
	struct battery_msg msg = {
		.type = BATTERY_PERCENTAGE_SAMPLE_REQUEST,
	};

	int err = zbus_chan_pub(&BATTERY_CHAN, &msg, K_SECONDS(1));

	TEST_ASSERT_EQUAL(0, err);
}

void test_battery_percentage_sample(void)
{
	for (int i = 0; i < 10; i++) {
		/* Given */
		send_battery_percentage_sample_request();

		/* When */
		k_sleep(K_SECONDS(1));

		/* Then */
		check_battery_event(BATTERY_PERCENTAGE_SAMPLE_REQUEST);
		check_battery_event(BATTERY_PERCENTAGE_SAMPLE_RESPONSE);
		check_no_battery_events(3600);
	}
}

/* This is required to be added to each test. That is because unity's
 * main may return nonzero, while zephyr's main currently must
 * return 0 in all cases (other values are reserved).
 */
extern int unity_main(void);

int main(void)
{
	(void)unity_main();

	k_sleep(K_FOREVER);

	return 0;
}
```

## src/redef.c
```c
/*
 * Copyright (c) 2025 Nordic Semiconductor ASA
 *
 * SPDX-License-Identifier: LicenseRef-Nordic-5-Clause
 */

#include <zephyr/device.h>
#include <zephyr/drivers/sensor.h>

static int sample_fetch(const struct device *dev, enum sensor_channel chan)
{
	ARG_UNUSED(dev);
	ARG_UNUSED(chan);

	return 0;
}

static int channel_get(const struct device *dev, enum sensor_channel chan,
		      struct sensor_value *val)
{
	ARG_UNUSED(dev);
	ARG_UNUSED(chan);
	ARG_UNUSED(val);

	return 0;
}

static const struct sensor_driver_api dummy_api = {
	.sample_fetch = &sample_fetch,
	.channel_get = &channel_get,
};

struct device_state state = {
	.initialized = true,
	.init_res = 0U,
};

struct device mock_charger_device = {
	.name = "mock_npm1300_charger",
	.state = &state,
	.api = &dummy_api
};
```

## src/redef.h
```c
/*
 * Copyright (c) 2025 Nordic Semiconductor ASA
 *
 * SPDX-License-Identifier: LicenseRef-Nordic-5-Clause
 */

#ifndef REDEF_H_
#define REDEF_H_

#include <zephyr/device.h>

extern struct device mock_charger_device;

#undef DEVICE_DT_GET
#define DEVICE_DT_GET(node_id) &mock_charger_device

#endif /* REDEF_ */
```
