## CMakeLists.txt
```
#
# Copyright (c) 2024 Nordic Semiconductor ASA
#
# SPDX-License-Identifier: LicenseRef-Nordic-5-Clause
#

cmake_minimum_required(VERSION 3.20.0)

find_package(Zephyr REQUIRED HINTS $ENV{ZEPHYR_BASE})
project(environmental_module_test)

test_runner_generate(src/button_module_test.c)

target_sources(app
  PRIVATE
  src/button_module_test.c
  ../../../app/src/modules/button/button.c
)

zephyr_include_directories(${ZEPHYR_BASE}/include/zephyr/)
zephyr_include_directories(${ZEPHYR_BASE}/subsys/testsuite/include)
zephyr_include_directories(../../../app/src/common)
zephyr_include_directories(../../../app/src/modules/cloud)
zephyr_include_directories(../../../app/src/modules/button)

target_link_options(app PRIVATE --whole-archive)
# Options that cannot be passed through Kconfig fragments
target_compile_definitions(app PRIVATE
	-DCONFIG_APP_CLOUD_PAYLOAD_BUFFER_MAX_SIZE=100
  -DCONFIG_APP_BUTTON_LOG_LEVEL=0
  -DCONFIG_APP_BUTTON_LONG_PRESS_TIMEOUT_MS=3000
)
```

## prj.conf
```kconfig
#
# Copyright (c) 2024 Nordic Semiconductor ASA
#
# SPDX-License-Identifier: LicenseRef-Nordic-5-Clause
#

CONFIG_UNITY=y
CONFIG_ZBUS=y
CONFIG_LOG=y
CONFIG_SENSOR=y
CONFIG_ZBUS_OBSERVER_NAME=y
CONFIG_ZBUS_CHANNEL_NAME=y
CONFIG_ZBUS_MSG_SUBSCRIBER=y
CONFIG_ZBUS_RUNTIME_OBSERVERS=y
CONFIG_CBPRINTF_FP_SUPPORT=y
CONFIG_SENSOR_LOG_LEVEL_DBG=y
CONFIG_HEAP_MEM_POOL_SIZE=40000

CONFIG_SMF=y
CONFIG_SMF_ANCESTOR_SUPPORT=y
CONFIG_SMF_INITIAL_TRANSITION=y

CONFIG_NATIVE_SIM_SLOWDOWN_TO_REAL_TIME=n

# sys_rand32_get() used by test_random_presses
CONFIG_ENTROPY_GENERATOR=y
```

## src/main.c
```c
/*
 * Copyright (c) 2024 Nordic Semiconductor ASA
 *
 * SPDX-License-Identifier: LicenseRef-Nordic-5-Clause
 */
#include <unity.h>
#include <zephyr/fff.h>
#include <zephyr/zbus/zbus.h>
#include <zephyr/logging/log.h>
#include <dk_buttons_and_leds.h>
#include <date_time.h>

#include "app_common.h"
#include "button.h"

DEFINE_FFF_GLOBALS;

LOG_MODULE_REGISTER(button_module_test, 4);

ZBUS_MSG_SUBSCRIBER_DEFINE(button_subscriber);
ZBUS_CHAN_ADD_OBS(BUTTON_CHAN, button_subscriber, 0);

#define FAKE_TIME_MS 1716552398505

int date_time_now(int64_t *time)
{
	*time = FAKE_TIME_MS;
	return 0;
}

static button_handler_t button_handler = NULL;

int dk_buttons_init(button_handler_t _button_handler)
{
	button_handler = _button_handler;
	return 0;
}

void tearDown(void)
{
	const struct zbus_channel *chan;
	uint8_t button_number;
	int err;

	err = zbus_sub_wait_msg(&button_subscriber, &chan, &button_number, K_MSEC(1000));
	if (err == 0) {
		LOG_ERR("Unhandled message in payload channel");
		TEST_FAIL();
	}
}

void test_button_trigger(void)
{
	const struct zbus_channel *chan;
	uint8_t button_number;
	int err;

	TEST_ASSERT_NOT_NULL(button_handler);
	button_handler(DK_BTN1_MSK, DK_BTN1_MSK);

	err = zbus_sub_wait_msg(&button_subscriber, &chan, &button_number, K_MSEC(1000));
	if (err == -ENOMSG) {
		LOG_ERR("No BUTTON_CHAN message received");
		TEST_FAIL();
	} else if (err) {
		LOG_ERR("zbus_sub_wait, error: %d", err);
		SEND_FATAL_ERROR();

		return;
	}

	/* check if chan is button channel */
	if (chan != &BUTTON_CHAN) {
		LOG_ERR("Received message from wrong channel");
		TEST_FAIL();
	}
}

/* This is required to be added to each test. That is because unity's
 * main may return nonzero, while zephyr's main currently must
 * return 0 in all cases (other values are reserved).
 */
extern int unity_main(void);

int main(void)
{
	/* use the runner from test_runner_generate() */
	(void)unity_main();

	return 0;
}
```

## src/button_module_test.c
```c
/*
 * Copyright (c) 2024 Nordic Semiconductor ASA
 *
 * SPDX-License-Identifier: LicenseRef-Nordic-5-Clause
 */
#include <unity.h>
#include <zephyr/fff.h>
#include <zephyr/zbus/zbus.h>
#include <zephyr/logging/log.h>
#include <zephyr/random/random.h>
#include <dk_buttons_and_leds.h>
#include <date_time.h>

#include "app_common.h"
#include "button.h"

DEFINE_FFF_GLOBALS;

LOG_MODULE_REGISTER(button_module_test, 4);

ZBUS_MSG_SUBSCRIBER_DEFINE(button_subscriber);
ZBUS_CHAN_ADD_OBS(button_chan, button_subscriber, 0);

#define FAKE_TIME_MS 1716552398505

int date_time_now(int64_t *time)
{
	*time = FAKE_TIME_MS;
	return 0;
}

static button_handler_t button_handler;

int dk_buttons_init(button_handler_t _button_handler)
{
	button_handler = _button_handler;
	return 0;
}

void tearDown(void)
{
	const struct zbus_channel *chan;
	struct button_msg msg;
	int err;

	err = zbus_sub_wait_msg(&button_subscriber, &chan, &msg, K_MSEC(1000));
	if (err == 0) {
		LOG_ERR("Unhandled message in payload channel");
		TEST_FAIL();
	}
}

void test_button_short_press(void)
{
	const struct zbus_channel *chan;
	struct button_msg msg;
	int err;

	TEST_ASSERT_NOT_NULL(button_handler);
	/* Simulate button press and release to trigger short press */
	button_handler(DK_BTN1_MSK, DK_BTN1_MSK);  /* Press */
	k_msleep(100);  /* Short delay */
	button_handler(0, DK_BTN1_MSK);  /* Release */

	err = zbus_sub_wait_msg(&button_subscriber, &chan, &msg, K_MSEC(1000));
	TEST_ASSERT_EQUAL(0, err);

	/* check if chan is button channel */
	if (chan != &button_chan) {
		LOG_ERR("Received message from wrong channel");
		TEST_FAIL();
	}

	/* Verify message content */
	TEST_ASSERT_EQUAL(1, msg.button_number);
	TEST_ASSERT_EQUAL(BUTTON_PRESS_SHORT, msg.type);
}

void test_button_long_press(void)
{
	const struct zbus_channel *chan;
	struct button_msg msg;
	int err;

	TEST_ASSERT_NOT_NULL(button_handler);
	/* Simulate button press and release to trigger long press */
	button_handler(DK_BTN1_MSK, DK_BTN1_MSK);  /* Press */
	k_msleep(CONFIG_APP_BUTTON_LONG_PRESS_TIMEOUT_MS + 500);  /* Long press */
	button_handler(0, DK_BTN1_MSK);  /* Release */

	err = zbus_sub_wait_msg(&button_subscriber, &chan, &msg, K_MSEC(1000));
	TEST_ASSERT_EQUAL(0, err);

	/* check if chan is button channel */
	if (chan != &button_chan) {
		LOG_ERR("Received message from wrong channel");
		TEST_FAIL();
	}

	/* Verify message content */
	TEST_ASSERT_EQUAL(1, msg.button_number);
	TEST_ASSERT_EQUAL(BUTTON_PRESS_LONG, msg.type);
}

void test_repeat_short_and_long_press(void)
{
	const struct zbus_channel *chan;
	struct button_msg msg;
	int err;

	TEST_ASSERT_NOT_NULL(button_handler);

	for (int i = 0; i < 30; i++) {
		/* Simulate button press and release to trigger short press */
		button_handler(DK_BTN1_MSK, DK_BTN1_MSK);  /* Press */
		k_msleep(CONFIG_APP_BUTTON_LONG_PRESS_TIMEOUT_MS - 100);  /* Almost long press */
		button_handler(0, DK_BTN1_MSK);  /* Release */

		err = zbus_sub_wait_msg(&button_subscriber, &chan, &msg, K_MSEC(1000));
		TEST_ASSERT_EQUAL(0, err);

		/* Verify message content */
		TEST_ASSERT_EQUAL(1, msg.button_number);
		TEST_ASSERT_EQUAL(BUTTON_PRESS_SHORT, msg.type);

		button_handler(DK_BTN1_MSK, DK_BTN1_MSK);  /* Press */
		k_msleep(CONFIG_APP_BUTTON_LONG_PRESS_TIMEOUT_MS + 500);  /* Long press */
		button_handler(0, DK_BTN1_MSK);  /* Release */

		err = zbus_sub_wait_msg(&button_subscriber, &chan, &msg, K_MSEC(1000));
		TEST_ASSERT_EQUAL(0, err);

		/* Verify message content */
		TEST_ASSERT_EQUAL(1, msg.button_number);
		TEST_ASSERT_EQUAL(BUTTON_PRESS_LONG, msg.type);
	}
}

void test_random_presses(void)
{
	const struct zbus_channel *chan;
	struct button_msg msg;
	int err;
	const int num_presses = 25;
	const uint32_t min_delay = 50;
	const uint32_t max_delay = 5000;
	const uint32_t long_press_threshold = CONFIG_APP_BUTTON_LONG_PRESS_TIMEOUT_MS;

	TEST_ASSERT_NOT_NULL(button_handler);

	for (int i = 0; i < num_presses; i++) {
		/* Generate random delay between min_delay and max_delay */
		uint32_t random_delay = min_delay + (sys_rand32_get() %
						     (max_delay - min_delay + 1));

		/* Determine expected message type based on delay */
		enum button_msg_type expected_type = (random_delay >= long_press_threshold)
						     ? BUTTON_PRESS_LONG
						     : BUTTON_PRESS_SHORT;

		/* Simulate button press */
		button_handler(DK_BTN1_MSK, DK_BTN1_MSK);  /* Press */
		k_msleep(random_delay);  /* Hold for random duration */
		button_handler(0, DK_BTN1_MSK);  /* Release */

		err = zbus_sub_wait_msg(&button_subscriber, &chan, &msg, K_MSEC(1000));
		TEST_ASSERT_EQUAL(0, err);

		/* Check if chan is button channel */
		if (chan != &button_chan) {
			LOG_ERR("Received message from wrong channel for press %d", i + 1);
			TEST_FAIL();
		}

		/* Verify message content */
		TEST_ASSERT_EQUAL(1, msg.button_number);
		TEST_ASSERT_EQUAL(expected_type, msg.type);
	}
}

/* This is required to be added to each test. That is because unity's
 * main may return nonzero, while zephyr's main currently must
 * return 0 in all cases (other values are reserved).
 */
extern int unity_main(void);

int main(void)
{
	/* use the runner from test_runner_generate() */
	(void)unity_main();

	return 0;
}
```
