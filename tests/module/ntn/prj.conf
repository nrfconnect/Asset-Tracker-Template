## CMakeLists.txt
```
#
# Copyright (c) 2026 Nordic Semiconductor ASA
#
# SPDX-License-Identifier: LicenseRef-Nordic-5-Clause
#

cmake_minimum_required(VERSION 3.20.0)

find_package(Zephyr REQUIRED HINTS $ENV{ZEPHYR_BASE})
project(sgp4_pass_test)

test_runner_generate(src/sgp4_pass_test.c)

target_sources(app
  PRIVATE
  src/sgp4_pass_test.c
)

zephyr_include_directories(${ZEPHYR_BASE}/include/zephyr/)
zephyr_include_directories(${ZEPHYR_BASE}/subsys/testsuite/include)
zephyr_include_directories(../../../app/src/common)
zephyr_include_directories(../../../lib/sgp4)

target_link_options(app PRIVATE --whole-archive)
```

## prj.conf
```kconfig
#
# Copyright (c) 2026 Nordic Semiconductor ASA
#
# SPDX-License-Identifier: LicenseRef-Nordic-5-Clause
#

CONFIG_UNITY=y
CONFIG_LOG=y
CONFIG_CBPRINTF_FP_SUPPORT=y
CONFIG_HEAP_MEM_POOL_SIZE=80000
CONFIG_MAIN_STACK_SIZE=16384
CONFIG_NATIVE_SIM_SLOWDOWN_TO_REAL_TIME=n
```

## src/sgp4_pass_test.c
```c
/*
 * Copyright (c) 2026 Nordic Semiconductor ASA
 *
 * SPDX-License-Identifier: LicenseRef-Nordic-5-Clause
 */

#include <unity.h>
#include <zephyr/fff.h>
#include <zephyr/zbus/zbus.h>
#include <zephyr/logging/log.h>
#include <zephyr/random/random.h>
#include <stdint.h>
#include <stdlib.h>
#include <date_time.h>
#include <time.h>
#include "sgp4_pass_predict.h"

/* missing headers */
struct tm *gmtime_r(const int64_t *timep, struct tm *result);
char *strtok_r(char *str, const char *delim, char **saveptr);


DEFINE_FFF_GLOBALS;

static struct sat_data sat_data_tle;

/* Mon Mar 02 2026 08:50:24 */
#define FAKE_TIME_MS 1772441424123LL
int date_time_now(int64_t *time)
{
	*time = FAKE_TIME_MS;
	return 0;
}

static void debug_print_next_pass(struct sat_data *data)
{
	struct tm start_tm, end_tm, max_elevation_tm;
	int64_t start_time = data->next_pass.start_time_ms / 1000;
	int64_t end_time = data->next_pass.end_time_ms / 1000;
	int64_t max_elevation_time = data->next_pass.max_elevation_time_ms / 1000;

	gmtime_r(&start_time, &start_tm);
	gmtime_r(&end_time, &end_tm);
	gmtime_r(&max_elevation_time, &max_elevation_tm);

	LOG_DBG("data->next_pass.start_time: %s", asctime(&start_tm));
	LOG_DBG("data->next_pass.end_time: %s", asctime(&end_tm));
	LOG_DBG("data->next_pass.max_elevation_time: %s", asctime(&max_elevation_tm));
}

void test_jd_from_unix_time_ms(void)
{
	double jd, jdfract, jdcombined;

	jd_from_unix_time_ms(FAKE_TIME_MS, &jd, &jdfract);
	jdcombined = jd + jdfract;
	TEST_ASSERT_EQUAL(FAKE_TIME_MS, (int64_t)((jdcombined - 2440587.5) * 86400000LL));
}

void test_nextpass_tle_data(void)
{
	/* Epoch time: Thu Feb 12 2026 13:32:09 GMT+0000 */
	char line1[] = "1 99999U 25356A   26026.11000000  .00002000  00000-0  10000-3 0  0001";
	char line2[] = "2 99999   0.0000 000.0000 0005000 180.0000 180.0000 15.09000000 00007";
	static struct sat_data *data = &sat_data_tle;
	int err;

	err = sat_data_init_tle(data, line1, line2);
	TEST_ASSERT_EQUAL(0, err);

	err = sat_data_calculate_next_pass(data, 0, 0.0, 0.0, 0.0, FAKE_TIME_MS);
	TEST_ASSERT_EQUAL(0, err);

	int64_t start_time = data->next_pass.start_time_ms / 1000;
	int64_t end_time = data->next_pass.end_time_ms / 1000;
	int64_t max_elevation_time = data->next_pass.max_elevation_time_ms / 1000;
	struct tm start_tm, end_tm, max_elevation_tm;

	gmtime_r(&start_time, &start_tm);
	gmtime_r(&end_time, &end_tm);
	gmtime_r(&max_elevation_time, &max_elevation_tm);
	LOG_DBG("data->next_pass.start_time: %s", asctime(&start_tm));
	LOG_DBG("data->next_pass.end_time: %s", asctime(&end_tm));
	LOG_DBG("data->next_pass.max_elevation_time: %s", asctime(&max_elevation_tm));
	TEST_ASSERT_EQUAL(0, err);
}


void test_parse_at_sibconfig(void)
{
	struct sat_data satellite;
	const char *atsib32 = "SIBCONFIG: 32,\"01A2D101\",1,0,0,2097151,0,2097151,8388,2592442259,"
		"10000,-3,595296,5,,,,,";
	TEST_ASSERT_EQUAL(0, sat_data_init_atsib32(&satellite, atsib32));
	TEST_ASSERT_EQUAL(0, sat_data_set_name(&satellite, "01A2D101"));
	TEST_ASSERT_EQUAL(0,
		sat_data_calculate_next_pass(&satellite, 0, 0.0, 0.0, 0.0, FAKE_TIME_MS));
	debug_print_next_pass(&satellite);
}

void test_parse_at_sibconfig_full(void)
{
	struct sat_data satellite;
	const char *atsib32 = "SIBCONFIG: 32,\"01A2D101\",1,0,0,2097151,0,2097151,8388,2592442259,"
		"10000,-3,595296,5,10,20,30,40,50";
	TEST_ASSERT_EQUAL(0, sat_data_init_atsib32(&satellite, atsib32));
	TEST_ASSERT_EQUAL(0, sat_data_set_name(&satellite, "01A2D101"));
	TEST_ASSERT_EQUAL(0,
		sat_data_calculate_next_pass(&satellite, 0, 0.0, 0.0, 0.0, FAKE_TIME_MS));
	debug_print_next_pass(&satellite);
}

void test_atsib_parser_single_sib(void)
{
	struct sat_data_sib32 *sib32;
	char cell_id[9];
	const char *atsib32 = "SIBCONFIG: 32,\"01A2D101\",1,909,13,14,15,16,17,18,5000000000,"
		"-5,99,100,10,20,30,40,50";
	int sibcount = parse_sibconfig32_at(atsib32, cell_id, NULL);

	TEST_ASSERT_EQUAL(1, sibcount);
	TEST_ASSERT_EQUAL(0, strncmp(cell_id, "01A2D101", 8));
	sib32 = malloc(sizeof(struct sat_data_sib32) * sibcount);
	sibcount = parse_sibconfig32_at(atsib32, cell_id, sib32);
	TEST_ASSERT_EQUAL(1, sibcount);
	TEST_ASSERT_EQUAL(909, sib32[0].satelliteId);
	TEST_ASSERT_EQUAL(13, sib32[0].inclination);
	TEST_ASSERT_EQUAL(14, sib32[0].argumentPerigee);
	TEST_ASSERT_EQUAL(15, sib32[0].rightAscension);
	TEST_ASSERT_EQUAL(16, sib32[0].meanAnomaly);
	TEST_ASSERT_EQUAL(17, sib32[0].eccentricity);
	TEST_ASSERT_EQUAL(18, sib32[0].meanMotion);
	TEST_ASSERT_EQUAL(5000000000, sib32[0].bStarDecimal);
	TEST_ASSERT_EQUAL(-5, sib32[0].bStarExponent);
	TEST_ASSERT_EQUAL(99, sib32[0].epochStar);
	TEST_ASSERT_EQUAL(100, sib32[0].serviceStart);
	TEST_ASSERT_EQUAL(10, sib32[0].elevationAngleLeft);
	TEST_ASSERT_EQUAL(20, sib32[0].elevationAngleRight);
	TEST_ASSERT_EQUAL(30, sib32[0].referencePointLongitude);
	TEST_ASSERT_EQUAL(40, sib32[0].referencePointLatitude);
	TEST_ASSERT_EQUAL(50, sib32[0].radius);
	free(sib32);
}

void test_atsib_parser_single_sib_empty_end(void)
{
	struct sat_data_sib32 *sib32;
	char cell_id[9];
	const char *atsib32 = "SIBCONFIG: 32,\"01A2D101\",1,909,13,14,15,16,17,18,5000000000,"
		"-5,99,100,,,30,40,,";
	int sibcount = parse_sibconfig32_at(atsib32, cell_id, NULL);

	TEST_ASSERT_EQUAL(1, sibcount);
	TEST_ASSERT_EQUAL(0, strncmp(cell_id, "01A2D101", 8));
	sib32 = malloc(sizeof(struct sat_data_sib32) * sibcount);
	sibcount = parse_sibconfig32_at(atsib32, cell_id, sib32);
	TEST_ASSERT_EQUAL(1, sibcount);
	TEST_ASSERT_EQUAL(909, sib32[0].satelliteId);
	TEST_ASSERT_EQUAL(13, sib32[0].inclination);
	TEST_ASSERT_EQUAL(14, sib32[0].argumentPerigee);
	TEST_ASSERT_EQUAL(15, sib32[0].rightAscension);
	TEST_ASSERT_EQUAL(16, sib32[0].meanAnomaly);
	TEST_ASSERT_EQUAL(17, sib32[0].eccentricity);
	TEST_ASSERT_EQUAL(18, sib32[0].meanMotion);
	TEST_ASSERT_EQUAL(5000000000, sib32[0].bStarDecimal);
	TEST_ASSERT_EQUAL(-5, sib32[0].bStarExponent);
	TEST_ASSERT_EQUAL(99, sib32[0].epochStar);
	TEST_ASSERT_EQUAL(100, sib32[0].serviceStart);
	TEST_ASSERT_EQUAL(-INT64_MAX, sib32[0].elevationAngleLeft);
	TEST_ASSERT_EQUAL(-INT64_MAX, sib32[0].elevationAngleRight);
	TEST_ASSERT_EQUAL(30, sib32[0].referencePointLongitude);
	TEST_ASSERT_EQUAL(40, sib32[0].referencePointLatitude);
	TEST_ASSERT_EQUAL(-INT64_MAX, sib32[0].radius);
	free(sib32);
}

void test_atsib_parser_multiple_sibs(void)
{
	struct sat_data_sib32 *sib32;
	char cell_id[9];
	const char *atsib32 = "SIBCONFIG: 32,\"01A2D101\",2,909,13,14,15,16,17,18,5000000000,"
		"-5,99,100,10,20,30,40,50,808,13,14,15,16,17,18,5000000000,"
		"-5,99,100,10,20,30,40,50";
	int sibcount = parse_sibconfig32_at(atsib32, cell_id, NULL);

	TEST_ASSERT_EQUAL(2, sibcount);
	TEST_ASSERT_EQUAL(0, strncmp(cell_id, "01A2D101", 8));
	sib32 = malloc(sizeof(struct sat_data_sib32) * sibcount);
	sibcount = parse_sibconfig32_at(atsib32, cell_id, sib32);
	TEST_ASSERT_EQUAL(2, sibcount);

	TEST_ASSERT_EQUAL(909, sib32[0].satelliteId);
	TEST_ASSERT_EQUAL(13, sib32[0].inclination);
	TEST_ASSERT_EQUAL(14, sib32[0].argumentPerigee);
	TEST_ASSERT_EQUAL(15, sib32[0].rightAscension);
	TEST_ASSERT_EQUAL(16, sib32[0].meanAnomaly);
	TEST_ASSERT_EQUAL(17, sib32[0].eccentricity);
	TEST_ASSERT_EQUAL(18, sib32[0].meanMotion);
	TEST_ASSERT_EQUAL(5000000000, sib32[0].bStarDecimal);
	TEST_ASSERT_EQUAL(-5, sib32[0].bStarExponent);
	TEST_ASSERT_EQUAL(99, sib32[0].epochStar);
	TEST_ASSERT_EQUAL(100, sib32[0].serviceStart);
	TEST_ASSERT_EQUAL(10, sib32[0].elevationAngleLeft);
	TEST_ASSERT_EQUAL(20, sib32[0].elevationAngleRight);
	TEST_ASSERT_EQUAL(30, sib32[0].referencePointLongitude);
	TEST_ASSERT_EQUAL(40, sib32[0].referencePointLatitude);
	TEST_ASSERT_EQUAL(50, sib32[0].radius);

	TEST_ASSERT_EQUAL(808, sib32[1].satelliteId);
	TEST_ASSERT_EQUAL(13, sib32[1].inclination);
	TEST_ASSERT_EQUAL(14, sib32[1].argumentPerigee);
	TEST_ASSERT_EQUAL(15, sib32[1].rightAscension);
	TEST_ASSERT_EQUAL(16, sib32[1].meanAnomaly);
	TEST_ASSERT_EQUAL(17, sib32[1].eccentricity);
	TEST_ASSERT_EQUAL(18, sib32[1].meanMotion);
	TEST_ASSERT_EQUAL(5000000000, sib32[1].bStarDecimal);
	TEST_ASSERT_EQUAL(-5, sib32[1].bStarExponent);
	TEST_ASSERT_EQUAL(99, sib32[1].epochStar);
	TEST_ASSERT_EQUAL(100, sib32[1].serviceStart);
	TEST_ASSERT_EQUAL(10, sib32[1].elevationAngleLeft);
	TEST_ASSERT_EQUAL(20, sib32[1].elevationAngleRight);
	TEST_ASSERT_EQUAL(30, sib32[1].referencePointLongitude);
	TEST_ASSERT_EQUAL(40, sib32[1].referencePointLatitude);
	TEST_ASSERT_EQUAL(50, sib32[1].radius);
	free(sib32);
}

void test_atsib_parser_multiple_sibs_empty_end(void)
{
	struct sat_data_sib32 *sib32;
	char cell_id[9];
	const char *atsib32 = "SIBCONFIG: 32,\"01A2D101\",2,909,13,14,15,16,17,18,5000000000,"
		"-5,99,100,10,20,30,,,808,13,14,15,16,17,18,3000000000,-5,99,100,10,20,30,40,";
	int sibcount = parse_sibconfig32_at(atsib32, cell_id, NULL);

	TEST_ASSERT_EQUAL(2, sibcount);
	TEST_ASSERT_EQUAL(0, strncmp(cell_id, "01A2D101", 8));
	sib32 = malloc(sizeof(struct sat_data_sib32) * sibcount);
	sibcount = parse_sibconfig32_at(atsib32, cell_id, sib32);
	TEST_ASSERT_EQUAL(2, sibcount);

	TEST_ASSERT_EQUAL(909, sib32[0].satelliteId);
	TEST_ASSERT_EQUAL(13, sib32[0].inclination);
	TEST_ASSERT_EQUAL(14, sib32[0].argumentPerigee);
	TEST_ASSERT_EQUAL(15, sib32[0].rightAscension);
	TEST_ASSERT_EQUAL(16, sib32[0].meanAnomaly);
	TEST_ASSERT_EQUAL(17, sib32[0].eccentricity);
	TEST_ASSERT_EQUAL(18, sib32[0].meanMotion);
	TEST_ASSERT_EQUAL(5000000000, sib32[0].bStarDecimal);
	TEST_ASSERT_EQUAL(-5, sib32[0].bStarExponent);
	TEST_ASSERT_EQUAL(99, sib32[0].epochStar);
	TEST_ASSERT_EQUAL(100, sib32[0].serviceStart);
	TEST_ASSERT_EQUAL(10, sib32[0].elevationAngleLeft);
	TEST_ASSERT_EQUAL(20, sib32[0].elevationAngleRight);
	TEST_ASSERT_EQUAL(30, sib32[0].referencePointLongitude);
	TEST_ASSERT_EQUAL(-INT64_MAX, sib32[0].referencePointLatitude);
	TEST_ASSERT_EQUAL(-INT64_MAX, sib32[0].radius);

	TEST_ASSERT_EQUAL(808, sib32[1].satelliteId);
	TEST_ASSERT_EQUAL(13, sib32[1].inclination);
	TEST_ASSERT_EQUAL(14, sib32[1].argumentPerigee);
	TEST_ASSERT_EQUAL(15, sib32[1].rightAscension);
	TEST_ASSERT_EQUAL(16, sib32[1].meanAnomaly);
	TEST_ASSERT_EQUAL(17, sib32[1].eccentricity);
	TEST_ASSERT_EQUAL(18, sib32[1].meanMotion);
	TEST_ASSERT_EQUAL(3000000000, sib32[1].bStarDecimal);
	TEST_ASSERT_EQUAL(-5, sib32[1].bStarExponent);
	TEST_ASSERT_EQUAL(99, sib32[1].epochStar);
	TEST_ASSERT_EQUAL(100, sib32[1].serviceStart);
	TEST_ASSERT_EQUAL(10, sib32[1].elevationAngleLeft);
	TEST_ASSERT_EQUAL(20, sib32[1].elevationAngleRight);
	TEST_ASSERT_EQUAL(30, sib32[1].referencePointLongitude);
	TEST_ASSERT_EQUAL(40, sib32[1].referencePointLatitude);
	TEST_ASSERT_EQUAL(-INT64_MAX, sib32[1].radius);
	free(sib32);
}

void test_nullinput(void)
{
	int err;
	struct sat_data sat_data = {0};

	err = sat_data_calculate_next_pass(NULL, 0, 0.0, 0.0, 0.0, FAKE_TIME_MS);
	TEST_ASSERT_EQUAL(-EINVAL, err);
	err = sat_data_calculate_next_pass(&sat_data, 0, 0.0, 0.0, 0.0, FAKE_TIME_MS);
	TEST_ASSERT_EQUAL(-1, err);
	err =  sat_data_init_atsib32(NULL, NULL);
	TEST_ASSERT_EQUAL(-EINVAL, err);
	err = sat_data_init_atsib32(&sat_data, NULL);
	TEST_ASSERT_EQUAL(-EINVAL, err);
	err = sat_data_init_atsib32(NULL, "SIBCONFIG FORMAT ERROR");
	TEST_ASSERT_EQUAL(-EINVAL, err);
	err = sat_data_init_tle(NULL, NULL, NULL);
	TEST_ASSERT_EQUAL(-EINVAL, err);
	err = sat_data_init_tle(&sat_data, NULL, NULL);
	TEST_ASSERT_EQUAL(-EINVAL, err);
	err = sat_data_init_tle(NULL, "TLE FORMAT ERROR1", "TLE FORMAT ERROR2");
	TEST_ASSERT_EQUAL(-EINVAL, err);
}

extern int unity_main(void);

int main(void)
{
	/* use the runner from test_runner_generate() */
	(void)unity_main();

	return 0;
}
```
