## CMakeLists.txt
```
#
# Copyright (c) 2024 Nordic Semiconductor ASA
#
# SPDX-License-Identifier: LicenseRef-Nordic-5-Clause
#

cmake_minimum_required(VERSION 3.20.0)

find_package(Zephyr REQUIRED HINTS $ENV{ZEPHYR_BASE})
project(cloud_module_test)

test_runner_generate(src/cloud_module_test.c)

target_sources(app
  PRIVATE
  src/cloud_module_test.c
  ../../../app/src/modules/cloud/cloud.c
  ../../../app/src/modules/cloud/cloud_provisioning.c
  ../../../app/src/modules/cloud/cloud_location.c
  ../../../app/src/modules/cloud/cloud_environmental.c
  ../../../app/src/modules/cloud/cloud_configuration.c
)

zephyr_include_directories(${ZEPHYR_BASE}/include/zephyr/)
zephyr_include_directories(${ZEPHYR_BASE}/include/zephyr/net)
zephyr_include_directories(${ZEPHYR_BASE}/subsys/testsuite/include)
zephyr_include_directories(../../../app/src/modules/cloud)
zephyr_include_directories(../../../app/src/common)
zephyr_include_directories(../../../app/src/modules/power)
zephyr_include_directories(../../../app/src/modules/network)
zephyr_include_directories(../../../app/src/modules/environmental)
zephyr_include_directories(../../../app/src/modules/location)
zephyr_include_directories(../../../app/src/modules/storage)
zephyr_include_directories(${NRF_DIR}/subsys/net/lib/nrf_cloud/include)
zephyr_include_directories(${NRF_DIR}/subsys/net/lib/nrf_cloud/common/include)
zephyr_include_directories(${NRF_DIR}/include/net)
zephyr_include_directories(${NRF_DIR}/subsys/net/lib/nrf_cloud/coap/include)
zephyr_include_directories(${NRF_DIR}/../modules/lib/cjson)
zephyr_include_directories(${ZEPHYR_BASE}/../nrfxlib/nrf_modem/include)

target_link_options(app PRIVATE --whole-archive)

# Options that cannot be passed through Kconfig fragments
target_compile_definitions(app PRIVATE
	-DCONFIG_APP_CLOUD_PAYLOAD_BUFFER_MAX_SIZE=256
	-DCONFIG_APP_CLOUD_SHADOW_RESPONSE_BUFFER_MAX_SIZE=512
	-DCONFIG_APP_CLOUD_LOG_LEVEL=4
	-DCONFIG_APP_CLOUD_THREAD_STACK_SIZE=6352
	-DCONFIG_APP_CLOUD_MESSAGE_QUEUE_SIZE=5
	-DCONFIG_APP_CLOUD_MSG_PROCESSING_TIMEOUT_SECONDS=1
	-DCONFIG_APP_CLOUD_WATCHDOG_TIMEOUT_SECONDS=2
	-DCONFIG_APP_CLOUD_BACKOFF_TYPE_LINEAR=1
	-DCONFIG_APP_CLOUD_BACKOFF_INITIAL_SECONDS=6
	-DCONFIG_APP_CLOUD_BACKOFF_LINEAR_INCREMENT_SECONDS=6
	-DCONFIG_APP_CLOUD_BACKOFF_MAX_SECONDS=36
	-DCONFIG_APP_CLOUD_STORAGE_BATCH_ITEM_READ_TIMEOUT_MS=50
	-DCONFIG_APP_POWER=1
	-DCONFIG_APP_ENVIRONMENTAL=1
	-DCONFIG_LTE_LC_EDRX_MODULE=1
	-DCONFIG_LTE_LC_PSM_MODULE=1
	-DCONFIG_COAP_CONTENT_FORMAT_APP_JSON=50
	-DCONFIG_COAP_CLIENT_MAX_EXTRA_OPTIONS=2
	-DCONFIG_COAP_CLIENT_MAX_PATH_LENGTH=128
	-DCONFIG_NRF_CLOUD_COAP=1
	-DCONFIG_COAP_CLIENT_MESSAGE_HEADER_SIZE=1024
	-DCONFIG_COAP_CLIENT_MESSAGE_SIZE=1024
	-DCONFIG_COAP_CLIENT_MAX_REQUESTS=5
	-DCONFIG_COAP_CLIENT_BLOCK_SIZE=1024
	-DCONFIG_APP_LOCATION=1
	-DCONFIG_APP_LOCATION_WIFI_APS_MAX=10
	-DCONFIG_APP_LOCATION_NEIGHBOR_CELLS_MAX=10
	-DCONFIG_LTE_NEIGHBOR_CELLS_MAX=10
	-DCONFIG_LOCATION_METHOD_WIFI_SCANNING_RESULTS_MAX_CNT=10
	-DCONFIG_LOCATION_METHOD_WIFI_SCANNING_CHANNELS_MAX=3
	-DCONFIG_LOCATION_SERVICE_EXTERNAL
	-DCONFIG_LOCATION_METHOD_CELLULAR=1
	-DCONFIG_LOCATION_METHOD_WIFI=1
	-DCONFIG_LOCATION_METHOD_GNSS=1
	-DCONFIG_LOCATION_METHODS_LIST_SIZE=3
	-DCONFIG_NRF_CLOUD_AGNSS=y
)
```

## prj.conf
```kconfig
#
# Copyright (c) 2024 Nordic Semiconductor ASA
#
# SPDX-License-Identifier: LicenseRef-Nordic-5-Clause
#

CONFIG_UNITY=y
CONFIG_NATIVE_SIM_SLOWDOWN_TO_REAL_TIME=n

CONFIG_ZBUS=y
CONFIG_ZBUS_OBSERVER_NAME=y
CONFIG_ZBUS_CHANNEL_NAME=y
CONFIG_ZBUS_MSG_SUBSCRIBER=y
CONFIG_ZBUS_MSG_SUBSCRIBER_NET_BUF_POOL_SIZE=32
CONFIG_ZBUS_RUNTIME_OBSERVERS=y

CONFIG_SMF=y
CONFIG_SMF_ANCESTOR_SUPPORT=y
CONFIG_SMF_INITIAL_TRANSITION=y

CONFIG_ZCBOR=y
CONFIG_ZCBOR_CANONICAL=y

CONFIG_HEAP_MEM_POOL_SIZE=50000
```

## src/expected_environmental_cbor.h
```c
/*
 * Copyright (c) 2025 Nordic Semiconductor ASA
 *
 * SPDX-License-Identifier: LicenseRef-Nordic-5-Clause
 */

#ifndef EXPECTED_ENVIRONMENTAL_CBOR_H
#define EXPECTED_ENVIRONMENTAL_CBOR_H

#include <zephyr/types.h>

#include "environmental.h"

extern const struct environmental_msg env_samples[33];
extern const size_t env_samples_size;
extern const uint8_t expected_environmental_cbor_20[];
extern const size_t expected_environmental_cbor_20_len;
extern const uint8_t expected_environmental_cbor_33[];
extern const size_t expected_environmental_cbor_33_len;
extern const uint8_t expected_environmental_single_cbor[];
extern const size_t expected_environmental_single_cbor_len;
extern const uint8_t expected_environmental_grouped_cbor_20[];
extern const size_t expected_environmental_grouped_cbor_20_len;
extern const uint8_t expected_environmental_cbor_13[];
extern const size_t expected_environmental_cbor_13_len;
extern const uint8_t expected_environmental_cbor_5[];
extern const size_t expected_environmental_cbor_5_len;

#endif /* EXPECTED_ENVIRONMENTAL_CBOR_H */
```

## src/storage_mock.c
```c
/*
 * Copyright (c) 2025 Nordic Semiconductor ASA
 *
 * SPDX-License-Identifier: LicenseRef-Nordic-5-Clause
 */

#include <zephyr/kernel.h>
#include <zephyr/zbus/zbus.h>
#include <zephyr/logging/log.h>

/* Include the actual headers instead of redefining */
#include "../../../app/src/modules/storage/storage.h"
#include "../../../app/src/modules/location/location.h"
#include "../../../app/src/modules/environmental/environmental.h"

LOG_MODULE_REGISTER(storage_mock, CONFIG_LOG_DEFAULT_LEVEL);

/* Mock storage channels */
ZBUS_CHAN_DEFINE(STORAGE_CHAN,
		 struct storage_msg,
		 NULL,
		 NULL,
		 ZBUS_OBSERVERS_EMPTY,
		 ZBUS_MSG_INIT(.type = STORAGE_MODE_PASSTHROUGH)
);

ZBUS_CHAN_DEFINE(STORAGE_DATA_CHAN,
		 struct storage_msg,
		 NULL,
		 NULL,
		 ZBUS_OBSERVERS_EMPTY,
		 ZBUS_MSG_INIT(.type = STORAGE_DATA)
);

/* Note: LOCATION_CHAN is already defined in cloud_module_test.c */

/* Note: location functions are provided by the actual headers, no need to mock them */

/* Mock storage batch read function */
int storage_batch_read(struct storage_data_item *out_item, k_timeout_t timeout)
{
	LOG_DBG("Mock storage_batch_read called");

	if (!out_item) {
		return -EINVAL;
	}

	/* Return no data available to simulate empty storage */
	return -EAGAIN;
}
```
