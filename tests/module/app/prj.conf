## CMakeLists.txt
```
#
# Copyright (c) 2025 Nordic Semiconductor ASA
#
# SPDX-License-Identifier: LicenseRef-Nordic-5-Clause
#

cmake_minimum_required(VERSION 3.20.0)

find_package(Zephyr REQUIRED HINTS $ENV{ZEPHYR_BASE})
project(app_module_test)

test_runner_generate(src/main.c)

set(ASSET_TRACKER_TEMPLATE_DIR ../../..)

target_sources(app
	PRIVATE
	src/main.c
	src/checks.c
	${ASSET_TRACKER_TEMPLATE_DIR}/app/src/modules/app/app.c
	${ASSET_TRACKER_TEMPLATE_DIR}/app/src/common/message_channel.c
)

target_include_directories(app PRIVATE src)

zephyr_include_directories(${ZEPHYR_BASE}/include/zephyr/)
zephyr_include_directories(${ZEPHYR_BASE}/subsys/testsuite/include)
zephyr_include_directories(../../../app/src/common)
zephyr_include_directories(../../../app/src/modules/cloud)
zephyr_include_directories(../../../app/src/modules/battery)
zephyr_include_directories(../../../app/src/modules/button)
zephyr_include_directories(../../../app/src/modules/network)
zephyr_include_directories(../../../app/src/modules/environmental)
zephyr_include_directories(../../../app/src/modules/fota)
zephyr_include_directories(../../../app/src/modules/location)
zephyr_include_directories(../../../app/src/modules/led)


target_link_options(app PRIVATE --whole-archive)

add_compile_options(-Wno-return-type)

set_property(SOURCE ${ASSET_TRACKER_TEMPLATE_DIR}/app/src/modules/app/app.c PROPERTY COMPILE_FLAGS
	     "-include ${CMAKE_CURRENT_SOURCE_DIR}/src/redef.h")

# Options that cannot be passed through Kconfig fragments
target_compile_definitions(app PRIVATE
	-DCONFIG_APP_LOG_LEVEL=4
	-DCONFIG_APP_PAYLOAD_CHANNEL_BUFFER_MAX_SIZE=100
	-DCONFIG_APP_MODULE_TRIGGER_TIMEOUT_SECONDS=600
	-DCONFIG_APP_CLOUD_LOG_LEVEL=0
	-DCONFIG_APP_CLOUD_THREAD_STACK_SIZE=2048
	-DCONFIG_APP_CLOUD_MESSAGE_QUEUE_SIZE=5
	-DCONFIG_APP_CLOUD_BACKOFF_TYPE_LINEAR=1
	-DCONFIG_APP_CLOUD_BACKOFF_INITIAL_SECONDS=6
	-DCONFIG_APP_CLOUD_BACKOFF_LINEAR_INCREMENT_SECONDS=6
	-DCONFIG_APP_CLOUD_BACKOFF_MAX_SECONDS=36
	-DCONFIG_LTE_LC_CONN_EVAL_MODULE=1
	-DCONFIG_LTE_LC_EDRX_MODULE=1
	-DCONFIG_LTE_LC_PSM_MODULE=1
	-DCONFIG_APP_MODULE_RECV_BUFFER_SIZE=1024
	-DCOAP_CONTENT_FORMAT_APP_JSON=50
	-DCONFIG_APP_BATTERY=1
	-DCONFIG_APP_ENVIRONMENTAL=1
	-DZEPHYR_INCLUDE_SYS_REBOOT_H_
	-DCONFIG_APP_REQUEST_NETWORK_QUALITY=1
)
```

## prj.conf
```kconfig
#
# Copyright (c) 2025 Nordic Semiconductor ASA
#
# SPDX-License-Identifier: LicenseRef-Nordic-5-Clause
#

CONFIG_UNITY=y
CONFIG_ZBUS=y
CONFIG_LOG=y
CONFIG_ZBUS_OBSERVER_NAME=y
CONFIG_ZBUS_CHANNEL_NAME=y
CONFIG_ZBUS_MSG_SUBSCRIBER=y
CONFIG_ZBUS_RUNTIME_OBSERVERS=y
CONFIG_CBPRINTF_FP_SUPPORT=y
CONFIG_HEAP_MEM_POOL_SIZE=40000
CONFIG_ZBUS_MSG_SUBSCRIBER_NET_BUF_POOL_SIZE=100

CONFIG_SMF=y
CONFIG_SMF_ANCESTOR_SUPPORT=y
CONFIG_SMF_INITIAL_TRANSITION=y
CONFIG_NATIVE_SIM_SLOWDOWN_TO_REAL_TIME=n
```

## src/main.c
```c
/*
 * Copyright (c) 2025 Nordic Semiconductor ASA
 *
 * SPDX-License-Identifier: LicenseRef-Nordic-5-Clause
 */
#include <unity.h>

#include <zephyr/fff.h>
#include <zephyr/zbus/zbus.h>
#include <zephyr/task_wdt/task_wdt.h>
#include <zephyr/logging/log.h>
#include <date_time.h>

#include "dk_buttons_and_leds.h"
#include "message_channel.h"
#include "battery.h"
#include "network.h"
#include "environmental.h"
#include "cloud_module.h"
#include "fota.h"
#include "location.h"
#include "led.h"

#include "checks.h"

/* Define the channels for testing */
ZBUS_CHAN_DEFINE(BATTERY_CHAN,
		 struct battery_msg,
		 NULL,
		 NULL,
		 ZBUS_OBSERVERS_EMPTY,
		 ZBUS_MSG_INIT(0)
);
ZBUS_CHAN_DEFINE(BUTTON_CHAN,
		 struct battery_msg,
		 NULL,
		 NULL,
		 ZBUS_OBSERVERS_EMPTY,
		 ZBUS_MSG_INIT(0)
);
ZBUS_CHAN_DEFINE(NETWORK_CHAN,
		 struct network_msg,
		 NULL,
		 NULL,
		 ZBUS_OBSERVERS_EMPTY,
		 ZBUS_MSG_INIT(.type = NETWORK_DISCONNECTED)
);
ZBUS_CHAN_DEFINE(CLOUD_CHAN,
		 struct cloud_msg,
		 NULL,
		 NULL,
		 ZBUS_OBSERVERS_EMPTY,
		 ZBUS_MSG_INIT(.type = CLOUD_DISCONNECTED)
);
ZBUS_CHAN_DEFINE(ENVIRONMENTAL_CHAN,
		 struct environmental_msg,
		 NULL,
		 NULL,
		 ZBUS_OBSERVERS_EMPTY,
		 ZBUS_MSG_INIT(0)
);
ZBUS_CHAN_DEFINE(FOTA_CHAN,
		 enum fota_msg_type,
		 NULL,
		 NULL,
		 ZBUS_OBSERVERS_EMPTY,
		 ZBUS_MSG_INIT(0)
);
ZBUS_CHAN_DEFINE(LOCATION_CHAN,
		 enum location_msg_type,
		 NULL,
		 NULL,
		 ZBUS_OBSERVERS_EMPTY,
		 ZBUS_MSG_INIT(0)
);
ZBUS_CHAN_DEFINE(LED_CHAN,
		 struct led_msg,
		 NULL,
		 NULL,
		 ZBUS_OBSERVERS_EMPTY,
		 ZBUS_MSG_INIT(0)
);


DEFINE_FFF_GLOBALS;

#define HOUR_IN_SECONDS	3600
#define WEEK_IN_SECONDS HOUR_IN_SECONDS * 24 * 7

FAKE_VALUE_FUNC(int, dk_buttons_init, button_handler_t);
FAKE_VALUE_FUNC(int, task_wdt_feed, int);
FAKE_VALUE_FUNC(int, task_wdt_add, uint32_t, task_wdt_callback_t, void *);
FAKE_VOID_FUNC(date_time_register_handler, date_time_evt_handler_t);
FAKE_VOID_FUNC(sys_reboot, int);

LOG_MODULE_REGISTER(trigger_module_test, 4);

void setUp(void)
{
	RESET_FAKE(dk_buttons_init);
	RESET_FAKE(task_wdt_feed);
	RESET_FAKE(task_wdt_add);
	RESET_FAKE(date_time_register_handler);
	RESET_FAKE(sys_reboot);

	FFF_RESET_HISTORY();
}

static void button_handler(uint32_t button_states, uint32_t has_changed)
{
	int err;
	uint8_t button_number = 1;

	if (has_changed & button_states & DK_BTN1_MSK) {
		LOG_DBG("Button 1 pressed!");

		err = zbus_chan_pub(&BUTTON_CHAN, &button_number, K_SECONDS(1));
		if (err) {
			LOG_ERR("zbus_chan_pub, error: %d", err);
			SEND_FATAL_ERROR();
			return;
		}
	}
}

static void send_cloud_connected_ready_to_send(void)
{
	struct cloud_msg cloud_msg = {
		.type = CLOUD_CONNECTED_READY_TO_SEND,
	};

	int err = zbus_chan_pub(&CLOUD_CHAN, &cloud_msg, K_SECONDS(1));

	TEST_ASSERT_EQUAL(0, err);
}

static void send_config(uint64_t interval)
{
	const struct configuration config = {
		.update_interval_present = true,
		.update_interval = interval,
	};

	int err = zbus_chan_pub(&CONFIG_CHAN, &config, K_SECONDS(1));

	TEST_ASSERT_EQUAL(0, err);
}

static void send_cloud_disconnected(void)
{
	struct cloud_msg cloud_msg = {
		.type = CLOUD_DISCONNECTED,
	};

	int err = zbus_chan_pub(&CLOUD_CHAN, &cloud_msg, K_SECONDS(1));

	TEST_ASSERT_EQUAL(0, err);
}

void test_init_to_connected_state(void)
{
	/* Given */
	send_cloud_connected_ready_to_send();

	/* When */
	k_sleep(K_SECONDS(HOUR_IN_SECONDS));

	/* Then */
	uint32_t interval =  HOUR_IN_SECONDS / CONFIG_APP_MODULE_TRIGGER_TIMEOUT_SECONDS;

	check_network_event(NETWORK_QUALITY_SAMPLE_REQUEST);
	check_battery_event(BATTERY_PERCENTAGE_SAMPLE_REQUEST);

	for (int i = 0; i < interval; i++) {
		check_network_event(NETWORK_QUALITY_SAMPLE_REQUEST);
		check_battery_event(BATTERY_PERCENTAGE_SAMPLE_REQUEST);
	}

	/* Cleanup */
	send_cloud_disconnected();
	check_no_events(7200);
}

void test_button_press_on_connected(void)
{
	/* Given */
	send_cloud_connected_ready_to_send();

	/* When */
	button_handler(DK_BTN1_MSK, DK_BTN1_MSK);
	k_sleep(K_SECONDS(5));


	/* Then */

	/* Two events, one for initial trigger when entering connected state and one for the
	 * button press
	 */
	check_network_event(NETWORK_QUALITY_SAMPLE_REQUEST);
	check_battery_event(BATTERY_PERCENTAGE_SAMPLE_REQUEST);
	check_network_event(NETWORK_QUALITY_SAMPLE_REQUEST);
	check_battery_event(BATTERY_PERCENTAGE_SAMPLE_REQUEST);

	/* Cleanup */
	send_cloud_disconnected();
	check_no_events(7200);
}

void test_button_press_on_disconnected(void)
{
	/* Given */
	send_cloud_disconnected();

	/* When */
	button_handler(DK_BTN1_MSK, DK_BTN1_MSK);
	k_sleep(K_SECONDS(5));

	/* Then */
	check_no_events(7200);
}

void test_trigger_interval_change_in_connected(void)
{
	/* Given */
	send_cloud_connected_ready_to_send();
	send_config(HOUR_IN_SECONDS * 12);

	/* When */
	k_sleep(K_SECONDS(WEEK_IN_SECONDS));

	/* Then */
	uint32_t interval =  (WEEK_IN_SECONDS) / (HOUR_IN_SECONDS * 12);

	check_network_event(NETWORK_QUALITY_SAMPLE_REQUEST);
	check_battery_event(BATTERY_PERCENTAGE_SAMPLE_REQUEST);

	for (int i = 0; i < interval; i++) {
		check_network_event(NETWORK_QUALITY_SAMPLE_REQUEST);
		check_battery_event(BATTERY_PERCENTAGE_SAMPLE_REQUEST);
	}

	/* Cleanup */
	send_cloud_disconnected();
	check_no_events(WEEK_IN_SECONDS);
}

/* This is required to be added to each test. That is because unity's
 * main may return nonzero, while zephyr's main currently must
 * return 0 in all cases (other values are reserved).
 */
extern int unity_main(void);

int main(void)
{
	(void)unity_main();

	k_sleep(K_FOREVER);

	return 0;
}
```

## src/checks.c
```c
/*
 * Copyright (c) 2025 Nordic Semiconductor ASA
 *
 * SPDX-License-Identifier: LicenseRef-Nordic-5-Clause
 */
#include <unity.h>
#include <zephyr/zbus/zbus.h>
#include <zephyr/logging/log.h>
#include "message_channel.h"
#include "battery.h"
#include "network.h"

#include "checks.h"

ZBUS_MSG_SUBSCRIBER_DEFINE(subscriber);
ZBUS_CHAN_ADD_OBS(NETWORK_CHAN, subscriber, 0);
ZBUS_CHAN_ADD_OBS(BATTERY_CHAN, subscriber, 0);

LOG_MODULE_REGISTER(trigger_module_checks, 4);

void check_network_event(enum network_msg_type expected_network_type)
{
	int err;
	const struct zbus_channel *chan;
	struct network_msg network_msg;

	/* Allow the test thread to sleep so that the DUT's thread is allowed to run. */
	k_sleep(K_MSEC(100));

	err = zbus_sub_wait_msg(&subscriber, &chan, &network_msg, K_MSEC(1000));
	if (err == -ENOMSG) {
		LOG_ERR("No network event received");
		TEST_FAIL();
	} else if (err) {
		LOG_ERR("zbus_sub_wait, error: %d", err);
		SEND_FATAL_ERROR();

		return;
	}

	if (chan != &NETWORK_CHAN) {
		LOG_ERR("Received message from wrong channel");
		TEST_FAIL();
	}

	TEST_ASSERT_EQUAL(expected_network_type, network_msg.type);
}

void check_battery_event(enum battery_msg_type expected_battery_type)
{
	int err;
	const struct zbus_channel *chan;
	struct battery_msg battery_msg;

	/* Allow the test thread to sleep so that the DUT's thread is allowed to run. */
	k_sleep(K_MSEC(100));

	err = zbus_sub_wait_msg(&subscriber, &chan, &battery_msg, K_MSEC(1000));
	if (err == -ENOMSG) {
		LOG_ERR("No battery event received");
		TEST_FAIL();
	} else if (err) {
		LOG_ERR("zbus_sub_wait, error: %d", err);
		SEND_FATAL_ERROR();

		return;
	}

	if (chan != &BATTERY_CHAN) {
		LOG_ERR("Received message from wrong channel");
		TEST_FAIL();
	}

	TEST_ASSERT_EQUAL(expected_battery_type, battery_msg.type);
}

void check_no_events(uint32_t time_in_seconds)
{
	int err;
	const struct zbus_channel *chan;
	uint8_t *payload = NULL;

	/* Allow the test thread to sleep so that the DUT's thread is allowed to run. */
	k_sleep(K_SECONDS(time_in_seconds));

	err = zbus_sub_wait_msg(&subscriber, &chan, payload, K_MSEC(1000));
	if (err == 0) {
		LOG_ERR("Unexpected message message on channel %s", zbus_chan_name(chan));
		TEST_FAIL();
	}
}
```
