## CMakeLists.txt
```
#
# Copyright (c) 2024 Nordic Semiconductor ASA
#
# SPDX-License-Identifier: LicenseRef-Nordic-5-Clause
#

cmake_minimum_required(VERSION 3.20.0)

find_package(Zephyr REQUIRED HINTS $ENV{ZEPHYR_BASE})
project(environmental_module_test)

test_runner_generate(src/environmental_module_test.c)

set(ASSET_TRACKER_TEMPLATE_DIR ../../..)

target_sources(app
  PRIVATE
  src/environmental_module_test.c
  src/redef.c
  ../../../app/src/modules/environmental/environmental.c
)

zephyr_include_directories(${ZEPHYR_BASE}/include/zephyr/)
zephyr_include_directories(${ZEPHYR_BASE}/subsys/testsuite/include)
zephyr_include_directories(../../../app/src/common)
zephyr_include_directories(../../../app/src/modules/cloud)
zephyr_include_directories(../../../app/src/modules/environmental)
zephyr_include_directories(src)

target_link_options(app PRIVATE --whole-archive)
# Options that cannot be passed through Kconfig fragments
target_compile_definitions(app PRIVATE
	-DCONFIG_APP_CLOUD_PAYLOAD_BUFFER_MAX_SIZE=100
	-DCONFIG_APP_ENVIRONMENTAL_LOG_LEVEL=4
	-DCONFIG_APP_ENVIRONMENTAL_THREAD_STACK_SIZE=1024
	-DCONFIG_APP_ENVIRONMENTAL_MESSAGE_QUEUE_SIZE=5
	-DCONFIG_APP_ENVIRONMENTAL_MSG_PROCESSING_TIMEOUT_SECONDS=1
	-DCONFIG_APP_ENVIRONMENTAL_WATCHDOG_TIMEOUT_SECONDS=2
)

set_property(SOURCE ${ASSET_TRACKER_TEMPLATE_DIR}/app/src/modules/environmental/environmental.c PROPERTY COMPILE_FLAGS
             "-include ${CMAKE_CURRENT_SOURCE_DIR}/src/redef.h")
```

## prj.conf
```kconfig
CONFIG_UNITY=y
CONFIG_ZBUS=y
CONFIG_LOG=y
CONFIG_ZBUS_OBSERVER_NAME=y
CONFIG_ZBUS_CHANNEL_NAME=y
CONFIG_ZBUS_MSG_SUBSCRIBER=y
CONFIG_ZBUS_RUNTIME_OBSERVERS=y
CONFIG_CBPRINTF_FP_SUPPORT=y
CONFIG_HEAP_MEM_POOL_SIZE=40000
CONFIG_ZBUS_MSG_SUBSCRIBER_NET_BUF_POOL_SIZE=100

CONFIG_SMF=y
CONFIG_SMF_ANCESTOR_SUPPORT=y
CONFIG_SMF_INITIAL_TRANSITION=y
CONFIG_NATIVE_SIM_SLOWDOWN_TO_REAL_TIME=n

# Add sanitizers
CONFIG_ASAN=y
CONFIG_UBSAN=y
```

## app.overlay
```dts
/ {

	gas_sensor_dummy: gas_sensor_dummy {
		compatible = "zephyr,gas-sensor-dummy";
		status = "okay";
	};

	aliases {
		gas-sensor = &gas_sensor_dummy;
	};
};
```

## src/main.c
```c
/*
 * Copyright (c) 2025 Nordic Semiconductor ASA
 *
 * SPDX-License-Identifier: LicenseRef-Nordic-5-Clause
 */
#include <unity.h>
#include <zephyr/fff.h>
#include <zephyr/zbus/zbus.h>
#include <zephyr/task_wdt/task_wdt.h>
#include <zephyr/logging/log.h>

#include "app_common.h"
#include "environmental.h"

DEFINE_FFF_GLOBALS;

FAKE_VALUE_FUNC(int, task_wdt_feed, int);
FAKE_VALUE_FUNC(int, task_wdt_add, uint32_t, task_wdt_callback_t, void *);

ZBUS_MSG_SUBSCRIBER_DEFINE(environmental_subscriber);
ZBUS_CHAN_ADD_OBS(ENVIRONMENTAL_CHAN, environmental_subscriber, 0);

LOG_MODULE_REGISTER(environmental_module_test, 4);

void setUp(void)
{
	/* reset fakes */
	RESET_FAKE(task_wdt_feed);
	RESET_FAKE(task_wdt_add);
}

void check_environmental_event(enum environmental_msg_type expected_environmental_type)
{
	int err;
	const struct zbus_channel *chan;
	struct environmental_msg environmental_msg;

	/* Allow the test thread to sleep so that the DUT's thread is allowed to run. */
	k_sleep(K_MSEC(100));

	err = zbus_sub_wait_msg(&environmental_subscriber, &chan, &environmental_msg, K_MSEC(1000));
	if (err == -ENOMSG) {
		LOG_ERR("No envornmental event received");
		TEST_FAIL();
	} else if (err) {
		LOG_ERR("zbus_sub_wait, error: %d", err);
		SEND_FATAL_ERROR();

		return;
	}

	if (chan != &ENVIRONMENTAL_CHAN) {
		LOG_ERR("Received message from wrong channel");
		TEST_FAIL();
	}

	TEST_ASSERT_EQUAL(expected_environmental_type, environmental_msg.type);
}

void check_no_environmental_events(uint32_t time_in_seconds)
{
	int err;
	const struct zbus_channel *chan;
	struct environmental_msg environmental_msg;

	/* Allow the test thread to sleep so that the DUT's thread is allowed to run. */
	k_sleep(K_SECONDS(time_in_seconds));

	err = zbus_sub_wait_msg(&environmental_subscriber, &chan, &environmental_msg, K_MSEC(1000));
	if (err == 0) {
		LOG_ERR("Received trigger event with type %d", environmental_msg.type);
		TEST_FAIL();
	}
}

static void send_environmental_sample_request(void)
{
	struct environmental_msg msg = {
		.type = ENVIRONMENTAL_SENSOR_SAMPLE_REQUEST,
	};

	int err = zbus_chan_pub(&ENVIRONMENTAL_CHAN, &msg, K_SECONDS(1));

	TEST_ASSERT_EQUAL(0, err);
}

void test_sensor_sample(void)
{
	for (int i = 0; i < 10; i++) {
		/* Given */
		send_environmental_sample_request();

		/* When */
		k_sleep(K_SECONDS(1));

		/* Then */
		check_environmental_event(ENVIRONMENTAL_SENSOR_SAMPLE_REQUEST);
		check_environmental_event(ENVIRONMENTAL_SENSOR_SAMPLE_RESPONSE);
		check_no_environmental_events(3600);
	}
}

/* This is required to be added to each test. That is because unity's
 * main may return nonzero, while zephyr's main currently must
 * return 0 in all cases (other values are reserved).
 */
extern int unity_main(void);

int main(void)
{
	/* use the runner from test_runner_generate() */
	(void)unity_main();

	return 0;
}
```

## src/environmental_module_test.c
```c
/*
 * Copyright (c) 2025 Nordic Semiconductor ASA
 *
 * SPDX-License-Identifier: LicenseRef-Nordic-5-Clause
 */
#include <unity.h>
#include <zephyr/fff.h>
#include <zephyr/zbus/zbus.h>
#include <zephyr/task_wdt/task_wdt.h>
#include <zephyr/logging/log.h>
#include <zephyr/drivers/sensor.h>

#include "app_common.h"
#include "environmental.h"
#include "redef.h"

DEFINE_FFF_GLOBALS;

FAKE_VALUE_FUNC(int, task_wdt_feed, int);
FAKE_VALUE_FUNC(int, task_wdt_add, uint32_t, task_wdt_callback_t, void *);
FAKE_VALUE_FUNC(int, date_time_now, int64_t *);

ZBUS_MSG_SUBSCRIBER_DEFINE(environmental_subscriber);
ZBUS_CHAN_ADD_OBS(environmental_chan, environmental_subscriber, 0);

LOG_MODULE_REGISTER(environmental_module_test, 4);

void setUp(void)
{
	/* reset fakes */
	RESET_FAKE(task_wdt_feed);
	RESET_FAKE(task_wdt_add);
	RESET_FAKE(date_time_now);

	mock_channel_get_fail_channel = SENSOR_CHAN_ALL;
}

void check_environmental_event(enum environmental_msg_type expected_environmental_type)
{
	int err;
	const struct zbus_channel *chan;
	struct environmental_msg environmental_msg;

	/* Allow the test thread to sleep so that the DUT's thread is allowed to run. */
	k_sleep(K_MSEC(100));

	err = zbus_sub_wait_msg(&environmental_subscriber, &chan, &environmental_msg, K_MSEC(1000));
	if (err == -ENOMSG) {
		LOG_ERR("No envornmental event received");
		TEST_FAIL();
	} else if (err) {
		LOG_ERR("zbus_sub_wait, error: %d", err);
		SEND_FATAL_ERROR();

		return;
	}

	if (chan != &environmental_chan) {
		LOG_ERR("Received message from wrong channel");
		TEST_FAIL();
	}

	TEST_ASSERT_EQUAL(expected_environmental_type, environmental_msg.type);
}

void check_no_environmental_events(uint32_t time_in_seconds)
{
	int err;
	const struct zbus_channel *chan;
	struct environmental_msg environmental_msg;

	/* Allow the test thread to sleep so that the DUT's thread is allowed to run. */
	k_sleep(K_SECONDS(time_in_seconds));

	err = zbus_sub_wait_msg(&environmental_subscriber, &chan, &environmental_msg, K_MSEC(1000));
	if (err == 0) {
		LOG_ERR("Received trigger event with type %d", environmental_msg.type);
		TEST_FAIL();
	}
}

static void send_environmental_sample_request(void)
{
	struct environmental_msg msg = {
		.type = ENVIRONMENTAL_SENSOR_SAMPLE_REQUEST,
	};

	int err = zbus_chan_pub(&environmental_chan, &msg, K_SECONDS(1));

	TEST_ASSERT_EQUAL(0, err);
}

void test_sensor_sample(void)
{
	for (int i = 0; i < 10; i++) {
		/* Given */
		send_environmental_sample_request();

		/* When */
		k_sleep(K_SECONDS(1));

		/* Then */
		check_environmental_event(ENVIRONMENTAL_SENSOR_SAMPLE_REQUEST);
		check_environmental_event(ENVIRONMENTAL_SENSOR_SAMPLE_RESPONSE);
		check_no_environmental_events(3600);
	}
}

void test_sensor_sample_gas_resistance_read_failure(void)
{
	/* Given */
	mock_channel_get_fail_channel = SENSOR_CHAN_GAS_RES;

	send_environmental_sample_request();

	/* When */
	k_sleep(K_SECONDS(1));

	/* Then: the module should still report the rest of the sample even though the
	 * (supplementary) gas resistance reading failed.
	 */
	check_environmental_event(ENVIRONMENTAL_SENSOR_SAMPLE_REQUEST);
	check_environmental_event(ENVIRONMENTAL_SENSOR_SAMPLE_RESPONSE);
}

/* This is required to be added to each test. That is because unity's
 * main may return nonzero, while zephyr's main currently must
 * return 0 in all cases (other values are reserved).
 */
extern int unity_main(void);

int main(void)
{
	/* use the runner from test_runner_generate() */
	(void)unity_main();

	return 0;
}
```

## src/redef.c
```c
/*
 * Copyright (c) 2025 Nordic Semiconductor ASA
 *
 * SPDX-License-Identifier: LicenseRef-Nordic-5-Clause
 */

#include <errno.h>
#include <zephyr/device.h>
#include <zephyr/drivers/sensor.h>

static int sample_fetch(const struct device *dev, enum sensor_channel chan)
{
	ARG_UNUSED(dev);
	ARG_UNUSED(chan);

	return 0;
}

enum sensor_channel mock_channel_get_fail_channel = SENSOR_CHAN_ALL;

static int channel_get(const struct device *dev, enum sensor_channel chan,
		      struct sensor_value *val)
{
	ARG_UNUSED(dev);
	ARG_UNUSED(val);

	if (chan == mock_channel_get_fail_channel) {
		return -EIO;
	}

	return 0;
}

static const struct sensor_driver_api dummy_api = {
	.sample_fetch = &sample_fetch,
	.channel_get = &channel_get,
};

struct device_state state = {
	.initialized = true,
	.init_res = 0U,
};

struct device mock_sensor_device = {
	.name = "mock_sensor",
	.state = &state,
	.api = &dummy_api
};
```

## src/redef.h
```c
/*
 * Copyright (c) 2025 Nordic Semiconductor ASA
 *
 * SPDX-License-Identifier: LicenseRef-Nordic-5-Clause
 */

#ifndef REDEF_H_
#define REDEF_H_

#include <zephyr/device.h>
#include <zephyr/drivers/sensor.h>

extern struct device mock_sensor_device;

/* When set to a channel other than SENSOR_CHAN_ALL, the mock channel_get() implementation
 * will fail (return -EIO) for that channel only. Reset to SENSOR_CHAN_ALL between tests.
 */
extern enum sensor_channel mock_channel_get_fail_channel;

#undef DEVICE_DT_GET
#define DEVICE_DT_GET(node_id) &mock_sensor_device

#endif /* REDEF_ */
```
