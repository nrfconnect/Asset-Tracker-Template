/*
 * Copyright (c) 2026 Nordic Semiconductor ASA
 *
 * SPDX-License-Identifier: LicenseRef-Nordic-5-Clause
 */

flash_ext: &gd25wb256 {
	status = "okay";
};

/delete-node/ &boot_partition;
/delete-node/ &slot1_partition;
/delete-node/ &tfm_ps_partition;
/delete-node/ &tfm_its_partition;
/delete-node/ &tfm_otp_partition;
#include "../../../boards/att_flash_partitions.dtsi"

/* Give b0 full secure SRAM. */
&sram0_s {
	reg = <0x0 0x40000>;
};

/ {
	chosen {
		zephyr,code-partition = &b0_partition;
	};
};
