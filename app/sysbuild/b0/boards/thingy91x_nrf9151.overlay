/*
 * Copyright (c) 2026 Nordic Semiconductor ASA
 *
 * SPDX-License-Identifier: LicenseRef-Nordic-5-Clause
 */

/delete-node/ &b0_partition;
/delete-node/ &s0_partition;
/delete-node/ &s1_partition;
/delete-node/ &external_flash_partition;
#include "../../../boards/att_flash_partitions.dtsi"

/* Give b0 full secure SRAM. */
&sram0_s {
	reg = <0x0 0x40000>;
};

/ {
	chosen {
		zephyr,code-partition = &b0_partition;
	};
};
