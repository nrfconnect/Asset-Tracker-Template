/*
 * Copyright (c) 2025 Nordic Semiconductor ASA
 *
 * SPDX-License-Identifier: LicenseRef-Nordic-5-Clause
 */

flash_ext: &gd25wb256 {
	status = "okay";
};

/delete-node/ &boot_partition;
/delete-node/ &slot1_partition;
/delete-node/ &tfm_ps_partition;
/delete-node/ &tfm_its_partition;
/delete-node/ &tfm_otp_partition;
#include "../../../boards/att_flash_partitions.dtsi"

&uart0 {
	status = "okay";
	current-speed = <1000000>;
};
