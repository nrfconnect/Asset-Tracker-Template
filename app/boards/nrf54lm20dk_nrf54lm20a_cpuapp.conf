## app/boards/nrf54lm20dk_nrf54lm20a_cpuapp.conf
```kconfig
#
# Copyright (c) 2026 Nordic Semiconductor ASA
#
# SPDX-License-Identifier: LicenseRef-Nordic-5-Clause
#
# Asset Tracker Template configuration for the nRF54LM20 application core
# acting as the host of an external nRF91-based modem running ncs-serial-modem.
#
# The host uses the upstream Zephyr cellular modem stack (modem_cellular
# driver + CMUX + PPP + chat) instead of the nRF Modem Library, and brings
# the link up/down through Zephyr's connection manager (NETWORK_BACKEND_CONN_MGR).
# Native MbedTLS (no TF-M offload) is used for cloud connections.
#

# --- UART configuration for Serial Modem ---
CONFIG_SERIAL=y
CONFIG_UART_ASYNC_API=y
CONFIG_UART_USE_RUNTIME_CONFIGURE=y

# --- Zephyr cellular modem driver (CMUX + PPP + chat) ---
CONFIG_MODEM=y
CONFIG_MODEM_MODULES=y
CONFIG_MODEM_CELLULAR=y
CONFIG_MODEM_CELLULAR_APN=""
CONFIG_MODEM_CELLULAR_UART_BUFFER_SIZES=512
CONFIG_MODEM_CMUX_MTU=127
CONFIG_MODEM_CMUX_WORK_BUFFER_SIZE_EXTRA=2048
CONFIG_MODEM_BACKEND_UART_ASYNC_HWFC=y
CONFIG_MODEM_STATS=y
# Use a dedicated workqueue for the modem subsystem to keep the system
# workqueue free for application work (zbus, location, cloud, etc.).
CONFIG_MODEM_DEDICATED_WORKQUEUE=y
CONFIG_MODEM_DEDICATED_WORKQUEUE_STACK_SIZE=2048
CONFIG_MODEM_DEDICATED_WORKQUEUE_PRIORITY=5

# --- Networking: PPP + native sockets, no offload ---
CONFIG_NET_NATIVE=y
CONFIG_NET_TCP=y
CONFIG_NET_UDP=y
CONFIG_NET_SOCKETS_OFFLOAD=n
CONFIG_NET_CONTEXT_RCVTIMEO=y
CONFIG_NET_CONTEXT_SNDTIMEO=y
CONFIG_NET_L2_PPP=y
CONFIG_NET_L2_PPP_OPTION_DNS_USE=y
CONFIG_NET_PKT_RX_COUNT=16
CONFIG_NET_PKT_TX_COUNT=16
CONFIG_NET_BUF_RX_COUNT=32
CONFIG_NET_BUF_TX_COUNT=32

# --- Connection manager (network module backend) ---
CONFIG_NET_CONNECTION_MANAGER=y
CONFIG_NET_MGMT=y
CONFIG_NET_MGMT_EVENT=y
CONFIG_NET_MGMT_EVENT_INFO=y
# Default NET_MGMT stack (768 B) is too small for our callbacks: zbus
# publish + downstream notifies/subscribers, and the burst of NET_EVENT_*
# fired during PPP/CMUX bring-up overflow it. Bump the queue too.
CONFIG_NET_MGMT_EVENT_STACK_SIZE=4096
CONFIG_NET_MGMT_EVENT_QUEUE_SIZE=10
CONFIG_APP_NETWORK_BACKEND_CONN_MGR=y

# --- DNS resolver (uses DNS server obtained via PPP IPCP) ---
CONFIG_DNS_RESOLVER=y
CONFIG_NET_SOCKETS_DNS_TIMEOUT=30000

# --- Native TLS / MbedTLS / PSA Crypto (no modem-offloaded TLS) ---
CONFIG_NET_SOCKETS_SOCKOPT_TLS=y
CONFIG_NET_SOCKETS_ENABLE_DTLS=y
CONFIG_NET_SOCKETS_TLS_MAX_CONTEXTS=1
CONFIG_NET_SOCKETS_TLS_SET_MAX_FRAGMENT_LENGTH=y
CONFIG_TLS_CREDENTIALS=y
CONFIG_TLS_CREDENTIALS_BACKEND_VOLATILE=y

# Native TLS via NCS MbedTLS/nrf_security (DTLS for nRF Cloud CoAP + provisioning)
CONFIG_PSA_CRYPTO=y
CONFIG_MBEDTLS=y
CONFIG_MBEDTLS_ENABLE_HEAP=y
CONFIG_MBEDTLS_HEAP_SIZE=81920
CONFIG_MBEDTLS_PEM_PARSE_C=y
CONFIG_MBEDTLS_SSL_KEEP_PEER_CERTIFICATE=n
CONFIG_MBEDTLS_SSL_SERVER_NAME_INDICATION=y
CONFIG_MBEDTLS_DECLARE_PRIVATE_IDENTIFIERS=y
CONFIG_MBEDTLS_MD_C=y
CONFIG_MBEDTLS_HMAC_DRBG_C=y
CONFIG_MBEDTLS_SHA256_C=y
CONFIG_MBEDTLS_ECP_C=y
CONFIG_MBEDTLS_ECDSA_C=y
CONFIG_MBEDTLS_CTR_DRBG_C=y
CONFIG_MBEDTLS_AES_C=y
CONFIG_MBEDTLS_ENTROPY_C=y
CONFIG_PSA_WANT_ALG_ECDH=y
CONFIG_PSA_WANT_ALG_ECDSA=y
CONFIG_PSA_WANT_ALG_GCM=y
CONFIG_PSA_WANT_ECC_SECP_R1_256=y
CONFIG_MBEDTLS_KEY_EXCHANGE_ECDHE_ECDSA_ENABLED=y

# --- Stack and heap tuning ---
CONFIG_MAIN_STACK_SIZE=8192
CONFIG_SYSTEM_WORKQUEUE_STACK_SIZE=8192
CONFIG_SHELL_STACK_SIZE=6144
CONFIG_APP_NETWORK_THREAD_STACK_SIZE=4096
CONFIG_APP_CLOUD_THREAD_STACK_SIZE=8192
CONFIG_APP_STORAGE_THREAD_STACK_SIZE=4096
CONFIG_DATE_TIME_THREAD_STACK_SIZE=4096
CONFIG_DATE_TIME_NTP=y
CONFIG_DATE_TIME_RETRY_COUNT=5

CONFIG_RESET_ON_FATAL_ERROR=n

# --- Location / FOTA modules omitted (no NCS Location lib / nRF Cloud FOTA on host)
CONFIG_LOCATION=n
CONFIG_APP_LOCATION=n
CONFIG_APP_FOTA=n

# --- HW ID source (SoC FICR via HWINFO; no modem IMEI on this host) ---
CONFIG_HW_ID_LIBRARY=y
CONFIG_HW_ID_LIBRARY_SOURCE_DEVICE_ID=y

# --- Memfault disabled on Serial Modem host (focus: provisioning + nRF Cloud) ---
CONFIG_MEMFAULT=n

# --- AT user pipe on modem_cellular (DLCI 1 / Serial Modem AT channel) ---
CONFIG_MODEM_AT_USER_PIPE=y
CONFIG_MODEM_AT_USER_PIPE_IDX=0

# --- nRF Device Provisioning (host, via modem_cellular AT pipe) ---
CONFIG_NRF_PROVISIONING=y
CONFIG_NRF_PROVISIONING_BACKEND_MODEM_CELLULAR=y
CONFIG_NRF_PROVISIONING_COAP=y
CONFIG_NRF_PROVISIONING_CODEC=y
CONFIG_NRF_PROVISIONING_CBOR=y
CONFIG_NRF_PROVISIONING_WITH_CERT=y
CONFIG_NRF_PROVISIONING_CBOR_RECORDS=5
CONFIG_NRF_PROVISIONING_RX_BUF_SZ=2560
CONFIG_NRF_PROVISIONING_TX_BUF_SZ=2048
CONFIG_NRF_PROVISIONING_CODEC_AT_CMD_LEN=2048
CONFIG_NRF_PROVISIONING_CODEC_RX_SZ_START=1024
CONFIG_NRF_PROVISIONING_AUTO_START_ON_INIT=y

# --- nRF Cloud CoAP on host (JWT/credentials on modem via AT user pipe) ---
CONFIG_NRF_CLOUD=y
CONFIG_NRF_CLOUD_COAP=y
CONFIG_NRF_CLOUD_COAP_MAX_RETRIES=3
CONFIG_NRF_CLOUD_COAP_DISCONNECT_ON_FAILED_REQUEST=y
# Memfault disabled on nRF54 host; no nrf_cloud_coap_get_user_options provider
CONFIG_NRF_CLOUD_COAP_MAX_USER_OPTIONS=0
CONFIG_NRF_CLOUD_PRINT_DETAILS=n
CONFIG_NRF_CLOUD_SEND_SHADOW_INFO_ON_CONNECT=n
# Device status shadow requires MODEM_INFO (nRF Modem Lib on-chip modem only)
CONFIG_NRF_CLOUD_SEND_DEVICE_STATUS=n
CONFIG_NRF_CLOUD_SEND_DEVICE_STATUS_NETWORK=n
CONFIG_NRF_CLOUD_MODEM_CELLULAR=y
CONFIG_NRF_CLOUD_CLIENT_ID_SRC_MDM_DEVICE_UUID=y
CONFIG_NRF_CLOUD_CHECK_CREDENTIALS=y
CONFIG_NRF_CLOUD_CREDENTIALS_MGMT_MODEM_CELLULAR=y
CONFIG_NRF_CLOUD_CREDENTIALS_SYNC_FROM_MODEM=y
CONFIG_NRF_CLOUD_JWT_SOURCE_MODEM_CELLULAR=y

CONFIG_COAP=y
CONFIG_COAP_EXTENDED_OPTIONS_LEN=y
CONFIG_COAP_CLIENT=y
CONFIG_COAP_CLIENT_MAX_EXTRA_OPTIONS=3
CONFIG_COAP_MAX_RETRANSMIT=1
CONFIG_COAP_INIT_ACK_TIMEOUT_MS=5000
CONFIG_COAP_CLIENT_BLOCK_SIZE=1024
CONFIG_COAP_CLIENT_MESSAGE_SIZE=1024
CONFIG_COAP_CLIENT_STACK_SIZE=1280

# FOTA requires nRF Modem on host; disabled until nRF54 FOTA path exists
CONFIG_NRF_CLOUD_FOTA_POLL=n
```

## app/boards/thingy91_nrf9160_ns.conf
```kconfig
#
# Copyright (c) 2025 Nordic Semiconductor ASA
#
# SPDX-License-Identifier: LicenseRef-Nordic-5-Clause
#

# Environmental module

CONFIG_SENSOR=n
CONFIG_BME680=n
CONFIG_APP_ENVIRONMENTAL=n
# Reduce logging to save flash
CONFIG_APP_ENVIRONMENTAL_LOG_LEVEL_OFF=y

# Full modem fota not supported, lacks external flash
CONFIG_NRF_CLOUD_FOTA_FULL_MODEM_UPDATE=n
# Enable shell for Memfault shell commands
CONFIG_SHELL=y

# Flash space optimizations for Thingy:91 (372 KB flash)
# Disable debug logging (saves significant flash)
CONFIG_TFM_LOG_LEVEL_SILENCE=y
# CONFIG_TFM_SPM_LOG_LEVEL_OFF=y
CONFIG_APP_FOTA_LOG_LEVEL_OFF=y
CONFIG_APP_LOCATION_LOG_LEVEL_OFF=y
CONFIG_APP_CLOUD_LOG_LEVEL_OFF=y
CONFIG_APP_NETWORK_LOG_LEVEL_OFF=y
CONFIG_APP_LOG_LEVEL_OFF=y
CONFIG_NRF_PROVISIONING_LOG_LEVEL_OFF=y
CONFIG_NRF_CLOUD_FOTA_POLL_LOG_LEVEL_OFF=y

# Disable thread names (saves flash for string storage)
CONFIG_THREAD_NAME=n

# Reduce task watchdog channels (8 -> 4 saves flash)
# CONFIG_TASK_WDT_CHANNELS=4

# Disable PM device shell (optional feature)
CONFIG_PM_DEVICE_SHELL=n

# Reduce shell buffer sizes (if shell is still needed)
CONFIG_SHELL_CMD_BUFF_SIZE=1024
CONFIG_SHELL_BACKEND_SERIAL_RX_RING_BUFFER_SIZE=1024

# Reduce log buffer size
CONFIG_LOG_BUFFER_SIZE=2048

# Disable AT shell if not needed (saves significant flash)
CONFIG_AT_SHELL=n

# Reduce provisioning buffer sizes if possible
CONFIG_NRF_PROVISIONING_RX_BUF_SZ=2048
CONFIG_NRF_PROVISIONING_TX_BUF_SZ=2048
CONFIG_NRF_PROVISIONING_CODEC_AT_CMD_LEN=1024
CONFIG_NRF_PROVISIONING_CODEC_RX_SZ_START=1024
```

## app/boards/thingy91x_nrf9151_ns.conf
```kconfig
#
# Copyright (c) 2024 Nordic Semiconductor ASA
#
# SPDX-License-Identifier: LicenseRef-Nordic-5-Clause
#

# External flash (MCUboot secondary on GD25)
CONFIG_SPI=y
CONFIG_SPI_NOR=y
CONFIG_SPI_NOR_SFDP_DEVICETREE=y
CONFIG_SPI_NOR_FLASH_LAYOUT_PAGE_SIZE=4096

# TF-M - Crypto is offloaded to the modem so the minimal profile is sufficient.
CONFIG_TFM_PROFILE_TYPE_MINIMAL=y
# Set these options to make TF-M fit within the allocated TF-M flash and RAM partitions.
CONFIG_TFM_PSA_FRAMEWORK_HAS_MM_IOVEC=y
CONFIG_PSA_WANT_ALG_CTR_DRBG=y
# TFM logging over uart0
CONFIG_TFM_LOG_LEVEL_SILENCE=n
CONFIG_TFM_SECURE_UART0=y
CONFIG_TFM_SECURE_UART_SHARE_INSTANCE=y
CONFIG_TFM_EXCEPTION_INFO_DUMP=y
CONFIG_TFM_SPM_LOG_LEVEL_INFO=y

# Modem library shared memory buffers - 4KB is sufficient for this application
CONFIG_NRF_MODEM_LIB_SHMEM_TX_SIZE=4096
CONFIG_NRF_MODEM_LIB_SHMEM_RX_SIZE=4096

# Environmental module
CONFIG_APP_ENVIRONMENTAL=y

# Enable BME680
CONFIG_BME680=y

# Power module
CONFIG_APP_POWER=y

# LED module
CONFIG_APP_LED=y
CONFIG_APP_LED_LOG_LEVEL_DBG=y

# Fuel Gage
CONFIG_NRF_FUEL_GAUGE=y
CONFIG_NPM13XX_CHARGER=y

# Wi-Fi
CONFIG_WIFI=y
CONFIG_WIFI_NRF70=y
CONFIG_WIFI_NRF70_LOG_LEVEL_ERR=y
CONFIG_WIFI_NRF70_SKIP_LOCAL_ADMIN_MAC=y
CONFIG_NRF70_BH_WQ_STACK_SIZE=1024
CONFIG_NRF70_IRQ_WQ_STACK_SIZE=1024
# Scan only 2.4 GHz channels. Most commercial APs use channels 1, 6, and 11 (all 2.4 GHz),
# providing sufficient AP coverage for Wi-Fi location while reducing scan time.
CONFIG_NRF_WIFI_2G_BAND=y
# Scan only using offload API
CONFIG_WIFI_NM_WPA_SUPPLICANT=n

# Memory optimizations
CONFIG_NET_BUF_RX_COUNT=1
CONFIG_NET_BUF_TX_COUNT=1
CONFIG_NET_PKT_RX_COUNT=1
CONFIG_NET_PKT_TX_COUNT=1
CONFIG_NET_TX_STACK_SIZE=512
CONFIG_NET_RX_STACK_SIZE=512
CONFIG_NET_TC_TX_COUNT=1
CONFIG_NET_MAX_CONTEXTS=1
CONFIG_NET_MGMT_EVENT_STACK_SIZE=1280

# Wifi scan requires extended heap size
CONFIG_NRF_WIFI_CTRL_HEAP_SIZE=10240

# Configure location priority order and timeouts
CONFIG_LOCATION_METHOD_WIFI=y
CONFIG_LOCATION_WORKQUEUE_STACK_SIZE=4096
CONFIG_LOCATION_REQUEST_DEFAULT_METHOD_FIRST_GNSS=y
CONFIG_LOCATION_REQUEST_DEFAULT_METHOD_SECOND_WIFI=y
CONFIG_LOCATION_REQUEST_DEFAULT_METHOD_THIRD_CELLULAR=y
CONFIG_LOCATION_REQUEST_DEFAULT_WIFI_TIMEOUT=5000

# GNSS location options (depend on LOCATION_METHOD_GNSS)
CONFIG_LOCATION_REQUEST_DEFAULT_GNSS_TIMEOUT=60000
CONFIG_LOCATION_REQUEST_DEFAULT_GNSS_VISIBILITY_DETECTION=y
CONFIG_LOCATION_REQUEST_DEFAULT_GNSS_ACCURACY_LOW=y
CONFIG_LTE_NETWORK_MODE_LTE_M_NBIOT_GPS=y
CONFIG_LTE_NEIGHBOR_CELLS_MAX=8

# Required for explicit-erase flash (nRF91 internal flash)
CONFIG_STREAM_FLASH_ERASE=y
## Align this with CONFIG_NRF_WIFI_SCAN_MAX_BSS_CNT
CONFIG_LOCATION_METHOD_WIFI_SCANNING_RESULTS_MAX_CNT=10
CONFIG_NRF_WIFI_SCAN_MAX_BSS_CNT=10

# Debug logging
CONFIG_APP_POWER_LOG_LEVEL_DBG=y
CONFIG_APP_ENVIRONMENTAL_LOG_LEVEL_DBG=y

# nRF Modem Library and AT command access
CONFIG_NRF_MODEM_LIB=y
CONFIG_AT_SHELL=y
CONFIG_AT_MONITOR_HEAP_SIZE=2176

# LTE Link Control modules
CONFIG_LTE_LINK_CONTROL=y
CONFIG_LTE_LC_PDN_MODULE=y
CONFIG_LTE_LC_PSM_MODULE=y
CONFIG_LTE_LC_EDRX_MODULE=y
CONFIG_LTE_LC_WORKQUEUE_STACK_SIZE=896

# PSM (Power Saving Mode)
CONFIG_LTE_PSM_REQ=y
CONFIG_LTE_PROPRIETARY_PSM_REQ=y
CONFIG_LTE_PSM_REQ_FORMAT_SECONDS=y
CONFIG_LTE_PSM_REQ_RPTAU_SECONDS=7200
CONFIG_LTE_PSM_REQ_RAT_SECONDS=6

# eDRX (Extended Discontinuous Reception)
CONFIG_LTE_EDRX_REQ=y
CONFIG_LTE_EDRX_REQ_VALUE_LTE_M="0000"
CONFIG_LTE_EDRX_REQ_VALUE_NBIOT="0000"

# Modem info / JWT / Key management
CONFIG_MODEM_INFO=y
CONFIG_MODEM_INFO_ADD_DEVICE=y
CONFIG_MODEM_KEY_MGMT=y
CONFIG_MODEM_JWT=y
CONFIG_MODEM_ATTEST_TOKEN=y
CONFIG_HW_ID_LIBRARY_SOURCE_UUID=y

# nRF Cloud (CoAP transport)
CONFIG_NRF_CLOUD=y
CONFIG_NRF_CLOUD_COAP=y
CONFIG_NRF_CLOUD_COAP_MAX_RETRIES=3
CONFIG_NRF_CLOUD_COAP_DISCONNECT_ON_FAILED_REQUEST=y
CONFIG_NRF_CLOUD_COAP_MAX_USER_OPTIONS=2
CONFIG_NRF_CLOUD_PRINT_DETAILS=n
CONFIG_NRF_CLOUD_SEND_SHADOW_INFO_ON_CONNECT=n
CONFIG_NRF_CLOUD_SEND_DEVICE_STATUS=y
CONFIG_NRF_CLOUD_SEND_DEVICE_STATUS_NETWORK=y
CONFIG_NRF_CLOUD_SEND_DEVICE_STATUS_SIM=y
CONFIG_NRF_CLOUD_SEND_SERVICE_INFO_FOTA=y
CONFIG_NRF_CLOUD_AGNSS=y
CONFIG_NRF_CLOUD_LOG_DIRECT=n
CONFIG_NRF_CLOUD_LOG_OUTPUT_LEVEL=3
CONFIG_NRF_CLOUD_CLIENT_ID_SRC_INTERNAL_UUID=y
CONFIG_NRF_CLOUD_CHECK_CREDENTIALS=y
CONFIG_NRF_CLOUD_CREDENTIALS_MGMT_MODEM=y

# nRF Cloud FOTA
CONFIG_NRF_CLOUD_FOTA_POLL=y
CONFIG_NRF_CLOUD_FOTA_FULL_MODEM_UPDATE=y
CONFIG_NRF_CLOUD_FOTA_FULL_MODEM_UPDATE_BUF_SIZE=1024
CONFIG_NRF_CLOUD_FOTA_DOWNLOAD_FRAGMENT_SIZE=1900
CONFIG_NRF_CLOUD_COAP_DOWNLOADS=y
CONFIG_FOTA_DOWNLOAD=y
CONFIG_FOTA_DOWNLOAD_PROGRESS_EVT=y
CONFIG_FOTA_DL_TIMEOUT_MIN=60
CONFIG_FOTA_SOCKET_RETRIES=5
CONFIG_DFU_TARGET=y
CONFIG_DOWNLOADER=y
CONFIG_DOWNLOADER_STACK_SIZE=2000

# MCUboot - needed for FOTA
CONFIG_BOOTLOADER_MCUBOOT=y
CONFIG_IMG_MANAGER=y
CONFIG_MCUBOOT_IMG_MANAGER=y

# nRF Provisioning
CONFIG_NRF_PROVISIONING=y
CONFIG_NRF_PROVISIONING_CBOR_RECORDS=5
CONFIG_NRF_PROVISIONING_COAP=y
CONFIG_NRF_PROVISIONING_CODEC=y
CONFIG_NRF_PROVISIONING_CBOR=y
CONFIG_NRF_PROVISIONING_WITH_CERT=y
CONFIG_NRF_PROVISIONING_RX_BUF_SZ=2560
CONFIG_NRF_PROVISIONING_TX_BUF_SZ=2048
CONFIG_NRF_PROVISIONING_CODEC_AT_CMD_LEN=2048
CONFIG_NRF_PROVISIONING_CODEC_RX_SZ_START=1024

# Location framework (base; Wi-Fi/GNSS tuning below)
CONFIG_APP_LOCATION=y
CONFIG_APP_FOTA=y
CONFIG_APP_LOCATION_LOG_LEVEL_DBG=y
CONFIG_APP_FOTA_LOG_LEVEL_DBG=y
CONFIG_LOCATION=y
CONFIG_LOCATION_DATA_DETAILS=y
CONFIG_LOCATION_METHOD_GNSS=y
CONFIG_LOCATION_METHOD_CELLULAR=y
CONFIG_LOCATION_SERVICE_EXTERNAL=y
CONFIG_LOCATION_REQUEST_DEFAULT_CELLULAR_TIMEOUT=30000
CONFIG_LOCATION_REQUEST_DEFAULT_TIMEOUT=120000
CONFIG_LOCATION_REQUEST_DEFAULT_CELLULAR_CELL_COUNT=3
CONFIG_APP_LOCATION_NEIGHBOR_CELLS_MAX=8

# Memfault (logging + storage; cloud upload in section below)
CONFIG_MEMFAULT=y
CONFIG_MEMFAULT_NCS_FW_TYPE="att"
CONFIG_MEMFAULT_LOGGING_ENABLE=y
CONFIG_MEMFAULT_LOGGING_RAM_SIZE=4096
CONFIG_MEMFAULT_EVENT_STORAGE_SIZE=2048
CONFIG_MEMFAULT_COREDUMP_STACK_SIZE_TO_COLLECT=512
CONFIG_MEMFAULT_HTTP_ENABLE=n
CONFIG_MEMFAULT_NCS_STACK_METRICS=n
CONFIG_MEMFAULT_FS_BYTES_FREE_METRIC=n
CONFIG_POSIX_FILE_SYSTEM=n

# Memfault: NCS-specific upload over nRF Cloud CoAP
CONFIG_PM_PARTITION_SIZE_MEMFAULT_STORAGE=0x8000
CONFIG_MEMFAULT_COAP_MAX_POST_SIZE=972
CONFIG_MEMFAULT_COAP_MAX_MESSAGES_TO_SEND=10000
CONFIG_MEMFAULT_NCS_INTERNAL_FLASH_BACKED_COREDUMP=y
CONFIG_MEMFAULT_NCS_POST_COREDUMP_ON_NETWORK_CONNECTED=y
CONFIG_MEMFAULT_PERIODIC_UPLOAD_USE_DEDICATED_WORKQUEUE=y
CONFIG_MEMFAULT_USE_NRF_CLOUD_COAP=y
CONFIG_MEMFAULT_NCS_LTE_METRICS=y
CONFIG_MEMFAULT_NCS_LOCATION_METRICS=y

# CoAP client tuning
CONFIG_COAP_MAX_RETRANSMIT=1
CONFIG_COAP_INIT_ACK_TIMEOUT_MS=5000
CONFIG_COAP_CLIENT_THREAD_PRIORITY=14
CONFIG_COAP_CLIENT_BLOCK_SIZE=1024
CONFIG_COAP_CLIENT_MESSAGE_SIZE=1024
CONFIG_COAP_CLIENT_STACK_SIZE=1280
CONFIG_COAP_EXTENDED_OPTIONS_LEN_VALUE=192
CONFIG_COAP_CLIENT_MAX_PATH_LENGTH=128
CONFIG_COAP_CLIENT_MAX_EXTRA_OPTIONS=3

# Network module backend (LTE link controller)
CONFIG_APP_NETWORK_BACKEND_LTE_LC=y
```

## app/src/inspect/Kconfig.inspect
```kconfig
#
# Copyright (c) 2026 Nordic Semiconductor
#
# SPDX-License-Identifier: LicenseRef-Nordic-5-Clause
#

menu "Inspect"

config APP_INSPECT_SHELL
	bool "Inspect shell command"
	depends on SHELL
	default y
	help
	  Enable the 'att_inspect' shell command.

endmenu # Inspect
```
