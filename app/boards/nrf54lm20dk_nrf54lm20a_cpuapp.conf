## app/src/modules/transport/Kconfig.transport
```kconfig
#
# Copyright (c) 2024 Nordic Semiconductor
#
# SPDX-License-Identifier: LicenseRef-Nordic-5-Clause
#

menu "Transport"
	depends on NRF_CLOUD_COAP

config APP_TRANSPORT_BACKOFF_INITIAL_SECONDS
	int "Reconnection backoff time in seconds"
	default 60
	help
	  Time in between reconnection attempts to the CoAP server.
	  The timer starts after the last failed attempt.

choice APP_TRANSPORT_BACKOFF_TYPE
	prompt "Reconnection backoff type"
	default APP_TRANSPORT_BACKOFF_TYPE_LINEAR

config APP_TRANSPORT_BACKOFF_TYPE_EXPONENTIAL
	bool "Exponential backoff"
	help
	  Exponential backoff doubles the reconnection timeout after each failed attempt.
	  The maximum reconnection timeout is defined by APP_TRANSPORT_BACKOFF_MAX_SECONDS.

config APP_TRANSPORT_BACKOFF_TYPE_LINEAR
	bool "Linear backoff"
	help
	  Linear backoff adds a fixed amount of time to the reconnection timeout after each failed attempt,
	  as defined by APP_TRANSPORT_BACKOFF_LINEAR_INCREMENT_SECONDS.

config APP_TRANSPORT_BACKOFF_TYPE_NONE
	bool "No backoff"
	help
	  No backoff means that the reconnection timeout is constant at the value defined by
	  APP_TRANSPORT_BACKOFF_INITIAL_SECONDS.

endchoice

config APP_TRANSPORT_BACKOFF_LINEAR_INCREMENT_SECONDS
	int "Reconnection backoff time increment"
	default 60
	help
	  Time added to the reconnection timeout after each failed attempt in seconds.
	  The maximum reconnection timeout is defined by APP_TRANSPORT_BACKOFF_MAX_SECONDS.

config APP_TRANSPORT_BACKOFF_MAX_SECONDS
	int "Maximum reconnection timeout"
	default 3600
	help
	  Maximum reconnection backoff value in seconds.

config APP_TRANSPORT_THREAD_STACK_SIZE
	int "Thread stack size"
	default 1536

config APP_TRANSPORT_MESSAGE_QUEUE_SIZE
	int "Message queue size"
	default 5
	help
	  ZBus subscriber message queue size.

config APP_TRANSPORT_WORKQUEUE_STACK_SIZE
	int "Workqueue stack size"
	default 1792
	help
	  Stack size of the module's internal workqueue.

config APP_TRANSPORT_POLL_INTERVAL_SECONDS
	int "Poll interval in seconds"
	default 10
	help
	  Interval in seconds between polling nRF Cloud CoAP.

config APP_TRANSPORT_WATCHDOG_TIMEOUT_SECONDS
	int "Watchdog timeout seconds"
	default 180

config APP_TRANSPORT_EXEC_TIME_SECONDS_MAX
	int "Maximum execution time seconds"
	default 120
	help
	  Maximum time allowed for a single execution of the module's thread loop.

module = APP_TRANSPORT
module-str = Transport
source "subsys/logging/Kconfig.template.log_config"

endmenu # Transport
```

## app/src/modules/uart_power_control/Kconfig.uart_power_control
```kconfig
#
# Copyright (c) 2026 Nordic Semiconductor ASA
#
# SPDX-License-Identifier: LicenseRef-Nordic-5-Clause
#

menuconfig APP_UART_POWER_CONTROL
	bool "UART power control on VBUS events"
	help
	  Disable UART when VBUS is removed to save power.
	  The UART is re-enabled when VBUS is connected again.

if APP_UART_POWER_CONTROL

config APP_UART_POWER_CONTROL_THREAD_STACK_SIZE
	int "UART power control thread stack size"
	default 512

module = APP_UART_POWER_CONTROL
module-str = UART Power Control
source "subsys/logging/Kconfig.template.log_config"

endif # APP_UART_POWER_CONTROL
```

## app/sysbuild/mcuboot/boards/nrf54lm20dk_nrf54lm20a_cpuapp.conf
```kconfig
#
# Copyright (c) 2026 Nordic Semiconductor ASA
#
# SPDX-License-Identifier: LicenseRef-Nordic-5-Clause
#

# nRF54LM20 uses RRAM — no external SPI NOR flash and no FPROTECT support
CONFIG_SPI_NOR=n
CONFIG_FPROTECT=n
CONFIG_BOOT_WATCHDOG_FEED=n

# MCUboot on nRF54L requires a larger main stack to avoid MPU faults
CONFIG_MAIN_STACK_SIZE=16384

# App slot is ~925 KB / 4 KB erase-block = ~232 sectors; use 256 to have margin
CONFIG_BOOT_MAX_IMG_SECTORS=256

CONFIG_MULTITHREADING=y
```
