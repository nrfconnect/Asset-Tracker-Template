## app/src/modules/battery/Kconfig.battery
```kconfig
#
# Copyright (c) 2024 Nordic Semiconductor
#
# SPDX-License-Identifier: LicenseRef-Nordic-5-Clause
#

menu "Battery"

config APP_BATTERY
	bool "Battery module"

if APP_BATTERY

config APP_BATTERY_THREAD_STACK_SIZE
	int "Thread stack size"
	default 1536

config APP_BATTERY_WATCHDOG_TIMEOUT_SECONDS
	int "Watchdog timeout"
	default 120
	help
	  Timeout in seconds for the battery module watchdog.
	  The timeout given in this option covers both:
	    * Waiting for an incoming message in zbus_sub_wait_msg().
	    * Time spent processing the message, defined by
	      CONFIG_APP_BATTERY_MSG_PROCESSING_TIMEOUT_SECONDS.
	  Ensure that this value exceeds CONFIG_APP_BATTERY_MSG_PROCESSING_TIMEOUT_SECONDS.
	  A small difference between the two can mean more frequent watchdog feeds, which increases
	  power consumption.

config APP_BATTERY_MSG_PROCESSING_TIMEOUT_SECONDS
	int "Maximum message processing time"
	default 3
	help
	  Maximum time allowed for processing a single message in the module's state machine.
	  The value must be smaller than CONFIG_APP_BATTERY_WATCHDOG_TIMEOUT_SECONDS.

module = APP_BATTERY
module-str = Battery
source "subsys/logging/Kconfig.template.log_config"

endif # APP_BATTERY

endmenu # Battery
```

## app/src/modules/button/Kconfig.button
```kconfig
#
# Copyright (c) 2024 Nordic Semiconductor
#
# SPDX-License-Identifier: LicenseRef-Nordic-5-Clause
#

menu "Button"

config APP_BUTTON_SHELL
	bool "Button module shell"
	default y if SHELL
	help
	  Enable shell for the button module.

config APP_BUTTON_LONG_PRESS_TIMEOUT_MS
	int "Long press timeout in milliseconds"
	default 3000
	help
	  Time in milliseconds that a button must be held to be considered
	  a long press. Short presses are detected when the button is
	  released before this timeout expires.

module = APP_BUTTON
module-str = Button
source "subsys/logging/Kconfig.template.log_config"

endmenu # Button
```

## app/src/modules/cloud/Kconfig.cloud
```kconfig
#
# Copyright (c) 2024 Nordic Semiconductor
#
# SPDX-License-Identifier: LicenseRef-Nordic-5-Clause
#

menuconfig APP_CLOUD
	bool "Cloud module"
	default y if NRF_CLOUD_COAP

if APP_CLOUD

config APP_CLOUD_SHELL
	bool "Enable cloud shell"
	default y if SHELL
	help
	  Enable cloud shell commands.

config APP_CLOUD_PAYLOAD_BUFFER_MAX_SIZE
	int "Payload maximum buffer size"
	default 128
	help
	  Maximum size of the buffer sent over the payload channel when sending RAW JSON messages
	  to the cloud.

config APP_CLOUD_SHADOW_RESPONSE_BUFFER_MAX_SIZE
	int "Payload maximum buffer size"
	default 512
	help
	  Maximum size of the buffer used to receive shadow responses from the cloud.

config APP_CLOUD_CONFIRMABLE_MESSAGES
	bool "Use confirmable messages"
	help
	  Use confirmable messages for CoAP communications with nRF Cloud.
	  Confirmable messages are retransmitted COAP_MAX_RETRANSMIT times
	  until an acknowledgment is received.

config APP_CLOUD_BACKOFF_INITIAL_SECONDS
	int "Reconnection backoff time in seconds"
	default 60
	help
	  Time in between reconnection attempts to the nRF Cloud CoAP server.
	  The timer starts after the last failed attempt.

choice APP_CLOUD_BACKOFF_TYPE
	prompt "Reconnection backoff type"
	default APP_CLOUD_BACKOFF_TYPE_LINEAR

config APP_CLOUD_BACKOFF_TYPE_EXPONENTIAL
	bool "Exponential backoff"
	help
	  Exponential backoff doubles the reconnection timeout after each failed attempt.
	  The maximum reconnection timeout is defined by APP_CLOUD_BACKOFF_MAX_SECONDS.

config APP_CLOUD_BACKOFF_TYPE_LINEAR
	bool "Linear backoff"
	help
	  Linear backoff adds a fixed amount of time to the reconnection timeout after each failed attempt,
	  as defined by APP_CLOUD_BACKOFF_LINEAR_INCREMENT_SECONDS.

config APP_CLOUD_BACKOFF_TYPE_NONE
	bool "No backoff"
	help
	  No backoff means that the reconnection timeout is constant at the value defined by
	  APP_CLOUD_BACKOFF_INITIAL_SECONDS.

endchoice

config APP_CLOUD_BACKOFF_LINEAR_INCREMENT_SECONDS
	int "Reconnection backoff time increment"
	default 60
	help
	  Time added to the reconnection timeout after each failed attempt in seconds.
	  The maximum reconnection timeout is defined by APP_CLOUD_BACKOFF_MAX_SECONDS.

config APP_CLOUD_BACKOFF_MAX_SECONDS
	int "Maximum reconnection timeout"
	default 3600
	help
	  Maximum reconnection backoff value in seconds.

config APP_CLOUD_THREAD_STACK_SIZE
	int "Thread stack size"
	default 4096

config APP_CLOUD_MESSAGE_QUEUE_SIZE
	int "Message queue size"
	default 5
	help
	  ZBus subscriber message queue size.

config APP_CLOUD_WATCHDOG_TIMEOUT_SECONDS
	int "Watchdog timeout"
	default 180
	help
	  Timeout in seconds for the cloud module watchdog.
	  The timeout given in this option covers both:
	    * Waiting for an incoming message in zbus_sub_wait_msg().
	    * Time spent processing the message, defined by
	      CONFIG_APP_CLOUD_MSG_PROCESSING_TIMEOUT_SECONDS.
	  Ensure that this value exceeds CONFIG_APP_CLOUD_MSG_PROCESSING_TIMEOUT_SECONDS.
	  A small difference between the two can mean more frequent watchdog feeds, which increases
	  power consumption.


config APP_CLOUD_MSG_PROCESSING_TIMEOUT_SECONDS
	int "Maximum message processing time"
	default 120
	help
	  Maximum time allowed for processing a single message in the module's state machine.
	  The value must be smaller than CONFIG_APP_CLOUD_WATCHDOG_TIMEOUT_SECONDS.

module = APP_CLOUD
module-str = Cloud
source "subsys/logging/Kconfig.template.log_config"

endif # APP_CLOUD
```

## app/src/modules/dummy/Kconfig.dummy
```kconfig
#
# Copyright (c) 2024 Nordic Semiconductor
#
# SPDX-License-Identifier: LicenseRef-Nordic-5-Clause
#

menuconfig APP_DUMMY
    bool "Dummy module"
    default y
    help
        Enable the dummy module.

if APP_DUMMY

config APP_DUMMY_THREAD_STACK_SIZE
    int "Dummy module thread stack size"
    default 2048
    help
        Stack size for the dummy module thread.

config APP_DUMMY_WATCHDOG_TIMEOUT_SECONDS
    int "Dummy module watchdog timeout in seconds"
    default 30
    help
        Watchdog timeout for the dummy module.

config APP_DUMMY_MSG_PROCESSING_TIMEOUT_SECONDS
    int "Dummy module message processing timeout in seconds"
    default 5
    help
        Maximum time allowed for processing a single message in the dummy module.

module = APP_DUMMY
module-str = DUMMY
source "subsys/logging/Kconfig.template.log_config"

endif # APP_DUMMY
```

## app/src/modules/environmental/Kconfig.environmental
```kconfig
#
# Copyright (c) 2024 Nordic Semiconductor
#
# SPDX-License-Identifier: LicenseRef-Nordic-5-Clause
#

menuconfig APP_ENVIRONMENTAL
	bool "Environmental module"
	depends on BME680
	default y

if APP_ENVIRONMENTAL

config APP_ENVIRONMENTAL_THREAD_STACK_SIZE
	int "Thread stack size"
	default 1024

config APP_ENVIRONMENTAL_WATCHDOG_TIMEOUT_SECONDS
	int "Watchdog timeout"
	default 120
	help
	  Timeout in seconds for the environmental module watchdog.
	  The timeout given in this option covers both:
	    * Waiting for an incoming message in zbus_sub_wait_msg().
	    * Time spent processing the message, defined by
	      CONFIG_APP_ENVIRONMENTAL_MSG_PROCESSING_TIMEOUT_SECONDS.
	  Ensure that this value exceeds CONFIG_APP_ENVIRONMENTAL_MSG_PROCESSING_TIMEOUT_SECONDS.
	  A small difference between the two can mean more frequent watchdog feeds, which increases
	  power consumption.

config APP_ENVIRONMENTAL_MSG_PROCESSING_TIMEOUT_SECONDS
	int "Maximum message processing time"
	default 3
	help
	  Maximum time allowed for processing a single message in the module's state machine.
	  The value must be smaller than CONFIG_APP_ENVIRONMENTAL_WATCHDOG_TIMEOUT_SECONDS.

module = APP_ENVIRONMENTAL
module-str = ENVIRONMENTAL
source "subsys/logging/Kconfig.template.log_config"

endif # APP_ENVIRONMENTAL
```

## app/src/modules/fota/Kconfig.fota
```kconfig
#
# Copyright (c) 2024 Nordic Semiconductor
#
# SPDX-License-Identifier: LicenseRef-Nordic-5-Clause
#

menuconfig APP_FOTA
	bool "FOTA"
	default y if (!BOARD_NATIVE_POSIX && (NRF_CLOUD_FOTA_POLL || MEMFAULT_FOTA))

if APP_FOTA

choice APP_FOTA_TYPE
	prompt "FOTA backend"
	default APP_FOTA_TYPE_NRF_CLOUD if NRF_CLOUD_FOTA_POLL
	default APP_FOTA_TYPE_MEMFAULT if MEMFAULT_FOTA
	help
	  Select which backend the FOTA module uses to discover and download firmware updates.

config APP_FOTA_TYPE_NRF_CLOUD
	bool "nRF Cloud FOTA"
	depends on NRF_CLOUD_FOTA_POLL
	help
	  Use the nRF Cloud FOTA poll library as the FOTA backend.

config APP_FOTA_TYPE_MEMFAULT
	bool "Memfault FOTA"
	depends on MEMFAULT_FOTA
	select MEMFAULT_FOTA_DOWNLOAD_CALLBACK_CUSTOM
	help
	  Use Memfault Release Management as the FOTA backend.
endchoice

config APP_FOTA_THREAD_STACK_SIZE
	int "Thread stack size"
	default 2048

config APP_FOTA_WATCHDOG_TIMEOUT_SECONDS
	int "Watchdog timeout"
	default 210
	help
	  Timeout in seconds for the FOTA module watchdog.
	  The timeout given in this option covers both:
	    * Waiting for an incoming message in zbus_sub_wait_msg().
	    * Time spent processing the message, defined by
	      CONFIG_APP_FOTA_MSG_PROCESSING_TIMEOUT_SECONDS.
	  Ensure that this value exceeds CONFIG_APP_FOTA_MSG_PROCESSING_TIMEOUT_SECONDS.
	  A small difference between the two can mean more frequent watchdog feeds, which increases
	  power consumption.

config APP_FOTA_MSG_PROCESSING_TIMEOUT_SECONDS
	int "Maximum message processing time"
	default 180
	help
	  Maximum time allowed for processing a single message in the module's state machine.
	  The value must be smaller than CONFIG_APP_FOTA_WATCHDOG_TIMEOUT_SECONDS.

module = APP_FOTA
module-str = FOTA
source "subsys/logging/Kconfig.template.log_config"

endif # APP_FOTA
```

## app/src/modules/led/Kconfig.led
```kconfig
#
# Copyright (c) 2024 Nordic Semiconductor
#
# SPDX-License-Identifier: LicenseRef-Nordic-5-Clause
#

menuconfig APP_LED
	bool "LED"
	select LED

if APP_LED

module = APP_LED
module-str = LED
source "subsys/logging/Kconfig.template.log_config"

endif # APP_LED
```

## app/src/modules/location/Kconfig.location
```kconfig
# Copyright (c) 2024 Nordic Semiconductor
#
# SPDX-License-Identifier: LicenseRef-Nordic-5-Clause
#

menuconfig APP_LOCATION
	bool "Location"
	default y if LOCATION
	select LOCATION_DATA_DETAILS

if APP_LOCATION

config APP_LOCATION_THREAD_STACK_SIZE
	int "Thread stack size"
	default 2560

config APP_LOCATION_WATCHDOG_TIMEOUT_SECONDS
	int "Watchdog timeout"
	default 120
	help
	  Timeout in seconds for the location module watchdog.
	  The timeout given in this option covers both:
	    * Waiting for an incoming message in zbus_sub_wait_msg().
	    * Time spent processing the message, defined by
	      CONFIG_APP_LOCATION_MSG_PROCESSING_TIMEOUT_SECONDS.
	  Ensure that this value exceeds CONFIG_APP_LOCATION_MSG_PROCESSING_TIMEOUT_SECONDS.
	  A small difference between the two can mean more frequent watchdog feeds, which increases
	  power consumption.

config APP_LOCATION_MSG_PROCESSING_TIMEOUT_SECONDS
	int "Maximum message processing time"
	default 60
	help
	  Maximum time allowed for processing a single message in the module's state machine.
	  The value must be smaller than CONFIG_APP_LOCATION_WATCHDOG_TIMEOUT_SECONDS.

config APP_LOCATION_WIFI_APS_MAX
	int "Maximum number of Wi-Fi APs"
	default 10
	help
	  Maximum number of Wi-Fi access points to store in a location request.

config APP_LOCATION_NEIGHBOR_CELLS_MAX
	int "Maximum number of neighbor cells"
	default 10
	help
	  Maximum number of neighbor cells to store in a location request.

module = APP_LOCATION
module-str = Location
source "subsys/logging/Kconfig.template.log_config"

endif # APP_LOCATION
```

## app/src/modules/memfault/Kconfig.memfault
```kconfig
#
# Copyright (c) 2024 Nordic Semiconductor
#
# SPDX-License-Identifier: LicenseRef-Nordic-5-Clause
#

menuconfig APP_MEMFAULT
	bool "Memfault"
	select MEMFAULT
	select MEMFAULT_HTTP_PERIODIC_UPLOAD
	select MODEM_KEY_MGMT
	select MEMFAULT_LOGGING_ENABLE
	select MEMFAULT_HTTP_ENABLE
	select MEMFAULT_NCS_LTE_METRICS
	select MEMFAULT_NCS_STACK_METRICS
	select MEMFAULT_NCS_INTERNAL_FLASH_BACKED_COREDUMP

if APP_MEMFAULT

config APP_MEMFAULT_INCLUDE_MODEM_TRACES
	bool "Modem traces to memfault"
	select MEMFAULT_CDR_ENABLE
	help
	  Include modem traces with Memfault coredumps.

config APP_MEMFAULT_THREAD_STACK_SIZE
	int "Thread stack size"
	default 1536

config APP_MEMFAULT_WATCHDOG_TIMEOUT_SECONDS
	int "Watchdog timeout seconds"
	default 1200

config APP_MEMFAULT_ZBUS_TIMEOUT_SECONDS
	int "Wait for zbus timeout seconds"
	default 60

config APP_MEMFAULT_UPLOAD_METRICS_ON_CLOUD_READY
	bool "Update metrics on cloud ready events"
	help
	  Update and upload metrics to Memfault when the cloud connection is ready.
	  Note that this means that metrics will be uploaded every time network connection is
	  established and cloud is connected. In poor network conditions, this may happen
	  frequently and may consume a excessive amount of data and power.
	  Also note that this only applies to metrics, not coredumps, which are uploaded
	  regardless of this setting.

module = APP_MEMFAULT
module-str = Memfault
source "subsys/logging/Kconfig.template.log_config"

endif # APP_MEMFAULT
```

## app/src/modules/network/Kconfig.network
```kconfig
#
# Copyright (c) 2024 Nordic Semiconductor
#
# SPDX-License-Identifier: LicenseRef-Nordic-5-Clause
#

menu "Network"
	depends on LTE_LINK_CONTROL
	depends on NTN

config APP_NETWORK
	bool "Network module"
	default y
	select LTE_LC_CELLULAR_PROFILE_MODULE
	help
	  Network module with TN and NTN GEO support.

config APP_NETWORK_SHELL
	bool "Network module shell commands"
	default y if SHELL
	help
	  Enable shell commands for the network module.

config APP_NETWORK_THREAD_STACK_SIZE
	int "Thread stack size"
	default 2048

config APP_NETWORK_WATCHDOG_TIMEOUT_SECONDS
	int "Watchdog timeout"
	default 600
	help
	  Timeout in seconds for the network module watchdog.
	  The timeout given in this option covers both:
	    * Waiting for an incoming message in zbus_sub_wait_msg().
	    * Time spent processing the message, defined by
	      CONFIG_APP_NETWORK_MSG_PROCESSING_TIMEOUT_SECONDS.
	  Ensure that this value exceeds
	      CONFIG_APP_NETWORK_MSG_PROCESSING_TIMEOUT_SECONDS.
	  A small difference between the two can mean more frequent watchdog feeds,
	  which increases power consumption.

config APP_NETWORK_MSG_PROCESSING_TIMEOUT_SECONDS
	int "Maximum message processing time"
	default 570
	help
	  Maximum time allowed for processing a single message in the module's
	  state machine. The value must be smaller than
	  CONFIG_APP_NETWORK_WATCHDOG_TIMEOUT_SECONDS.

config APP_NETWORK_TN_SEARCH_TIMEOUT_SECONDS
	int "Terrestrial search timeout (seconds)"
	default 300
	help
	  Maximum time to search for a terrestrial network before reporting
	  NETWORK_TN_SEARCH_FAILED.

config APP_NETWORK_AWAITING_LOCATION_TIMEOUT_SECONDS
	int "GNSS location wait timeout (seconds)"
	default 120
	help
	  Maximum time to wait for NETWORK_GNSS_LOCATION after requesting a fix.

config APP_NETWORK_CELL_SEARCH_TIMEOUT_SECONDS
	int "NTN cell search timeout (seconds)"
	default 600
	help
	  Maximum time to search for an NTN cell after location is set.

config APP_NETWORK_LOCATION_MAX_AGE_SECONDS
	int "Cached NTN location maximum age (seconds)"
	default 3600
	help
	  Re-request GNSS when cached location is older than this value.

config APP_NETWORK_LOCATION_REQUEST_DEBOUNCE_SECONDS
	int "NTN modem location request debounce (seconds)"
	default 300
	help
	  Minimum interval between ntn_location_set() calls when the modem
	  repeats NTN_EVT_LOCATION_REQUEST.

module = APP_NETWORK
module-str = Network
source "subsys/logging/Kconfig.template.log_config"

endmenu # Network
```
