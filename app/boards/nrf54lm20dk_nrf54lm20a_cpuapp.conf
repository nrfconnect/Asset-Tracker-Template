## app/src/modules/network/Kconfig.network_ntn
```kconfig
#
# Copyright (c) 2026 Nordic Semiconductor
#
# SPDX-License-Identifier: LicenseRef-Nordic-5-Clause
#

menu "Network NTN"
	depends on LTE_LINK_CONTROL

config APP_NETWORK_NTN
	bool "NTN GEO fallback network module"
	depends on NTN
	depends on APP_LOCATION
	help
	  Replace the standard network module with an NTN-aware variant that
	  tries terrestrial networks first and falls back to NTN GEO (Skylo)
	  when TN is unavailable. Requires NTN-capable modem firmware
	  (mfw_nrf9151-ntn).

if APP_NETWORK_NTN

config APP_NETWORK_NTN_SHELL
	bool "NTN network module shell commands"
	default y if SHELL
	help
	  Enable shell commands for the NTN network module.

config APP_NETWORK_NTN_THREAD_STACK_SIZE
	int "Thread stack size"
	default 2048
	help
	  Stack size for the NTN network module thread. Larger than
	  the standard network module due to GNSS and NTN handling.

config APP_NETWORK_NTN_WATCHDOG_TIMEOUT_SECONDS
	int "Watchdog timeout"
	default 600
	help
	  Timeout in seconds for the NTN network module watchdog.

config APP_NETWORK_NTN_MSG_PROCESSING_TIMEOUT_SECONDS
	int "Maximum message processing time"
	default 570
	help
	  Maximum time allowed for processing a single message.
	  Must be smaller than CONFIG_APP_NETWORK_NTN_WATCHDOG_TIMEOUT_SECONDS.

config APP_NETWORK_NTN_TN_SEARCH_USE_LIGHT_SEARCH
	bool "Use light search for TN before NTN fallback"
	help
	  If enabled, fall back to NTN after the modem completes a light search
	  (faster, based on cell history). If disabled, wait for the full search
	  to complete before falling back.

config APP_NETWORK_NTN_TN_SEARCH_TIMEOUT_SECONDS
	int "TN search timeout (seconds)"
	default 90
	help
	  Maximum time to wait for terrestrial network search to complete.
	  If neither a PDN connection nor a search done event is received
	  within this time, the module falls back to NTN. This is a safety
	  net in case modem domain events are not delivered.

config APP_NETWORK_NTN_STATIC_LATITUDE
	int "Static fallback latitude (microdegrees)"
	default 0
	help
	  Latitude in microdegrees (degrees * 1000000) used as last
	  resort when no GNSS fix is available.
	  Example: 63430000 for 63.43 N.

config APP_NETWORK_NTN_STATIC_LONGITUDE
	int "Static fallback longitude (microdegrees)"
	default 0
	help
	  Longitude in microdegrees (degrees * 1000000) used as last
	  resort when no GNSS fix is available.
	  Example: 10390000 for 10.39 E.

config APP_NETWORK_NTN_STATIC_ALTITUDE
	int "Static fallback altitude (meters)"
	default 0
	help
	  Altitude in meters above WGS-84 ellipsoid used as last
	  resort when no GNSS fix is available.
	  Example: 50 for 50 meters.

config APP_NETWORK_NTN_SEARCH_NETWORK_ON_STARTUP
	bool "Search for network on startup"
	default y
	help
	  If enabled, the module will search for a network on startup.
	  If disabled, network search must be triggered by a NETWORK_CONNECT
	  message.

module = APP_NETWORK_NTN
module-str = Network NTN
source "subsys/logging/Kconfig.template.log_config"

endif # APP_NETWORK_NTN

endmenu # Network NTN
```

## app/src/modules/network_ntn/Kconfig.network
```kconfig
#
# Copyright (c) 2024 Nordic Semiconductor
#
# SPDX-License-Identifier: LicenseRef-Nordic-5-Clause
#

menu "Network"
	depends on NRF_MODEM_LIB_NET_IF || (WIFI_NRF700X && WIFI_MGMT_EXT) || BOARD_NATIVE_POSIX

config APP_NETWORK_SHELL
	bool "Network module shell commands"
	default y if SHELL
	help
	  Enable shell commands for the network module.

config APP_NETWORK_THREAD_STACK_SIZE
	int "Thread stack size"
	default 2048

config APP_NETWORK_WATCHDOG_TIMEOUT_SECONDS
	int "Watchdog timeout"
	default 600
	help
	  Timeout in seconds for the network module watchdog.
	  The timeout given in this option covers both:
	    * Waiting for an incoming message in zbus_sub_wait_msg().
	    * Time spent processing the message, defined by
	      CONFIG_APP_NETWORK__MSG_PROCESSING_TIMEOUT_SECONDS.
	  Ensure that this value exceeds CONFIG_APP_NETWORK__MSG_PROCESSING_TIMEOUT_SECONDS.
	  A small difference between the two can mean more frequent watchdog feeds, which increases
	  power consumption.

config APP_NETWORK_MSG_PROCESSING_TIMEOUT_SECONDS
	int "Maximum message processing time"
	default 570
	help
	  Maximum time allowed for processing a single message in the module's state machine.
	  The value must be smaller than CONFIG_APP_NETWORK__WATCHDOG_TIMEOUT_SECONDS.

config APP_NETWORK_SEARCH_NETWORK_ON_STARTUP
	bool "Search for network on startup"
	default y
	help
	  If enabled, the module will search for a network on startup.
	  If disabled, network search must be triggered by a NETWORK_CONNECT message.

menu "NTN settings"
	depends on APP_NTN_MODE

config APP_NTN_BANDLOCK_ENABLE
	bool "Enable bandlock"
	default y
	help
	  Enable bandlock

if APP_NTN_BANDLOCK_ENABLE

config APP_NTN_BANDLOCK
	int "Bandlock"
	default 256
	help
	  Bandlock
endif

config APP_NTN_CHANNEL_SELECT_ENABLE
	bool "Enable channel select"
	default y
	help
	 Enable channel select 

if APP_NTN_CHANNEL_SELECT_ENABLE
config APP_NTN_CHANNEL_SELECT
	int "Channel / earfcn"
	default 228841
	help
	  Select channel
endif

config APP_NTN_APN_ENABLE
	bool "Set APN"
	default y
	help
	  Set APN

if APP_NTN_APN_ENABLE
config APP_NTN_APN
	string "APN"
	default "internet"
	help
	  APN
endif
endmenu

module = APP_NETWORK
module-str = Network
source "subsys/logging/Kconfig.template.log_config"

endmenu # Network
```

## app/src/modules/ntn_module/Kconfig.ntn
```kconfig
# Copyright (c) 2025 Nordic Semiconductor ASA
#
# SPDX-License-Identifier: LicenseRef-Nordic-5-Clause

menuconfig APP_NTN
	bool "NTN"
	default y if APP_NTN_MODE

if APP_NTN

config APP_NTN_THREAD_STACK_SIZE
	int "NTN module thread stack size"
	default 2048

config APP_NTN_TIMER_TIMEOUT_MINUTES
	int "NTN timer timeout in minutes"
	default 15
	help
	  Timer timeout for NTN mode before switching back to GNSS mode.

config APP_NTN_BANDLOCK_ENABLE
	bool "Enable NTN band lock"
	help
	  Enable band lock for NTN mode.

if APP_NTN_BANDLOCK_ENABLE

config APP_NTN_BANDLOCK
	int "NTN band to lock to"
	default 265
	help
	  Band number to lock NTN mode to.

endif # APP_NTN_BANDLOCK_ENABLE

config APP_NTN_CHANNEL_SELECT_ENABLE
	bool "Enable NTN channel select"
	help
	  Enable channel selection for NTN mode.

if APP_NTN_CHANNEL_SELECT_ENABLE

config APP_NTN_CHANNEL_SELECT
	int "NTN channel to select"
	default 1
	help
	  Channel number to select in NTN mode.

endif # APP_NTN_CHANNEL_SELECT_ENABLE

config APP_NTN_DISABLE_EPCO
	bool "Disable ePCO"
	help
	  Disable ePCO.

config APP_NTN_SERVER_ADDR
	string "NTN server address"
	default ""
	help
	  IP address of the NTN server to connect to.

config APP_NTN_SERVER_PORT
	int "NTN server port"
	default 0
	help
	  Port number of the NTN server to connect to.

config APP_NTN_SEND_GNSS_DATA
	bool "Send GNSS data to UDP endpoint"
	help
	  Send GNSS data to UDP endpoint.

config APP_NTN_WATCHDOG_TIMEOUT_SECONDS
	int "NTN module watchdog timeout in seconds"
	default 60
	help
	  If the NTN module thread is stuck for this amount of time,
	  the device will reset.

config APP_NTN_MSG_PROCESSING_TIMEOUT_SECONDS
	int "Maximum time in seconds allowed for processing a single message"
	default 60
	help
	  Maximum time allowed for processing a single message in the NTN module.
	  Must be less than APP_NTN_WATCHDOG_TIMEOUT_SECONDS.

module = APP_NTN
module-str = NTN
source "subsys/logging/Kconfig.template.log_config"

endif # APP_NTN
```

## app/src/modules/power/Kconfig.power
```kconfig
#
# Copyright (c) 2024 Nordic Semiconductor
#
# SPDX-License-Identifier: LicenseRef-Nordic-5-Clause
#

menu "Power"

config APP_POWER
	bool "Power module"
	depends on NRF_FUEL_GAUGE
	depends on NPM13XX_CHARGER

if APP_POWER

config APP_POWER_DISABLE_UART_ON_VBUS_REMOVED
	bool "Disable UART when VBUS is removed"
	default y

config APP_POWER_THREAD_STACK_SIZE
	int "Thread stack size"
	default 1344

config APP_POWER_WATCHDOG_TIMEOUT_SECONDS
	int "Watchdog timeout"
	default 120
	help
	  Timeout in seconds for the power module watchdog.
	  The timeout given in this option covers both:
	    * Waiting for an incoming message in zbus_sub_wait_msg().
	    * Time spent processing the message, defined by
	      CONFIG_APP_POWER_MSG_PROCESSING_TIMEOUT_SECONDS.
	  Ensure that this value exceeds CONFIG_APP_POWER_MSG_PROCESSING_TIMEOUT_SECONDS.
	  A small difference between the two can mean more frequent watchdog feeds, which increases
	  power consumption.

config APP_POWER_MSG_PROCESSING_TIMEOUT_SECONDS
	int "Maximum message processing time"
	default 3
	help
	  Maximum time allowed for processing a single message in the module's state machine.
	  The value must be smaller than CONFIG_APP_POWER_WATCHDOG_TIMEOUT_SECONDS.

module = APP_POWER
module-str = Power
source "subsys/logging/Kconfig.template.log_config"

endif # APP_POWER

endmenu # Power
```

## app/src/modules/sgp4/Kconfig.sat_prediction
```kconfig
config APP_SAT_PREDICTION
    bool "Satellite Prediction Module"
    default y
    select DATE_TIME
    help
      Enable satellite prediction module using SGP4.
```

## app/src/modules/sgp4/Kconfig.sgp4
```kconfig
#
# Copyright (c) 2026 Nordic Semiconductor
#
# SPDX-License-Identifier: LicenseRef-Nordic-5-Clause
#

config APP_SGP4
    bool "SGP4 Satellite Prediction Module"
    default n
    select DATE_TIME
    help
      Enable satellite prediction module using SGP4.
```

## app/src/modules/shell/Kconfig.shell
```kconfig
#
# Copyright (c) 2024 Nordic Semiconductor
#
# SPDX-License-Identifier: LicenseRef-Nordic-5-Clause
#

menuconfig APP_SHELL
	bool "Zbus Shell"
	depends on SHELL
	depends on !AT_HOST_LIRBARY
	imply AT_SHELL
	default y
	help
	  Shell that adds usefaul commands to control certain aspects of the application.

if APP_SHELL

module = APP_SHELL
module-str = SHELL
source "subsys/logging/Kconfig.template.log_config"

endif # APP_SHELL
```

## app/src/modules/storage/Kconfig.storage
```kconfig
# Copyright (c) 2025 Nordic Semiconductor ASA
#
# SPDX-License-Identifier: LicenseRef-Nordic-5-Clause

menuconfig APP_STORAGE
	bool "Storage module"
	default y
	select ZBUS
	select ZBUS_RUNTIME_OBSERVERS

if APP_STORAGE

config APP_STORAGE_THREAD_STACK_SIZE
	int "Storage module thread stack size"
	default 1720 if APP_STORAGE_BACKEND_RAM
	default 3200 if APP_STORAGE_BACKEND_LITTLEFS

choice APP_STORAGE_BACKEND
	prompt "Storage backend"
	default APP_STORAGE_BACKEND_RAM
	help
	  Select the storage backend to use for storing data samples.

config APP_STORAGE_BACKEND_RAM
	bool "RAM storage backend"
	help
	  Store data in RAM. Data will be lost on power loss or reset.

config APP_STORAGE_BACKEND_LITTLEFS
	bool "LittleFS storage backend"
	select FILE_SYSTEM
	select FILE_SYSTEM_LITTLEFS
	help
	  Store data in LittleFS filesystem. Data will persist across power
	  loss and resets, as long as the underlying flash storage is intact.

endchoice # APP_STORAGE_BACKEND

if APP_STORAGE_BACKEND_LITTLEFS

# Setup PM partition size for LittleFS to 64KB by default
config PM_PARTITION_SIZE_LITTLEFS
	default 0x10000

config PM_PARTITION_REGION_LITTLEFS_EXTERNAL
	default y if PM_EXTERNAL_FLASH_ENABLED

config APP_STORAGE_LITTLEFS_MAX_PATH_LEN
	int "Maximum length of storage file names"
	default 64
	help
	  Maximum length of file names used by the storage module
	  in the LittleFS backend.

endif # APP_STORAGE_BACKEND_LITTLEFS

config APP_STORAGE_MAX_TYPES
	int "Maximum number of data types"
	default 4
	help
	  Maximum number of different data types that can be registered
	  for storage. Each type requires memory for storing its records,
	  so this value affects RAM usage. Total RAM usage will be:
	  MAX_TYPES * MAX_RECORDS_PER_TYPE * RECORD_SIZE bytes.

config APP_STORAGE_MAX_RECORDS_PER_TYPE
	int "Maximum records per data type"
	default 8
	help
	  Maximum number of records that can be stored for each data type.
	  For example, if set to 32, you can store up to 32 battery samples,
	  32 environmental samples, etc. This value affects RAM usage.
	  Total RAM usage will be:
	  MAX_TYPES * MAX_RECORDS_PER_TYPE * RECORD_SIZE bytes.

config APP_STORAGE_BATCH_BUFFER_SIZE
	int "Storage batch buffer size in bytes"
	default 1024
	help
	  Size of the internal buffer for batch data access.
	  This buffer is used to transfer data from the storage backend
	  to consuming modules via the batch interface.

	  Larger buffers can improve throughput but use more RAM.
	  Must be large enough to hold at least one complete data item
	  plus its header.

config APP_STORAGE_SESSION_TIMEOUT_SECONDS
	int "Storage batch session timeout"
	default 60
	help
	  Timeout for an active storage batch session. If no activity
	  occurs on the session for this duration, it will be automatically
	  closed to prevent the storage module from getting stuck in a
	  busy state.

config APP_STORAGE_WATCHDOG_TIMEOUT_SECONDS
	int "Storage module watchdog timeout in seconds"
	default 60
	help
	  If the storage module thread is stuck for this amount of time,
	  the device will reset.

config APP_STORAGE_MSG_PROCESSING_TIMEOUT_SECONDS
	int "Maximum time in seconds allowed for processing a single message"
	default 5
	help
	  Maximum time allowed for processing a single message in the storage module.
	  Must be less than APP_STORAGE_WATCHDOG_TIMEOUT_SECONDS.

choice APP_STORAGE_INITIAL_MODE
	prompt "Storage module initial mode"
	default APP_STORAGE_INITIAL_MODE_PASSTHROUGH
	help
	  Select the initial mode of the storage module.

config APP_STORAGE_INITIAL_MODE_PASSTHROUGH
	bool "Passthrough mode"
	help
	  In this mode, the storage module will pass messages directly to STORAGE_DATA messages
	  without any buffering of data.

config APP_STORAGE_INITIAL_MODE_BUFFER
	bool "Buffer mode"
	help
	  In this mode, the storage module will buffer data samples in the configured backend.
	  Data is sent from the storage module upon request from other modules.

endchoice

config APP_STORAGE_SHELL
	bool "Enable storage shell commands"
	default y if SHELL
	select FILE_SYSTEM_SHELL if APP_STORAGE_BACKEND_LITTLEFS
	help
	  Enable shell commands for interacting with the storage module.
	  This allows you to manage stored data from the command line.

config APP_STORAGE_SHELL_STATS
	bool "Enable storage shell stats commands"
	default y if APP_STORAGE_SHELL
	help
	  Enable shell commands for displaying statistics about the storage module.
	  This includes information about stored records, types, and memory usage.
	  Enabling this option will increase the code size of the storage module.

module = APP_STORAGE
module-str = Storage
source "subsys/logging/Kconfig.template.log_config"

endif # APP_STORAGE
```
