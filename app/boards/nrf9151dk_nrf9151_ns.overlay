/*
 * Copyright (c) 2025 Nordic Semiconductor ASA
 *
 * SPDX-License-Identifier: LicenseRef-Nordic-5-Clause
 */

/ {
	chosen {
		nordic,modem-trace-uart = &uart1;
	};
};

&uart1 {
	status = "okay";
	current-speed = <1000000>;
};

flash_ext: &gd25wb256 {
	status = "okay";
};

/* Flash partitions (littlefs_storage, MCUboot slots, etc.) */
/delete-node/ &boot_partition;
/delete-node/ &slot1_partition;
/delete-node/ &tfm_ps_partition;
/delete-node/ &tfm_its_partition;
/delete-node/ &tfm_otp_partition;
#include "att_flash_partitions.dtsi"
#include "att_sram_partitions.dtsi"
