## Kconfig
```kconfig
#
# Copyright (c) 2025 Nordic Semiconductor ASA
#
# SPDX-License-Identifier: LicenseRef-Nordic-5-Clause
#

rsource "extras/modules/cloud_mqtt/Kconfig.cloud_mqtt"
```

## app/src/modules/ntn/Kconfig.ntn
```kconfig
# Copyright (c) 2025 Nordic Semiconductor ASA
#
# SPDX-License-Identifier: LicenseRef-Nordic-5-Clause

menuconfig APP_NTN
	bool "NTN module"
	default y if APP_NTN_MODE

if APP_NTN

config APP_NTN_THREAD_STACK_SIZE
	int "NTN module thread stack size"
	default 5120

config APP_NTN_TIMER_TIMEOUT_MINUTES
	int "NTN timer timeout in minutes"
	default 15
	help
	  Timer timeout for NTN mode before switching back to GNSS mode.

config APP_NTN_LOCATION_VALIDITY_TIME_SECONDS
	int "NTN location validity time"
	default 1800
	help
	  Location validity in seconds for NTN mode. The value depends on the use-case and what NTN constellation is used.
	  For example, if the device is stationary and using GEO, the value can be longer.
	  If the device is moving and using LEO, the value should be shorter.
	  The distance the device is expected to travel must also be considered.

config APP_NTN_BANDLOCK_ENABLE
	bool "Enable NTN band lock"
	help
	  Enable band lock for NTN mode.

if APP_NTN_BANDLOCK_ENABLE

config APP_NTN_BANDLOCK
	int "NTN band to lock to"
	default 265
	help
	  Band number to lock NTN mode to.

endif # APP_NTN_BANDLOCK_ENABLE

config APP_NTN_CHANNEL_SELECT_ENABLE
	bool "Enable NTN channel select"
	help
	  Enable channel selection for NTN mode.

if APP_NTN_CHANNEL_SELECT_ENABLE

config APP_NTN_CHANNEL_SELECT
	int "NTN channel to select"
	default 1
	help
	  Channel number to select in NTN mode.

endif # APP_NTN_CHANNEL_SELECT_ENABLE

config APP_NTN_SERVER_ADDR
	string "NTN server address"
	default ""
	help
	  IP address of the NTN server to connect to.

config APP_NTN_SERVER_PORT
	int "NTN server port"
	default 0
	help
	  Port number of the NTN server to connect to.

config APP_NTN_SEND_GNSS_DATA
	bool "Send GNSS data to UDP endpoint"
	help
	  Send GNSS data to UDP endpoint.

config APP_NTN_WATCHDOG_TIMEOUT_SECONDS
	int "NTN module watchdog timeout in seconds"
	default 300
	help
	  If the NTN module thread is stuck for this amount of time,
	  the device will reset.

config APP_NTN_MSG_PROCESSING_TIMEOUT_SECONDS
	int "Maximum time in seconds allowed for processing a single message"
	default 240
	help
	  Maximum time allowed for processing a single message in the NTN module.
	  Must be less than APP_NTN_WATCHDOG_TIMEOUT_SECONDS.

config APP_NTN_THINGY_ROCKS_ENDPOINT
	bool "Use world.thingy.rocks endpoint"
	help
	  Use world.thingy.rocks endpoint.

config APP_NTN_IRIDIUM
	bool "Iridium network"
	help
	  Iridium network.

config APP_NTN_NETWORK_CONNECTION_TIMEOUT_SECONDS
	int "NTN cell search / connection timeout in seconds"
	range 1 600
	default 180
	help
	  Maximum time the application waits, after switching the modem to NTN
	  active mode (CFUN=21), for the modem to acquire a satellite cell and
	  register on the network. Once this timer expires the NTN attempt is
	  aborted and the modem is taken to flight mode (CFUN=45).

	  NTN cell search takes significantly longer than terrestrial NB-IoT
	  because of long propagation delays, fewer search opportunities per
	  DRX cycle and fewer cells. A value below ~60 seconds is rarely
	  enough; 90-180 seconds is a reasonable range.

config APP_NTN_REGISTERED_TIMEOUT_SECONDS
	int "Extended NTN timeout once registered, in seconds"
	range 1 600
	default 120
	help
	  Once the modem reports CEREG registered (HOME or ROAMING) on the NTN
	  network, the connection timeout is restarted with this value to give
	  RRC connection setup and PDN activation time to complete before the
	  application gives up and issues CFUN=45.

config APP_NTN_SEND_ACK_TIMEOUT_SECONDS
	int "Network send acknowledgement timeout in seconds"
	range 1 600
	default 120
	help
	  SO_SNDTIMEO value for payload sends using SO_SENDCB. After a payload
	  is queued, the modem waits up to this long for network acknowledgement
	  before the send callback reports failure and NTN_SEND_FAILED is
	  published. Valid modem values are 1 to 600 seconds.

module = APP_NTN
module-str = NTN
source "subsys/logging/Kconfig.template.log_config"

endif # APP_NTN
```

## examples/modules/ntn/Kconfig.ntn
```kconfig
#
# Copyright (c) 2026 Nordic Semiconductor
#
# SPDX-License-Identifier: LicenseRef-Nordic-5-Clause
#

menuconfig APP_NTN
	bool "NTN fallback module"
	depends on APP_CLOUD && APP_LOCATION
	select NTN
	select LTE_LC_CELLULAR_PROFILE_MODULE
	select LTE_LC_PERIODIC_SEARCH_MODULE
	help
	  Use the Iridium non-terrestrial network (NTN) when no terrestrial network is available.
	  The module suspends the network module, sends GNSS locations to nRF Cloud over NTN by
	  resuming the paused CoAP session, and periodically hands the modem back to the network
	  module to search for a terrestrial network.
	  Requires modem firmware with Iridium NTN support.

if APP_NTN

config APP_NTN_TN_FALLBACK_TIMEOUT_SECONDS
	int "Terrestrial network timeout"
	default 600
	help
	  Time in seconds without a terrestrial network connection before falling back to NTN.
	  The timer starts at boot and every time the terrestrial network connection is lost.

config APP_NTN_FALLBACK_ON_SEARCH_DONE
	bool "Fall back to NTN when a network search completes without result"
	default y
	help
	  Fall back to NTN as soon as the modem reports that a complete terrestrial network search
	  found no suitable cell, without waiting for CONFIG_APP_NTN_TN_FALLBACK_TIMEOUT_SECONDS.

config APP_NTN_TN_RETRY_INTERVAL_MINUTES
	int "Terrestrial network retry interval"
	default 60
	help
	  Interval in minutes for handing the modem back to the network module to search for a
	  terrestrial network while using NTN.

config APP_NTN_UPLINK_INTERVAL_SECONDS
	int "Minimum NTN uplink interval"
	default 900
	help
	  Minimum time in seconds between two location uplinks over NTN. GNSS locations are
	  obtained at the application sampling interval, and locations obtained more often than
	  this interval are not sent over NTN.

config APP_NTN_LOCATION_VALIDITY_SECONDS
	int "Location validity"
	default 1800
	help
	  Time in seconds a GNSS location is considered valid for NTN cell search and timing
	  advance computation. 0 means infinite validity. Use a long validity for stationary
	  devices and a short validity for moving devices.

config APP_NTN_CONNECTION_TIMEOUT_SECONDS
	int "NTN connection timeout"
	default 240
	help
	  Maximum time in seconds to find an NTN cell and register before giving up on an uplink.

config APP_NTN_REGISTERED_TIMEOUT_SECONDS
	int "NTN registered timeout"
	default 180
	help
	  Time in seconds the connection timeout is extended with once the modem is registered to
	  the NTN network, to allow RRC and PDN setup to complete after registration.

config APP_NTN_SERVICE_REQUEST_ADDR
	string "UDP service request destination address"
	default "8.8.8.8"
	help
	  IPv4 address for the service-request UDP packet sent on PDN resume/activate to trigger
	  an RRC connection before the CoAP uplink.

config APP_NTN_SERVICE_REQUEST_PORT
	int "UDP service request destination port"
	default 53
	help
	  UDP port for the service-request trigger on PDN resume/activate.

config APP_NTN_BANDLOCK
	int "NTN band"
	default 249
	help
	  Band locked in NTN mode. The band lock is removed when returning to the terrestrial
	  network.

config APP_NTN_CHANNEL_SELECT
	int "NTN channel (EARFCN)"
	default 196702
	help
	  Channel used in NTN mode. The channel selection is removed when returning to the
	  terrestrial network.

config APP_NTN_CLOUD_FULL_CONNECT
	bool "Allow full nRF Cloud connection over NTN"
	help
	  Connect to nRF Cloud with a full DTLS handshake over NTN when there is no paused CoAP
	  session to resume, for example when the device has not been connected to a terrestrial
	  network since boot. The handshake uses considerably more data and time than resuming.

config APP_NTN_SHELL
	bool "NTN module shell commands"
	default y if SHELL

config APP_NTN_THREAD_STACK_SIZE
	int "Thread stack size"
	default 8192

config APP_NTN_WATCHDOG_TIMEOUT_SECONDS
	int "Watchdog timeout"
	default 1200
	help
	  Timeout in seconds for the NTN module watchdog.
	  The timeout given in this option covers both:
	    * Waiting for an incoming message in zbus_sub_wait_msg().
	    * Time spent processing the message, defined by
	      CONFIG_APP_NTN_MSG_PROCESSING_TIMEOUT_SECONDS.
	  Ensure that this value exceeds CONFIG_APP_NTN_MSG_PROCESSING_TIMEOUT_SECONDS.

config APP_NTN_MSG_PROCESSING_TIMEOUT_SECONDS
	int "Maximum message processing time"
	default 1170
	help
	  Maximum time allowed for processing a single message in the module's state machine.
	  This must cover the confirmable shadow update and location send over NTN, including
	  CoAP retransmissions, and a full nRF Cloud connection if
	  CONFIG_APP_NTN_CLOUD_FULL_CONNECT is enabled.
	  The value must be smaller than CONFIG_APP_NTN_WATCHDOG_TIMEOUT_SECONDS.

module = APP_NTN
module-str = NTN
source "subsys/logging/Kconfig.template.log_config"

endif # APP_NTN
```

## lib/Kconfig
```kconfig
#
# Copyright (c) 2026 Nordic Semiconductor ASA
#
# SPDX-License-Identifier: LicenseRef-Nordic-5-Clause
#

rsource "app_attest_token/Kconfig"
```

## lib/app_attest_token/Kconfig
```kconfig
#
# Copyright (c) 2026 Nordic Semiconductor ASA
#
# SPDX-License-Identifier: LicenseRef-Nordic-5-Clause
#

menuconfig APP_ATTEST_TOKEN
	bool "Application attestation token library"
	depends on HAS_IRONSIDE_SE
	select BASE64
	select AT_CMD_CUSTOM
	select AT_PARSER
	select PSA_CRYPTO
	select PSA_WANT_KEY_TYPE_ECC_KEY_PAIR_IMPORT
	select PSA_WANT_ALG_ECDSA
	select PSA_WANT_ECC_SECP_R1_256
	select PSA_WANT_ALG_SHA_256
	select PSA_WANT_GENERATE_RANDOM
	help
	  Generate a device attestation token on the application core using PSA
	  crypto and the IronSide SE Identity Attestation Key (IAK).

if APP_ATTEST_TOKEN

module=APP_ATTEST_TOKEN
module-str=Application Attestation Token
source "$(ZEPHYR_BASE)/subsys/logging/Kconfig.template.log_config"

endif # APP_ATTEST_TOKEN
```

## west.yml
```yaml
# Copyright (c) 2024 Nordic Semiconductor
# SPDX-License-Identifier: LicenseRef-Nordic-5-Clause

manifest:
  self:
    west-commands: scripts/west-commands.yml
    path: project

  remotes:
    - name: ncs
      url-base: https://github.com/nrfconnect
    - name: memfault
      url-base: https://github.com/memfault

  projects:
    - name: nrf
      remote: ncs
      repo-path: sdk-nrf
      revision: v3.5.0-preview3
      import: true
    # Overrides the Memfault SDK version with a newer one supporting multi-component OTA.
    - name: memfault-firmware-sdk
      remote: memfault
      repo-path: memfault-firmware-sdk
      revision: 1.47.0
      path: modules/lib/memfault-firmware-sdk
```
